VERSION ""

NS_ :

BS_:

BU_: EHR_Spare FEHR_3 PTO_SpeedSelector Dummy_Node_Ch2 FEHR_2 TrailerBrake OffBoardDiagnosticTool1_Ch2 PowerTakeOff_Ch2 Transmission1_Ch2 FEHR_1 REHR_5 REHR_4 REHR_3 REHR_2 REHR_1 InstrumentCluster_Ch2 ManagementComputer_Ch2 GWAY_OnBoardDiagnosticUnit_Ch2 GWAY_OffBoardDiagTool1_VB1_Ch2 GWAY_Engine1_Ch2 GWAY_CabDisplay1_Ch2 AuxiliaryValveControl_Ch2

BO_ 2566838913 SOFT_81: 89 REHR_2
 SG_ Appl_Id : 8|8@1+ (1,0) [0|255] ""  AuxiliaryValveControl_Ch2
 SG_ Appl_Id_Byte_01 : 368|8@1+ (1,0) [0|255] ""  AuxiliaryValveControl_Ch2
 SG_ Appl_Id_Byte_02 : 376|8@1+ (1,0) [0|255] ""  AuxiliaryValveControl_Ch2
 SG_ Appl_Id_Byte_03 : 384|8@1+ (1,0) [0|255] ""  AuxiliaryValveControl_Ch2
 SG_ Appl_Id_Byte_04 : 392|8@1+ (1,0) [0|255] ""  AuxiliaryValveControl_Ch2
 SG_ Appl_Id_Byte_05 : 400|8@1+ (1,0) [0|255] ""  AuxiliaryValveControl_Ch2
 SG_ Appl_Id_Byte_06 : 408|8@1+ (1,0) [0|255] ""  AuxiliaryValveControl_Ch2
 SG_ Appl_Id_Byte_07 : 416|8@1+ (1,0) [0|255] ""  AuxiliaryValveControl_Ch2
 SG_ Appl_Id_Byte_08 : 424|8@1+ (1,0) [0|255] ""  AuxiliaryValveControl_Ch2
 SG_ Appl_Id_Byte_09 : 432|8@1+ (1,0) [0|255] ""  AuxiliaryValveControl_Ch2
 SG_ Appl_Id_Byte_10 : 440|8@1+ (1,0) [0|255] ""  AuxiliaryValveControl_Ch2
 SG_ Appl_Id_Byte_11 : 448|8@1+ (1,0) [0|255] ""  AuxiliaryValveControl_Ch2
 SG_ Appl_Id_Byte_12 : 456|8@1+ (1,0) [0|255] ""  AuxiliaryValveControl_Ch2
 SG_ Appl_Id_Byte_13 : 464|8@1+ (1,0) [0|255] ""  AuxiliaryValveControl_Ch2
 SG_ Appl_Id_Byte_14 : 472|8@1+ (1,0) [0|255] ""  AuxiliaryValveControl_Ch2
 SG_ Appl_Id_Byte_15 : 480|8@1+ (1,0) [0|255] ""  AuxiliaryValveControl_Ch2
 SG_ Appl_Id_Byte_16 : 488|8@1+ (1,0) [0|255] ""  AuxiliaryValveControl_Ch2
 SG_ Appl_Id_Byte_17 : 496|8@1+ (1,0) [0|255] ""  AuxiliaryValveControl_Ch2
 SG_ Appl_Id_Byte_18 : 504|8@1+ (1,0) [0|255] ""  AuxiliaryValveControl_Ch2
 SG_ Appl_Id_Byte_19 : 512|8@1+ (1,0) [0|255] ""  AuxiliaryValveControl_Ch2
 SG_ Appl_Id_Byte_20 : 520|8@1+ (1,0) [0|255] ""  AuxiliaryValveControl_Ch2
 SG_ Appl_Id_Byte_21 : 528|8@1+ (1,0) [0|255] ""  AuxiliaryValveControl_Ch2
 SG_ Appl_Id_Byte_22 : 536|8@1+ (1,0) [0|255] ""  AuxiliaryValveControl_Ch2
 SG_ Appl_Id_Byte_23 : 544|8@1+ (1,0) [0|255] ""  AuxiliaryValveControl_Ch2
 SG_ Appl_Id_Byte_24 : 552|8@1+ (1,0) [0|255] ""  AuxiliaryValveControl_Ch2
 SG_ Appl_Id_Byte_25 : 560|8@1+ (1,0) [0|255] ""  AuxiliaryValveControl_Ch2
 SG_ Appl_Id_Byte_26 : 568|8@1+ (1,0) [0|255] ""  AuxiliaryValveControl_Ch2
 SG_ Appl_Id_Byte_27 : 576|8@1+ (1,0) [0|255] ""  AuxiliaryValveControl_Ch2
 SG_ Appl_Id_Byte_28 : 584|8@1+ (1,0) [0|255] ""  AuxiliaryValveControl_Ch2
 SG_ Appl_Id_Byte_29 : 592|8@1+ (1,0) [0|255] ""  AuxiliaryValveControl_Ch2
 SG_ Appl_Id_Byte_30 : 600|8@1+ (1,0) [0|255] ""  AuxiliaryValveControl_Ch2
 SG_ Appl_Id_Byte_31 : 608|8@1+ (1,0) [0|255] ""  AuxiliaryValveControl_Ch2
 SG_ Appl_Id_Byte_32 : 616|8@1+ (1,0) [0|255] ""  AuxiliaryValveControl_Ch2
 SG_ Appl_Id_Byte_33 : 624|8@1+ (1,0) [0|255] ""  AuxiliaryValveControl_Ch2
 SG_ Appl_Id_Byte_34 : 632|8@1+ (1,0) [0|255] ""  AuxiliaryValveControl_Ch2
 SG_ Appl_Id_Byte_35 : 640|8@1+ (1,0) [0|255] ""  AuxiliaryValveControl_Ch2
 SG_ Appl_Id_Byte_36 : 648|8@1+ (1,0) [0|255] ""  AuxiliaryValveControl_Ch2
 SG_ Appl_Id_Byte_37 : 656|8@1+ (1,0) [0|255] ""  AuxiliaryValveControl_Ch2
 SG_ Appl_Id_Byte_38 : 664|8@1+ (1,0) [0|255] ""  AuxiliaryValveControl_Ch2
 SG_ Appl_Id_Byte_39 : 672|8@1+ (1,0) [0|255] ""  AuxiliaryValveControl_Ch2
 SG_ Appl_Id_Enum : 680|24@1+ (1,0) [0|16777215] ""  AuxiliaryValveControl_Ch2
 SG_ Bootloader_Id : 360|8@1+ (1,0) [0|255] ""  AuxiliaryValveControl_Ch2
 SG_ Bootloader_Id_Byte_01 : 16|8@1+ (1,0) [0|255] ""  AuxiliaryValveControl_Ch2
 SG_ Bootloader_Id_Byte_02 : 24|8@1+ (1,0) [0|255] ""  AuxiliaryValveControl_Ch2
 SG_ Bootloader_Id_Byte_03 : 32|8@1+ (1,0) [0|255] ""  AuxiliaryValveControl_Ch2
 SG_ Bootloader_Id_Byte_04 : 40|8@1+ (1,0) [0|255] ""  AuxiliaryValveControl_Ch2
 SG_ Bootloader_Id_Byte_05 : 48|8@1+ (1,0) [0|255] ""  AuxiliaryValveControl_Ch2
 SG_ Bootloader_Id_Byte_06 : 56|8@1+ (1,0) [0|255] ""  AuxiliaryValveControl_Ch2
 SG_ Bootloader_Id_Byte_07 : 64|8@1+ (1,0) [0|255] ""  AuxiliaryValveControl_Ch2
 SG_ Bootloader_Id_Byte_08 : 72|8@1+ (1,0) [0|255] ""  AuxiliaryValveControl_Ch2
 SG_ Bootloader_Id_Byte_09 : 80|8@1+ (1,0) [0|255] ""  AuxiliaryValveControl_Ch2
 SG_ Bootloader_Id_Byte_10 : 88|8@1+ (1,0) [0|255] ""  AuxiliaryValveControl_Ch2
 SG_ Bootloader_Id_Byte_11 : 96|8@1+ (1,0) [0|255] ""  AuxiliaryValveControl_Ch2
 SG_ Bootloader_Id_Byte_12 : 104|8@1+ (1,0) [0|255] ""  AuxiliaryValveControl_Ch2
 SG_ Bootloader_Id_Byte_13 : 112|8@1+ (1,0) [0|255] ""  AuxiliaryValveControl_Ch2
 SG_ Bootloader_Id_Byte_14 : 120|8@1+ (1,0) [0|255] ""  AuxiliaryValveControl_Ch2
 SG_ Bootloader_Id_Byte_15 : 128|8@1+ (1,0) [0|255] ""  AuxiliaryValveControl_Ch2
 SG_ Bootloader_Id_Byte_16 : 136|8@1+ (1,0) [0|255] ""  AuxiliaryValveControl_Ch2
 SG_ Bootloader_Id_Byte_17 : 144|8@1+ (1,0) [0|255] ""  AuxiliaryValveControl_Ch2
 SG_ Bootloader_Id_Byte_18 : 152|8@1+ (1,0) [0|255] ""  AuxiliaryValveControl_Ch2
 SG_ Bootloader_Id_Byte_19 : 160|8@1+ (1,0) [0|255] ""  AuxiliaryValveControl_Ch2
 SG_ Bootloader_Id_Byte_20 : 168|8@1+ (1,0) [0|255] ""  AuxiliaryValveControl_Ch2
 SG_ Bootloader_Id_Byte_21 : 176|8@1+ (1,0) [0|255] ""  AuxiliaryValveControl_Ch2
 SG_ Bootloader_Id_Byte_22 : 184|8@1+ (1,0) [0|255] ""  AuxiliaryValveControl_Ch2
 SG_ Bootloader_Id_Byte_23 : 192|8@1+ (1,0) [0|255] ""  AuxiliaryValveControl_Ch2
 SG_ Bootloader_Id_Byte_24 : 200|8@1+ (1,0) [0|255] ""  AuxiliaryValveControl_Ch2
 SG_ Bootloader_Id_Byte_25 : 208|8@1+ (1,0) [0|255] ""  AuxiliaryValveControl_Ch2
 SG_ Bootloader_Id_Byte_26 : 216|8@1+ (1,0) [0|255] ""  AuxiliaryValveControl_Ch2
 SG_ Bootloader_Id_Byte_27 : 224|8@1+ (1,0) [0|255] ""  AuxiliaryValveControl_Ch2
 SG_ Bootloader_Id_Byte_28 : 232|8@1+ (1,0) [0|255] ""  AuxiliaryValveControl_Ch2
 SG_ Bootloader_Id_Byte_29 : 240|8@1+ (1,0) [0|255] ""  AuxiliaryValveControl_Ch2
 SG_ Bootloader_Id_Byte_30 : 248|8@1+ (1,0) [0|255] ""  AuxiliaryValveControl_Ch2
 SG_ Bootloader_Id_Byte_31 : 256|8@1+ (1,0) [0|255] ""  AuxiliaryValveControl_Ch2
 SG_ Bootloader_Id_Byte_32 : 264|8@1+ (1,0) [0|255] ""  AuxiliaryValveControl_Ch2
 SG_ Bootloader_Id_Byte_33 : 272|8@1+ (1,0) [0|255] ""  AuxiliaryValveControl_Ch2
 SG_ Bootloader_Id_Byte_34 : 280|8@1+ (1,0) [0|255] ""  AuxiliaryValveControl_Ch2
 SG_ Bootloader_Id_Byte_35 : 288|8@1+ (1,0) [0|255] ""  AuxiliaryValveControl_Ch2
 SG_ Bootloader_Id_Byte_36 : 296|8@1+ (1,0) [0|255] ""  AuxiliaryValveControl_Ch2
 SG_ Bootloader_Id_Byte_37 : 304|8@1+ (1,0) [0|255] ""  AuxiliaryValveControl_Ch2
 SG_ Bootloader_Id_Byte_38 : 312|8@1+ (1,0) [0|255] ""  AuxiliaryValveControl_Ch2
 SG_ Bootloader_Id_Byte_39 : 320|8@1+ (1,0) [0|255] ""  AuxiliaryValveControl_Ch2
 SG_ Bootloader_Id_Enum : 328|24@1+ (1,0) [0|16777215] ""  AuxiliaryValveControl_Ch2
 SG_ EndStrng_00 : 352|8@1+ (1,0) [0|255] "per byte"  AuxiliaryValveControl_Ch2
 SG_ EndStrng_01 : 704|8@1+ (1,0) [0|255] "per byte"  AuxiliaryValveControl_Ch2
 SG_ NumSW_IdField : 0|8@1+ (1,0) [0|250] "step"  AuxiliaryValveControl_Ch2

BO_ 2566838914 SOFT_82: 89 REHR_3
 SG_ Appl_Id : 8|8@1+ (1,0) [0|255] ""  AuxiliaryValveControl_Ch2
 SG_ Appl_Id_Byte_01 : 368|8@1+ (1,0) [0|255] ""  AuxiliaryValveControl_Ch2
 SG_ Appl_Id_Byte_02 : 376|8@1+ (1,0) [0|255] ""  AuxiliaryValveControl_Ch2
 SG_ Appl_Id_Byte_03 : 384|8@1+ (1,0) [0|255] ""  AuxiliaryValveControl_Ch2
 SG_ Appl_Id_Byte_04 : 392|8@1+ (1,0) [0|255] ""  AuxiliaryValveControl_Ch2
 SG_ Appl_Id_Byte_05 : 400|8@1+ (1,0) [0|255] ""  AuxiliaryValveControl_Ch2
 SG_ Appl_Id_Byte_06 : 408|8@1+ (1,0) [0|255] ""  AuxiliaryValveControl_Ch2
 SG_ Appl_Id_Byte_07 : 416|8@1+ (1,0) [0|255] ""  AuxiliaryValveControl_Ch2
 SG_ Appl_Id_Byte_08 : 424|8@1+ (1,0) [0|255] ""  AuxiliaryValveControl_Ch2
 SG_ Appl_Id_Byte_09 : 432|8@1+ (1,0) [0|255] ""  AuxiliaryValveControl_Ch2
 SG_ Appl_Id_Byte_10 : 440|8@1+ (1,0) [0|255] ""  AuxiliaryValveControl_Ch2
 SG_ Appl_Id_Byte_11 : 448|8@1+ (1,0) [0|255] ""  AuxiliaryValveControl_Ch2
 SG_ Appl_Id_Byte_12 : 456|8@1+ (1,0) [0|255] ""  AuxiliaryValveControl_Ch2
 SG_ Appl_Id_Byte_13 : 464|8@1+ (1,0) [0|255] ""  AuxiliaryValveControl_Ch2
 SG_ Appl_Id_Byte_14 : 472|8@1+ (1,0) [0|255] ""  AuxiliaryValveControl_Ch2
 SG_ Appl_Id_Byte_15 : 480|8@1+ (1,0) [0|255] ""  AuxiliaryValveControl_Ch2
 SG_ Appl_Id_Byte_16 : 488|8@1+ (1,0) [0|255] ""  AuxiliaryValveControl_Ch2
 SG_ Appl_Id_Byte_17 : 496|8@1+ (1,0) [0|255] ""  AuxiliaryValveControl_Ch2
 SG_ Appl_Id_Byte_18 : 504|8@1+ (1,0) [0|255] ""  AuxiliaryValveControl_Ch2
 SG_ Appl_Id_Byte_19 : 512|8@1+ (1,0) [0|255] ""  AuxiliaryValveControl_Ch2
 SG_ Appl_Id_Byte_20 : 520|8@1+ (1,0) [0|255] ""  AuxiliaryValveControl_Ch2
 SG_ Appl_Id_Byte_21 : 528|8@1+ (1,0) [0|255] ""  AuxiliaryValveControl_Ch2
 SG_ Appl_Id_Byte_22 : 536|8@1+ (1,0) [0|255] ""  AuxiliaryValveControl_Ch2
 SG_ Appl_Id_Byte_23 : 544|8@1+ (1,0) [0|255] ""  AuxiliaryValveControl_Ch2
 SG_ Appl_Id_Byte_24 : 552|8@1+ (1,0) [0|255] ""  AuxiliaryValveControl_Ch2
 SG_ Appl_Id_Byte_25 : 560|8@1+ (1,0) [0|255] ""  AuxiliaryValveControl_Ch2
 SG_ Appl_Id_Byte_26 : 568|8@1+ (1,0) [0|255] ""  AuxiliaryValveControl_Ch2
 SG_ Appl_Id_Byte_27 : 576|8@1+ (1,0) [0|255] ""  AuxiliaryValveControl_Ch2
 SG_ Appl_Id_Byte_28 : 584|8@1+ (1,0) [0|255] ""  AuxiliaryValveControl_Ch2
 SG_ Appl_Id_Byte_29 : 592|8@1+ (1,0) [0|255] ""  AuxiliaryValveControl_Ch2
 SG_ Appl_Id_Byte_30 : 600|8@1+ (1,0) [0|255] ""  AuxiliaryValveControl_Ch2
 SG_ Appl_Id_Byte_31 : 608|8@1+ (1,0) [0|255] ""  AuxiliaryValveControl_Ch2
 SG_ Appl_Id_Byte_32 : 616|8@1+ (1,0) [0|255] ""  AuxiliaryValveControl_Ch2
 SG_ Appl_Id_Byte_33 : 624|8@1+ (1,0) [0|255] ""  AuxiliaryValveControl_Ch2
 SG_ Appl_Id_Byte_34 : 632|8@1+ (1,0) [0|255] ""  AuxiliaryValveControl_Ch2
 SG_ Appl_Id_Byte_35 : 640|8@1+ (1,0) [0|255] ""  AuxiliaryValveControl_Ch2
 SG_ Appl_Id_Byte_36 : 648|8@1+ (1,0) [0|255] ""  AuxiliaryValveControl_Ch2
 SG_ Appl_Id_Byte_37 : 656|8@1+ (1,0) [0|255] ""  AuxiliaryValveControl_Ch2
 SG_ Appl_Id_Byte_38 : 664|8@1+ (1,0) [0|255] ""  AuxiliaryValveControl_Ch2
 SG_ Appl_Id_Byte_39 : 672|8@1+ (1,0) [0|255] ""  AuxiliaryValveControl_Ch2
 SG_ Appl_Id_Enum : 680|24@1+ (1,0) [0|16777215] ""  AuxiliaryValveControl_Ch2
 SG_ Bootloader_Id : 360|8@1+ (1,0) [0|255] ""  AuxiliaryValveControl_Ch2
 SG_ Bootloader_Id_Byte_01 : 16|8@1+ (1,0) [0|255] ""  AuxiliaryValveControl_Ch2
 SG_ Bootloader_Id_Byte_02 : 24|8@1+ (1,0) [0|255] ""  AuxiliaryValveControl_Ch2
 SG_ Bootloader_Id_Byte_03 : 32|8@1+ (1,0) [0|255] ""  AuxiliaryValveControl_Ch2
 SG_ Bootloader_Id_Byte_04 : 40|8@1+ (1,0) [0|255] ""  AuxiliaryValveControl_Ch2
 SG_ Bootloader_Id_Byte_05 : 48|8@1+ (1,0) [0|255] ""  AuxiliaryValveControl_Ch2
 SG_ Bootloader_Id_Byte_06 : 56|8@1+ (1,0) [0|255] ""  AuxiliaryValveControl_Ch2
 SG_ Bootloader_Id_Byte_07 : 64|8@1+ (1,0) [0|255] ""  AuxiliaryValveControl_Ch2
 SG_ Bootloader_Id_Byte_08 : 72|8@1+ (1,0) [0|255] ""  AuxiliaryValveControl_Ch2
 SG_ Bootloader_Id_Byte_09 : 80|8@1+ (1,0) [0|255] ""  AuxiliaryValveControl_Ch2
 SG_ Bootloader_Id_Byte_10 : 88|8@1+ (1,0) [0|255] ""  AuxiliaryValveControl_Ch2
 SG_ Bootloader_Id_Byte_11 : 96|8@1+ (1,0) [0|255] ""  AuxiliaryValveControl_Ch2
 SG_ Bootloader_Id_Byte_12 : 104|8@1+ (1,0) [0|255] ""  AuxiliaryValveControl_Ch2
 SG_ Bootloader_Id_Byte_13 : 112|8@1+ (1,0) [0|255] ""  AuxiliaryValveControl_Ch2
 SG_ Bootloader_Id_Byte_14 : 120|8@1+ (1,0) [0|255] ""  AuxiliaryValveControl_Ch2
 SG_ Bootloader_Id_Byte_15 : 128|8@1+ (1,0) [0|255] ""  AuxiliaryValveControl_Ch2
 SG_ Bootloader_Id_Byte_16 : 136|8@1+ (1,0) [0|255] ""  AuxiliaryValveControl_Ch2
 SG_ Bootloader_Id_Byte_17 : 144|8@1+ (1,0) [0|255] ""  AuxiliaryValveControl_Ch2
 SG_ Bootloader_Id_Byte_18 : 152|8@1+ (1,0) [0|255] ""  AuxiliaryValveControl_Ch2
 SG_ Bootloader_Id_Byte_19 : 160|8@1+ (1,0) [0|255] ""  AuxiliaryValveControl_Ch2
 SG_ Bootloader_Id_Byte_20 : 168|8@1+ (1,0) [0|255] ""  AuxiliaryValveControl_Ch2
 SG_ Bootloader_Id_Byte_21 : 176|8@1+ (1,0) [0|255] ""  AuxiliaryValveControl_Ch2
 SG_ Bootloader_Id_Byte_22 : 184|8@1+ (1,0) [0|255] ""  AuxiliaryValveControl_Ch2
 SG_ Bootloader_Id_Byte_23 : 192|8@1+ (1,0) [0|255] ""  AuxiliaryValveControl_Ch2
 SG_ Bootloader_Id_Byte_24 : 200|8@1+ (1,0) [0|255] ""  AuxiliaryValveControl_Ch2
 SG_ Bootloader_Id_Byte_25 : 208|8@1+ (1,0) [0|255] ""  AuxiliaryValveControl_Ch2
 SG_ Bootloader_Id_Byte_26 : 216|8@1+ (1,0) [0|255] ""  AuxiliaryValveControl_Ch2
 SG_ Bootloader_Id_Byte_27 : 224|8@1+ (1,0) [0|255] ""  AuxiliaryValveControl_Ch2
 SG_ Bootloader_Id_Byte_28 : 232|8@1+ (1,0) [0|255] ""  AuxiliaryValveControl_Ch2
 SG_ Bootloader_Id_Byte_29 : 240|8@1+ (1,0) [0|255] ""  AuxiliaryValveControl_Ch2
 SG_ Bootloader_Id_Byte_30 : 248|8@1+ (1,0) [0|255] ""  AuxiliaryValveControl_Ch2
 SG_ Bootloader_Id_Byte_31 : 256|8@1+ (1,0) [0|255] ""  AuxiliaryValveControl_Ch2
 SG_ Bootloader_Id_Byte_32 : 264|8@1+ (1,0) [0|255] ""  AuxiliaryValveControl_Ch2
 SG_ Bootloader_Id_Byte_33 : 272|8@1+ (1,0) [0|255] ""  AuxiliaryValveControl_Ch2
 SG_ Bootloader_Id_Byte_34 : 280|8@1+ (1,0) [0|255] ""  AuxiliaryValveControl_Ch2
 SG_ Bootloader_Id_Byte_35 : 288|8@1+ (1,0) [0|255] ""  AuxiliaryValveControl_Ch2
 SG_ Bootloader_Id_Byte_36 : 296|8@1+ (1,0) [0|255] ""  AuxiliaryValveControl_Ch2
 SG_ Bootloader_Id_Byte_37 : 304|8@1+ (1,0) [0|255] ""  AuxiliaryValveControl_Ch2
 SG_ Bootloader_Id_Byte_38 : 312|8@1+ (1,0) [0|255] ""  AuxiliaryValveControl_Ch2
 SG_ Bootloader_Id_Byte_39 : 320|8@1+ (1,0) [0|255] ""  AuxiliaryValveControl_Ch2
 SG_ Bootloader_Id_Enum : 328|24@1+ (1,0) [0|16777215] ""  AuxiliaryValveControl_Ch2
 SG_ EndStrng_00 : 352|8@1+ (1,0) [0|255] "per byte"  AuxiliaryValveControl_Ch2
 SG_ EndStrng_01 : 704|8@1+ (1,0) [0|255] "per byte"  AuxiliaryValveControl_Ch2
 SG_ NumSW_IdField : 0|8@1+ (1,0) [0|250] "step"  AuxiliaryValveControl_Ch2

BO_ 2566838915 SOFT_83: 89 REHR_4
 SG_ Bootloader_Id_Byte_08 : 72|8@1+ (1,0) [0|255] ""  AuxiliaryValveControl_Ch2
 SG_ Bootloader_Id_Byte_09 : 80|8@1+ (1,0) [0|255] ""  AuxiliaryValveControl_Ch2
 SG_ Bootloader_Id_Byte_10 : 88|8@1+ (1,0) [0|255] ""  AuxiliaryValveControl_Ch2
 SG_ Bootloader_Id_Byte_11 : 96|8@1+ (1,0) [0|255] ""  AuxiliaryValveControl_Ch2
 SG_ Bootloader_Id_Byte_12 : 104|8@1+ (1,0) [0|255] ""  AuxiliaryValveControl_Ch2
 SG_ Bootloader_Id_Byte_13 : 112|8@1+ (1,0) [0|255] ""  AuxiliaryValveControl_Ch2
 SG_ Bootloader_Id_Byte_14 : 120|8@1+ (1,0) [0|255] ""  AuxiliaryValveControl_Ch2
 SG_ Bootloader_Id_Byte_15 : 128|8@1+ (1,0) [0|255] ""  AuxiliaryValveControl_Ch2
 SG_ Bootloader_Id_Byte_16 : 136|8@1+ (1,0) [0|255] ""  AuxiliaryValveControl_Ch2
 SG_ Bootloader_Id_Byte_17 : 144|8@1+ (1,0) [0|255] ""  AuxiliaryValveControl_Ch2
 SG_ Bootloader_Id_Byte_18 : 152|8@1+ (1,0) [0|255] ""  AuxiliaryValveControl_Ch2
 SG_ Bootloader_Id_Byte_19 : 160|8@1+ (1,0) [0|255] ""  AuxiliaryValveControl_Ch2
 SG_ Bootloader_Id_Byte_20 : 168|8@1+ (1,0) [0|255] ""  AuxiliaryValveControl_Ch2
 SG_ Bootloader_Id_Byte_21 : 176|8@1+ (1,0) [0|255] ""  AuxiliaryValveControl_Ch2
 SG_ Bootloader_Id_Byte_22 : 184|8@1+ (1,0) [0|255] ""  AuxiliaryValveControl_Ch2
 SG_ Bootloader_Id_Byte_23 : 192|8@1+ (1,0) [0|255] ""  AuxiliaryValveControl_Ch2
 SG_ Bootloader_Id_Byte_24 : 200|8@1+ (1,0) [0|255] ""  AuxiliaryValveControl_Ch2
 SG_ Bootloader_Id_Byte_25 : 208|8@1+ (1,0) [0|255] ""  AuxiliaryValveControl_Ch2
 SG_ Bootloader_Id_Byte_26 : 216|8@1+ (1,0) [0|255] ""  AuxiliaryValveControl_Ch2
 SG_ Bootloader_Id_Byte_27 : 224|8@1+ (1,0) [0|255] ""  AuxiliaryValveControl_Ch2
 SG_ Bootloader_Id_Byte_28 : 232|8@1+ (1,0) [0|255] ""  AuxiliaryValveControl_Ch2
 SG_ Bootloader_Id_Byte_29 : 240|8@1+ (1,0) [0|255] ""  AuxiliaryValveControl_Ch2
 SG_ Bootloader_Id_Byte_30 : 248|8@1+ (1,0) [0|255] ""  AuxiliaryValveControl_Ch2
 SG_ Bootloader_Id_Byte_31 : 256|8@1+ (1,0) [0|255] ""  AuxiliaryValveControl_Ch2
 SG_ Bootloader_Id_Byte_32 : 264|8@1+ (1,0) [0|255] ""  AuxiliaryValveControl_Ch2
 SG_ Bootloader_Id_Byte_33 : 272|8@1+ (1,0) [0|255] ""  AuxiliaryValveControl_Ch2
 SG_ Bootloader_Id_Byte_34 : 280|8@1+ (1,0) [0|255] ""  AuxiliaryValveControl_Ch2
 SG_ Bootloader_Id_Byte_35 : 288|8@1+ (1,0) [0|255] ""  AuxiliaryValveControl_Ch2
 SG_ Bootloader_Id_Byte_36 : 296|8@1+ (1,0) [0|255] ""  AuxiliaryValveControl_Ch2
 SG_ Bootloader_Id_Byte_37 : 304|8@1+ (1,0) [0|255] ""  AuxiliaryValveControl_Ch2
 SG_ Bootloader_Id_Byte_38 : 312|8@1+ (1,0) [0|255] ""  AuxiliaryValveControl_Ch2
 SG_ Bootloader_Id_Byte_39 : 320|8@1+ (1,0) [0|255] ""  AuxiliaryValveControl_Ch2
 SG_ Bootloader_Id_Enum : 328|24@1+ (1,0) [0|16777215] ""  AuxiliaryValveControl_Ch2
 SG_ EndStrng_00 : 352|8@1+ (1,0) [0|255] "per byte"  AuxiliaryValveControl_Ch2
 SG_ EndStrng_01 : 704|8@1+ (1,0) [0|255] "per byte"  AuxiliaryValveControl_Ch2
 SG_ NumSW_IdField : 0|8@1+ (1,0) [0|250] "step"  AuxiliaryValveControl_Ch2
 SG_ Appl_Id : 8|8@1+ (1,0) [0|255] ""  AuxiliaryValveControl_Ch2
 SG_ Appl_Id_Byte_01 : 368|8@1+ (1,0) [0|255] ""  AuxiliaryValveControl_Ch2
 SG_ Appl_Id_Byte_02 : 376|8@1+ (1,0) [0|255] ""  AuxiliaryValveControl_Ch2
 SG_ Appl_Id_Byte_03 : 384|8@1+ (1,0) [0|255] ""  AuxiliaryValveControl_Ch2
 SG_ Appl_Id_Byte_04 : 392|8@1+ (1,0) [0|255] ""  AuxiliaryValveControl_Ch2
 SG_ Appl_Id_Byte_05 : 400|8@1+ (1,0) [0|255] ""  AuxiliaryValveControl_Ch2
 SG_ Appl_Id_Byte_06 : 408|8@1+ (1,0) [0|255] ""  AuxiliaryValveControl_Ch2
 SG_ Appl_Id_Byte_07 : 416|8@1+ (1,0) [0|255] ""  AuxiliaryValveControl_Ch2
 SG_ Appl_Id_Byte_08 : 424|8@1+ (1,0) [0|255] ""  AuxiliaryValveControl_Ch2
 SG_ Appl_Id_Byte_09 : 432|8@1+ (1,0) [0|255] ""  AuxiliaryValveControl_Ch2
 SG_ Appl_Id_Byte_10 : 440|8@1+ (1,0) [0|255] ""  AuxiliaryValveControl_Ch2
 SG_ Appl_Id_Byte_11 : 448|8@1+ (1,0) [0|255] ""  AuxiliaryValveControl_Ch2
 SG_ Appl_Id_Byte_12 : 456|8@1+ (1,0) [0|255] ""  AuxiliaryValveControl_Ch2
 SG_ Appl_Id_Byte_13 : 464|8@1+ (1,0) [0|255] ""  AuxiliaryValveControl_Ch2
 SG_ Appl_Id_Byte_14 : 472|8@1+ (1,0) [0|255] ""  AuxiliaryValveControl_Ch2
 SG_ Appl_Id_Byte_15 : 480|8@1+ (1,0) [0|255] ""  AuxiliaryValveControl_Ch2
 SG_ Appl_Id_Byte_16 : 488|8@1+ (1,0) [0|255] ""  AuxiliaryValveControl_Ch2
 SG_ Appl_Id_Byte_17 : 496|8@1+ (1,0) [0|255] ""  AuxiliaryValveControl_Ch2
 SG_ Appl_Id_Byte_18 : 504|8@1+ (1,0) [0|255] ""  AuxiliaryValveControl_Ch2
 SG_ Appl_Id_Byte_19 : 512|8@1+ (1,0) [0|255] ""  AuxiliaryValveControl_Ch2
 SG_ Appl_Id_Byte_20 : 520|8@1+ (1,0) [0|255] ""  AuxiliaryValveControl_Ch2
 SG_ Appl_Id_Byte_21 : 528|8@1+ (1,0) [0|255] ""  AuxiliaryValveControl_Ch2
 SG_ Appl_Id_Byte_22 : 536|8@1+ (1,0) [0|255] ""  AuxiliaryValveControl_Ch2
 SG_ Appl_Id_Byte_23 : 544|8@1+ (1,0) [0|255] ""  AuxiliaryValveControl_Ch2
 SG_ Appl_Id_Byte_24 : 552|8@1+ (1,0) [0|255] ""  AuxiliaryValveControl_Ch2
 SG_ Appl_Id_Byte_25 : 560|8@1+ (1,0) [0|255] ""  AuxiliaryValveControl_Ch2
 SG_ Appl_Id_Byte_26 : 568|8@1+ (1,0) [0|255] ""  AuxiliaryValveControl_Ch2
 SG_ Appl_Id_Byte_27 : 576|8@1+ (1,0) [0|255] ""  AuxiliaryValveControl_Ch2
 SG_ Appl_Id_Byte_28 : 584|8@1+ (1,0) [0|255] ""  AuxiliaryValveControl_Ch2
 SG_ Appl_Id_Byte_29 : 592|8@1+ (1,0) [0|255] ""  AuxiliaryValveControl_Ch2
 SG_ Appl_Id_Byte_30 : 600|8@1+ (1,0) [0|255] ""  AuxiliaryValveControl_Ch2
 SG_ Appl_Id_Byte_31 : 608|8@1+ (1,0) [0|255] ""  AuxiliaryValveControl_Ch2
 SG_ Appl_Id_Byte_32 : 616|8@1+ (1,0) [0|255] ""  AuxiliaryValveControl_Ch2
 SG_ Appl_Id_Byte_33 : 624|8@1+ (1,0) [0|255] ""  AuxiliaryValveControl_Ch2
 SG_ Appl_Id_Byte_34 : 632|8@1+ (1,0) [0|255] ""  AuxiliaryValveControl_Ch2
 SG_ Appl_Id_Byte_35 : 640|8@1+ (1,0) [0|255] ""  AuxiliaryValveControl_Ch2
 SG_ Appl_Id_Byte_36 : 648|8@1+ (1,0) [0|255] ""  AuxiliaryValveControl_Ch2
 SG_ Appl_Id_Byte_37 : 656|8@1+ (1,0) [0|255] ""  AuxiliaryValveControl_Ch2
 SG_ Appl_Id_Byte_38 : 664|8@1+ (1,0) [0|255] ""  AuxiliaryValveControl_Ch2
 SG_ Appl_Id_Byte_39 : 672|8@1+ (1,0) [0|255] ""  AuxiliaryValveControl_Ch2
 SG_ Appl_Id_Enum : 680|24@1+ (1,0) [0|16777215] ""  AuxiliaryValveControl_Ch2
 SG_ Bootloader_Id : 360|8@1+ (1,0) [0|255] ""  AuxiliaryValveControl_Ch2
 SG_ Bootloader_Id_Byte_01 : 16|8@1+ (1,0) [0|255] ""  AuxiliaryValveControl_Ch2
 SG_ Bootloader_Id_Byte_02 : 24|8@1+ (1,0) [0|255] ""  AuxiliaryValveControl_Ch2
 SG_ Bootloader_Id_Byte_03 : 32|8@1+ (1,0) [0|255] ""  AuxiliaryValveControl_Ch2
 SG_ Bootloader_Id_Byte_04 : 40|8@1+ (1,0) [0|255] ""  AuxiliaryValveControl_Ch2
 SG_ Bootloader_Id_Byte_05 : 48|8@1+ (1,0) [0|255] ""  AuxiliaryValveControl_Ch2
 SG_ Bootloader_Id_Byte_06 : 56|8@1+ (1,0) [0|255] ""  AuxiliaryValveControl_Ch2
 SG_ Bootloader_Id_Byte_07 : 64|8@1+ (1,0) [0|255] ""  AuxiliaryValveControl_Ch2

BO_ 2566838916 SOFT_84: 89 REHR_5
 SG_ Appl_Id : 8|8@1+ (1,0) [0|255] ""  AuxiliaryValveControl_Ch2
 SG_ Appl_Id_Byte_01 : 368|8@1+ (1,0) [0|255] ""  AuxiliaryValveControl_Ch2
 SG_ Appl_Id_Byte_02 : 376|8@1+ (1,0) [0|255] ""  AuxiliaryValveControl_Ch2
 SG_ Appl_Id_Byte_03 : 384|8@1+ (1,0) [0|255] ""  AuxiliaryValveControl_Ch2
 SG_ Appl_Id_Byte_04 : 392|8@1+ (1,0) [0|255] ""  AuxiliaryValveControl_Ch2
 SG_ Appl_Id_Byte_05 : 400|8@1+ (1,0) [0|255] ""  AuxiliaryValveControl_Ch2
 SG_ Appl_Id_Byte_06 : 408|8@1+ (1,0) [0|255] ""  AuxiliaryValveControl_Ch2
 SG_ Appl_Id_Byte_07 : 416|8@1+ (1,0) [0|255] ""  AuxiliaryValveControl_Ch2
 SG_ Appl_Id_Byte_08 : 424|8@1+ (1,0) [0|255] ""  AuxiliaryValveControl_Ch2
 SG_ Appl_Id_Byte_09 : 432|8@1+ (1,0) [0|255] ""  AuxiliaryValveControl_Ch2
 SG_ Appl_Id_Byte_10 : 440|8@1+ (1,0) [0|255] ""  AuxiliaryValveControl_Ch2
 SG_ Appl_Id_Byte_11 : 448|8@1+ (1,0) [0|255] ""  AuxiliaryValveControl_Ch2
 SG_ Appl_Id_Byte_12 : 456|8@1+ (1,0) [0|255] ""  AuxiliaryValveControl_Ch2
 SG_ Appl_Id_Byte_13 : 464|8@1+ (1,0) [0|255] ""  AuxiliaryValveControl_Ch2
 SG_ Appl_Id_Byte_14 : 472|8@1+ (1,0) [0|255] ""  AuxiliaryValveControl_Ch2
 SG_ Appl_Id_Byte_15 : 480|8@1+ (1,0) [0|255] ""  AuxiliaryValveControl_Ch2
 SG_ Appl_Id_Byte_16 : 488|8@1+ (1,0) [0|255] ""  AuxiliaryValveControl_Ch2
 SG_ Appl_Id_Byte_17 : 496|8@1+ (1,0) [0|255] ""  AuxiliaryValveControl_Ch2
 SG_ Appl_Id_Byte_18 : 504|8@1+ (1,0) [0|255] ""  AuxiliaryValveControl_Ch2
 SG_ Appl_Id_Byte_19 : 512|8@1+ (1,0) [0|255] ""  AuxiliaryValveControl_Ch2
 SG_ Appl_Id_Byte_20 : 520|8@1+ (1,0) [0|255] ""  AuxiliaryValveControl_Ch2
 SG_ Appl_Id_Byte_21 : 528|8@1+ (1,0) [0|255] ""  AuxiliaryValveControl_Ch2
 SG_ Appl_Id_Byte_22 : 536|8@1+ (1,0) [0|255] ""  AuxiliaryValveControl_Ch2
 SG_ Appl_Id_Byte_23 : 544|8@1+ (1,0) [0|255] ""  AuxiliaryValveControl_Ch2
 SG_ Appl_Id_Byte_24 : 552|8@1+ (1,0) [0|255] ""  AuxiliaryValveControl_Ch2
 SG_ Appl_Id_Byte_25 : 560|8@1+ (1,0) [0|255] ""  AuxiliaryValveControl_Ch2
 SG_ Appl_Id_Byte_26 : 568|8@1+ (1,0) [0|255] ""  AuxiliaryValveControl_Ch2
 SG_ Appl_Id_Byte_27 : 576|8@1+ (1,0) [0|255] ""  AuxiliaryValveControl_Ch2
 SG_ Appl_Id_Byte_28 : 584|8@1+ (1,0) [0|255] ""  AuxiliaryValveControl_Ch2
 SG_ Appl_Id_Byte_29 : 592|8@1+ (1,0) [0|255] ""  AuxiliaryValveControl_Ch2
 SG_ Appl_Id_Byte_30 : 600|8@1+ (1,0) [0|255] ""  AuxiliaryValveControl_Ch2
 SG_ Appl_Id_Byte_31 : 608|8@1+ (1,0) [0|255] ""  AuxiliaryValveControl_Ch2
 SG_ Appl_Id_Byte_32 : 616|8@1+ (1,0) [0|255] ""  AuxiliaryValveControl_Ch2
 SG_ Appl_Id_Byte_33 : 624|8@1+ (1,0) [0|255] ""  AuxiliaryValveControl_Ch2
 SG_ Appl_Id_Byte_34 : 632|8@1+ (1,0) [0|255] ""  AuxiliaryValveControl_Ch2
 SG_ Appl_Id_Byte_35 : 640|8@1+ (1,0) [0|255] ""  AuxiliaryValveControl_Ch2
 SG_ Appl_Id_Byte_36 : 648|8@1+ (1,0) [0|255] ""  AuxiliaryValveControl_Ch2
 SG_ Appl_Id_Byte_37 : 656|8@1+ (1,0) [0|255] ""  AuxiliaryValveControl_Ch2
 SG_ Appl_Id_Byte_38 : 664|8@1+ (1,0) [0|255] ""  AuxiliaryValveControl_Ch2
 SG_ Appl_Id_Byte_39 : 672|8@1+ (1,0) [0|255] ""  AuxiliaryValveControl_Ch2
 SG_ Appl_Id_Enum : 680|24@1+ (1,0) [0|16777215] ""  AuxiliaryValveControl_Ch2
 SG_ Bootloader_Id : 360|8@1+ (1,0) [0|255] ""  AuxiliaryValveControl_Ch2
 SG_ Bootloader_Id_Byte_01 : 16|8@1+ (1,0) [0|255] ""  AuxiliaryValveControl_Ch2
 SG_ Bootloader_Id_Byte_02 : 24|8@1+ (1,0) [0|255] ""  AuxiliaryValveControl_Ch2
 SG_ Bootloader_Id_Byte_03 : 32|8@1+ (1,0) [0|255] ""  AuxiliaryValveControl_Ch2
 SG_ Bootloader_Id_Byte_04 : 40|8@1+ (1,0) [0|255] ""  AuxiliaryValveControl_Ch2
 SG_ Bootloader_Id_Byte_05 : 48|8@1+ (1,0) [0|255] ""  AuxiliaryValveControl_Ch2
 SG_ Bootloader_Id_Byte_06 : 56|8@1+ (1,0) [0|255] ""  AuxiliaryValveControl_Ch2
 SG_ Bootloader_Id_Byte_07 : 64|8@1+ (1,0) [0|255] ""  AuxiliaryValveControl_Ch2
 SG_ Bootloader_Id_Byte_08 : 72|8@1+ (1,0) [0|255] ""  AuxiliaryValveControl_Ch2
 SG_ Bootloader_Id_Byte_09 : 80|8@1+ (1,0) [0|255] ""  AuxiliaryValveControl_Ch2
 SG_ Bootloader_Id_Byte_10 : 88|8@1+ (1,0) [0|255] ""  AuxiliaryValveControl_Ch2
 SG_ Bootloader_Id_Byte_11 : 96|8@1+ (1,0) [0|255] ""  AuxiliaryValveControl_Ch2
 SG_ Bootloader_Id_Byte_12 : 104|8@1+ (1,0) [0|255] ""  AuxiliaryValveControl_Ch2
 SG_ Bootloader_Id_Byte_13 : 112|8@1+ (1,0) [0|255] ""  AuxiliaryValveControl_Ch2
 SG_ Bootloader_Id_Byte_14 : 120|8@1+ (1,0) [0|255] ""  AuxiliaryValveControl_Ch2
 SG_ Bootloader_Id_Byte_15 : 128|8@1+ (1,0) [0|255] ""  AuxiliaryValveControl_Ch2
 SG_ Bootloader_Id_Byte_16 : 136|8@1+ (1,0) [0|255] ""  AuxiliaryValveControl_Ch2
 SG_ Bootloader_Id_Byte_17 : 144|8@1+ (1,0) [0|255] ""  AuxiliaryValveControl_Ch2
 SG_ Bootloader_Id_Byte_18 : 152|8@1+ (1,0) [0|255] ""  AuxiliaryValveControl_Ch2
 SG_ Bootloader_Id_Byte_19 : 160|8@1+ (1,0) [0|255] ""  AuxiliaryValveControl_Ch2
 SG_ Bootloader_Id_Byte_20 : 168|8@1+ (1,0) [0|255] ""  AuxiliaryValveControl_Ch2
 SG_ Bootloader_Id_Byte_21 : 176|8@1+ (1,0) [0|255] ""  AuxiliaryValveControl_Ch2
 SG_ Bootloader_Id_Byte_22 : 184|8@1+ (1,0) [0|255] ""  AuxiliaryValveControl_Ch2
 SG_ Bootloader_Id_Byte_23 : 192|8@1+ (1,0) [0|255] ""  AuxiliaryValveControl_Ch2
 SG_ Bootloader_Id_Byte_24 : 200|8@1+ (1,0) [0|255] ""  AuxiliaryValveControl_Ch2
 SG_ Bootloader_Id_Byte_25 : 208|8@1+ (1,0) [0|255] ""  AuxiliaryValveControl_Ch2
 SG_ Bootloader_Id_Byte_26 : 216|8@1+ (1,0) [0|255] ""  AuxiliaryValveControl_Ch2
 SG_ Bootloader_Id_Byte_27 : 224|8@1+ (1,0) [0|255] ""  AuxiliaryValveControl_Ch2
 SG_ Bootloader_Id_Byte_28 : 232|8@1+ (1,0) [0|255] ""  AuxiliaryValveControl_Ch2
 SG_ Bootloader_Id_Byte_29 : 240|8@1+ (1,0) [0|255] ""  AuxiliaryValveControl_Ch2
 SG_ Bootloader_Id_Byte_30 : 248|8@1+ (1,0) [0|255] ""  AuxiliaryValveControl_Ch2
 SG_ Bootloader_Id_Byte_31 : 256|8@1+ (1,0) [0|255] ""  AuxiliaryValveControl_Ch2
 SG_ Bootloader_Id_Byte_32 : 264|8@1+ (1,0) [0|255] ""  AuxiliaryValveControl_Ch2
 SG_ Bootloader_Id_Byte_33 : 272|8@1+ (1,0) [0|255] ""  AuxiliaryValveControl_Ch2
 SG_ Bootloader_Id_Byte_34 : 280|8@1+ (1,0) [0|255] ""  AuxiliaryValveControl_Ch2
 SG_ Bootloader_Id_Byte_35 : 288|8@1+ (1,0) [0|255] ""  AuxiliaryValveControl_Ch2
 SG_ Bootloader_Id_Byte_36 : 296|8@1+ (1,0) [0|255] ""  AuxiliaryValveControl_Ch2
 SG_ Bootloader_Id_Byte_37 : 304|8@1+ (1,0) [0|255] ""  AuxiliaryValveControl_Ch2
 SG_ Bootloader_Id_Byte_38 : 312|8@1+ (1,0) [0|255] ""  AuxiliaryValveControl_Ch2
 SG_ Bootloader_Id_Byte_39 : 320|8@1+ (1,0) [0|255] ""  AuxiliaryValveControl_Ch2
 SG_ Bootloader_Id_Enum : 328|24@1+ (1,0) [0|16777215] ""  AuxiliaryValveControl_Ch2
 SG_ EndStrng_00 : 352|8@1+ (1,0) [0|255] "per byte"  AuxiliaryValveControl_Ch2
 SG_ EndStrng_01 : 704|8@1+ (1,0) [0|255] "per byte"  AuxiliaryValveControl_Ch2
 SG_ NumSW_IdField : 0|8@1+ (1,0) [0|250] "step"  AuxiliaryValveControl_Ch2

BO_ 2566838921 SOFT_89: 89 FEHR_1
 SG_ Bootloader_Id_Byte_06 : 56|8@1+ (1,0) [0|255] ""  AuxiliaryValveControl_Ch2
 SG_ Bootloader_Id_Byte_07 : 64|8@1+ (1,0) [0|255] ""  AuxiliaryValveControl_Ch2
 SG_ Bootloader_Id_Byte_08 : 72|8@1+ (1,0) [0|255] ""  AuxiliaryValveControl_Ch2
 SG_ Bootloader_Id_Byte_09 : 80|8@1+ (1,0) [0|255] ""  AuxiliaryValveControl_Ch2
 SG_ Bootloader_Id_Byte_10 : 88|8@1+ (1,0) [0|255] ""  AuxiliaryValveControl_Ch2
 SG_ Bootloader_Id_Byte_11 : 96|8@1+ (1,0) [0|255] ""  AuxiliaryValveControl_Ch2
 SG_ Bootloader_Id_Byte_12 : 104|8@1+ (1,0) [0|255] ""  AuxiliaryValveControl_Ch2
 SG_ Bootloader_Id_Byte_13 : 112|8@1+ (1,0) [0|255] ""  AuxiliaryValveControl_Ch2
 SG_ Bootloader_Id_Byte_14 : 120|8@1+ (1,0) [0|255] ""  AuxiliaryValveControl_Ch2
 SG_ Bootloader_Id_Byte_15 : 128|8@1+ (1,0) [0|255] ""  AuxiliaryValveControl_Ch2
 SG_ Bootloader_Id_Byte_16 : 136|8@1+ (1,0) [0|255] ""  AuxiliaryValveControl_Ch2
 SG_ Bootloader_Id_Byte_17 : 144|8@1+ (1,0) [0|255] ""  AuxiliaryValveControl_Ch2
 SG_ Bootloader_Id_Byte_18 : 152|8@1+ (1,0) [0|255] ""  AuxiliaryValveControl_Ch2
 SG_ Bootloader_Id_Byte_19 : 160|8@1+ (1,0) [0|255] ""  AuxiliaryValveControl_Ch2
 SG_ Bootloader_Id_Byte_20 : 168|8@1+ (1,0) [0|255] ""  AuxiliaryValveControl_Ch2
 SG_ Bootloader_Id_Byte_21 : 176|8@1+ (1,0) [0|255] ""  AuxiliaryValveControl_Ch2
 SG_ Bootloader_Id_Byte_22 : 184|8@1+ (1,0) [0|255] ""  AuxiliaryValveControl_Ch2
 SG_ Bootloader_Id_Byte_23 : 192|8@1+ (1,0) [0|255] ""  AuxiliaryValveControl_Ch2
 SG_ Bootloader_Id_Byte_24 : 200|8@1+ (1,0) [0|255] ""  AuxiliaryValveControl_Ch2
 SG_ Bootloader_Id_Byte_25 : 208|8@1+ (1,0) [0|255] ""  AuxiliaryValveControl_Ch2
 SG_ Bootloader_Id_Byte_26 : 216|8@1+ (1,0) [0|255] ""  AuxiliaryValveControl_Ch2
 SG_ Bootloader_Id_Byte_27 : 224|8@1+ (1,0) [0|255] ""  AuxiliaryValveControl_Ch2
 SG_ Bootloader_Id_Byte_28 : 232|8@1+ (1,0) [0|255] ""  AuxiliaryValveControl_Ch2
 SG_ Bootloader_Id_Byte_29 : 240|8@1+ (1,0) [0|255] ""  AuxiliaryValveControl_Ch2
 SG_ Bootloader_Id_Byte_30 : 248|8@1+ (1,0) [0|255] ""  AuxiliaryValveControl_Ch2
 SG_ Bootloader_Id_Byte_31 : 256|8@1+ (1,0) [0|255] ""  AuxiliaryValveControl_Ch2
 SG_ Bootloader_Id_Byte_32 : 264|8@1+ (1,0) [0|255] ""  AuxiliaryValveControl_Ch2
 SG_ Bootloader_Id_Byte_33 : 272|8@1+ (1,0) [0|255] ""  AuxiliaryValveControl_Ch2
 SG_ Bootloader_Id_Byte_34 : 280|8@1+ (1,0) [0|255] ""  AuxiliaryValveControl_Ch2
 SG_ Bootloader_Id_Byte_35 : 288|8@1+ (1,0) [0|255] ""  AuxiliaryValveControl_Ch2
 SG_ Bootloader_Id_Byte_36 : 296|8@1+ (1,0) [0|255] ""  AuxiliaryValveControl_Ch2
 SG_ Bootloader_Id_Byte_37 : 304|8@1+ (1,0) [0|255] ""  AuxiliaryValveControl_Ch2
 SG_ Bootloader_Id_Byte_38 : 312|8@1+ (1,0) [0|255] ""  AuxiliaryValveControl_Ch2
 SG_ Bootloader_Id_Byte_39 : 320|8@1+ (1,0) [0|255] ""  AuxiliaryValveControl_Ch2
 SG_ Bootloader_Id_Enum : 328|24@1+ (1,0) [0|16777215] ""  AuxiliaryValveControl_Ch2
 SG_ EndStrng_00 : 352|8@1+ (1,0) [0|255] "per byte"  AuxiliaryValveControl_Ch2
 SG_ EndStrng_01 : 704|8@1+ (1,0) [0|255] "per byte"  AuxiliaryValveControl_Ch2
 SG_ NumSW_IdField : 0|8@1+ (1,0) [0|250] "step"  AuxiliaryValveControl_Ch2
 SG_ Appl_Id : 8|8@1+ (1,0) [0|255] ""  AuxiliaryValveControl_Ch2
 SG_ Appl_Id_Byte_01 : 368|8@1+ (1,0) [0|255] ""  AuxiliaryValveControl_Ch2
 SG_ Appl_Id_Byte_02 : 376|8@1+ (1,0) [0|255] ""  AuxiliaryValveControl_Ch2
 SG_ Appl_Id_Byte_03 : 384|8@1+ (1,0) [0|255] ""  AuxiliaryValveControl_Ch2
 SG_ Appl_Id_Byte_04 : 392|8@1+ (1,0) [0|255] ""  AuxiliaryValveControl_Ch2
 SG_ Appl_Id_Byte_05 : 400|8@1+ (1,0) [0|255] ""  AuxiliaryValveControl_Ch2
 SG_ Appl_Id_Byte_06 : 408|8@1+ (1,0) [0|255] ""  AuxiliaryValveControl_Ch2
 SG_ Appl_Id_Byte_07 : 416|8@1+ (1,0) [0|255] ""  AuxiliaryValveControl_Ch2
 SG_ Appl_Id_Byte_08 : 424|8@1+ (1,0) [0|255] ""  AuxiliaryValveControl_Ch2
 SG_ Appl_Id_Byte_09 : 432|8@1+ (1,0) [0|255] ""  AuxiliaryValveControl_Ch2
 SG_ Appl_Id_Byte_10 : 440|8@1+ (1,0) [0|255] ""  AuxiliaryValveControl_Ch2
 SG_ Appl_Id_Byte_11 : 448|8@1+ (1,0) [0|255] ""  AuxiliaryValveControl_Ch2
 SG_ Appl_Id_Byte_12 : 456|8@1+ (1,0) [0|255] ""  AuxiliaryValveControl_Ch2
 SG_ Appl_Id_Byte_13 : 464|8@1+ (1,0) [0|255] ""  AuxiliaryValveControl_Ch2
 SG_ Appl_Id_Byte_14 : 472|8@1+ (1,0) [0|255] ""  AuxiliaryValveControl_Ch2
 SG_ Appl_Id_Byte_15 : 480|8@1+ (1,0) [0|255] ""  AuxiliaryValveControl_Ch2
 SG_ Appl_Id_Byte_16 : 488|8@1+ (1,0) [0|255] ""  AuxiliaryValveControl_Ch2
 SG_ Appl_Id_Byte_17 : 496|8@1+ (1,0) [0|255] ""  AuxiliaryValveControl_Ch2
 SG_ Appl_Id_Byte_18 : 504|8@1+ (1,0) [0|255] ""  AuxiliaryValveControl_Ch2
 SG_ Appl_Id_Byte_19 : 512|8@1+ (1,0) [0|255] ""  AuxiliaryValveControl_Ch2
 SG_ Appl_Id_Byte_20 : 520|8@1+ (1,0) [0|255] ""  AuxiliaryValveControl_Ch2
 SG_ Appl_Id_Byte_21 : 528|8@1+ (1,0) [0|255] ""  AuxiliaryValveControl_Ch2
 SG_ Appl_Id_Byte_22 : 536|8@1+ (1,0) [0|255] ""  AuxiliaryValveControl_Ch2
 SG_ Appl_Id_Byte_23 : 544|8@1+ (1,0) [0|255] ""  AuxiliaryValveControl_Ch2
 SG_ Appl_Id_Byte_24 : 552|8@1+ (1,0) [0|255] ""  AuxiliaryValveControl_Ch2
 SG_ Appl_Id_Byte_25 : 560|8@1+ (1,0) [0|255] ""  AuxiliaryValveControl_Ch2
 SG_ Appl_Id_Byte_26 : 568|8@1+ (1,0) [0|255] ""  AuxiliaryValveControl_Ch2
 SG_ Appl_Id_Byte_27 : 576|8@1+ (1,0) [0|255] ""  AuxiliaryValveControl_Ch2
 SG_ Appl_Id_Byte_28 : 584|8@1+ (1,0) [0|255] ""  AuxiliaryValveControl_Ch2
 SG_ Appl_Id_Byte_29 : 592|8@1+ (1,0) [0|255] ""  AuxiliaryValveControl_Ch2
 SG_ Appl_Id_Byte_30 : 600|8@1+ (1,0) [0|255] ""  AuxiliaryValveControl_Ch2
 SG_ Appl_Id_Byte_31 : 608|8@1+ (1,0) [0|255] ""  AuxiliaryValveControl_Ch2
 SG_ Appl_Id_Byte_32 : 616|8@1+ (1,0) [0|255] ""  AuxiliaryValveControl_Ch2
 SG_ Appl_Id_Byte_33 : 624|8@1+ (1,0) [0|255] ""  AuxiliaryValveControl_Ch2
 SG_ Appl_Id_Byte_34 : 632|8@1+ (1,0) [0|255] ""  AuxiliaryValveControl_Ch2
 SG_ Appl_Id_Byte_35 : 640|8@1+ (1,0) [0|255] ""  AuxiliaryValveControl_Ch2
 SG_ Appl_Id_Byte_36 : 648|8@1+ (1,0) [0|255] ""  AuxiliaryValveControl_Ch2
 SG_ Appl_Id_Byte_37 : 656|8@1+ (1,0) [0|255] ""  AuxiliaryValveControl_Ch2
 SG_ Appl_Id_Byte_38 : 664|8@1+ (1,0) [0|255] ""  AuxiliaryValveControl_Ch2
 SG_ Appl_Id_Byte_39 : 672|8@1+ (1,0) [0|255] ""  AuxiliaryValveControl_Ch2
 SG_ Appl_Id_Enum : 680|24@1+ (1,0) [0|16777215] ""  AuxiliaryValveControl_Ch2
 SG_ Bootloader_Id : 360|8@1+ (1,0) [0|255] ""  AuxiliaryValveControl_Ch2
 SG_ Bootloader_Id_Byte_01 : 16|8@1+ (1,0) [0|255] ""  AuxiliaryValveControl_Ch2
 SG_ Bootloader_Id_Byte_02 : 24|8@1+ (1,0) [0|255] ""  AuxiliaryValveControl_Ch2
 SG_ Bootloader_Id_Byte_03 : 32|8@1+ (1,0) [0|255] ""  AuxiliaryValveControl_Ch2
 SG_ Bootloader_Id_Byte_04 : 40|8@1+ (1,0) [0|255] ""  AuxiliaryValveControl_Ch2
 SG_ Bootloader_Id_Byte_05 : 48|8@1+ (1,0) [0|255] ""  AuxiliaryValveControl_Ch2

BO_ 2566866048 PB_EHR_ParameterStatus_80: 8 REHR_1
 SG_ EHR_ChksumStor m80 : 40|8@1+ (1,0) [0|255] ""  AuxiliaryValveControl_Ch2
 SG_ EHR_ChksumSW m80 : 32|8@1+ (1,0) [0|255] ""  AuxiliaryValveControl_Ch2
 SG_ EHR_EvNumParamMux_12 : 24|8@1+ (1,0) [0|255] ""  AuxiliaryValveControl_Ch2
 SG_ EHR_ParamByte_1 : 0|8@1+ (1,0) [0|255] ""  AuxiliaryValveControl_Ch2
 SG_ EHR_ParamStsByte_2 : 8|8@1+ (1,0) [0|255] ""  AuxiliaryValveControl_Ch2
 SG_ EHR_ParamStsByte_3 M : 16|8@1+ (1,0) [0|255] ""  AuxiliaryValveControl_Ch2
 SG_ EHR_RmpRndng m103 : 32|8@1+ (1,0) [0|255] ""  AuxiliaryValveControl_Ch2

BO_ 2566866049 PB_EHR_ParameterStatus_81: 8 REHR_2
 SG_ EHR_ChksumStor m80 : 40|8@1+ (1,0) [0|255] ""  AuxiliaryValveControl_Ch2
 SG_ EHR_ChksumSW m80 : 32|8@1+ (1,0) [0|255] ""  AuxiliaryValveControl_Ch2
 SG_ EHR_EvNumParamMux_12 : 24|8@1+ (1,0) [0|255] ""  AuxiliaryValveControl_Ch2
 SG_ EHR_ParamByte_1 : 0|8@1+ (1,0) [0|255] ""  AuxiliaryValveControl_Ch2
 SG_ EHR_ParamStsByte_2 : 8|8@1+ (1,0) [0|255] ""  AuxiliaryValveControl_Ch2
 SG_ EHR_ParamStsByte_3 M : 16|8@1+ (1,0) [0|255] ""  AuxiliaryValveControl_Ch2
 SG_ EHR_RmpRndng m103 : 32|8@1+ (1,0) [0|255] ""  AuxiliaryValveControl_Ch2

BO_ 2566866050 PB_EHR_ParameterStatus_82: 8 REHR_3
 SG_ EHR_ChksumStor m80 : 40|8@1+ (1,0) [0|255] ""  AuxiliaryValveControl_Ch2
 SG_ EHR_ChksumSW m80 : 32|8@1+ (1,0) [0|255] ""  AuxiliaryValveControl_Ch2
 SG_ EHR_EvNumParamMux_12 : 24|8@1+ (1,0) [0|255] ""  AuxiliaryValveControl_Ch2
 SG_ EHR_ParamByte_1 : 0|8@1+ (1,0) [0|255] ""  AuxiliaryValveControl_Ch2
 SG_ EHR_ParamStsByte_2 : 8|8@1+ (1,0) [0|255] ""  AuxiliaryValveControl_Ch2
 SG_ EHR_ParamStsByte_3 M : 16|8@1+ (1,0) [0|255] ""  AuxiliaryValveControl_Ch2
 SG_ EHR_RmpRndng m103 : 32|8@1+ (1,0) [0|255] ""  AuxiliaryValveControl_Ch2

BO_ 2566866051 PB_EHR_ParameterStatus_83: 8 REHR_4
 SG_ EHR_ChksumStor m80 : 40|8@1+ (1,0) [0|255] ""  AuxiliaryValveControl_Ch2
 SG_ EHR_ChksumSW m80 : 32|8@1+ (1,0) [0|255] ""  AuxiliaryValveControl_Ch2
 SG_ EHR_EvNumParamMux_12 : 24|8@1+ (1,0) [0|255] ""  AuxiliaryValveControl_Ch2
 SG_ EHR_ParamByte_1 : 0|8@1+ (1,0) [0|255] ""  AuxiliaryValveControl_Ch2
 SG_ EHR_ParamStsByte_2 : 8|8@1+ (1,0) [0|255] ""  AuxiliaryValveControl_Ch2
 SG_ EHR_ParamStsByte_3 M : 16|8@1+ (1,0) [0|255] ""  AuxiliaryValveControl_Ch2
 SG_ EHR_RmpRndng m103 : 32|8@1+ (1,0) [0|255] ""  AuxiliaryValveControl_Ch2

CM_ BO_ 2566838913 "Software Identification. 'On request'. Variable DLC for Joystick Steering Valve (Danfoss) 11 identification fields (see signals) separated by  '*'";
CM_ SG_ 2566838913 Appl_Id "Software ID. Set to P826vxx or to P662vxx";
CM_ SG_ 2566838913 Appl_Id_Byte_01 "Software ID. Set to P826vxx or to P662vxx";
CM_ SG_ 2566838913 Appl_Id_Byte_02 "Software ID. Set to P826vxx or to P662vxx";
CM_ SG_ 2566838913 Appl_Id_Byte_03 "Software ID. Set to P826vxx or to P662vxx";
CM_ SG_ 2566838913 Appl_Id_Byte_04 "Software ID. Set to P826vxx or to P662vxx";
CM_ SG_ 2566838913 Appl_Id_Byte_05 "Software ID. Set to P826vxx or to P662vxx";
CM_ SG_ 2566838913 Appl_Id_Byte_06 "Software ID. Set to P826vxx or to P662vxx";
CM_ SG_ 2566838913 Appl_Id_Byte_07 "Software ID. Set to P826vxx or to P662vxx";
CM_ SG_ 2566838913 Appl_Id_Byte_08 "Software ID. Set to P826vxx or to P662vxx";
CM_ SG_ 2566838913 Appl_Id_Byte_09 "Software ID. Set to P826vxx or to P662vxx";
CM_ SG_ 2566838913 Appl_Id_Byte_10 "Software ID. Set to P826vxx or to P662vxx";
CM_ SG_ 2566838913 Appl_Id_Byte_11 "Software ID. Set to P826vxx or to P662vxx";
CM_ SG_ 2566838913 Appl_Id_Byte_12 "Software ID. Set to P826vxx or to P662vxx";
CM_ SG_ 2566838913 Appl_Id_Byte_13 "Software ID. Set to P826vxx or to P662vxx";
CM_ SG_ 2566838913 Appl_Id_Byte_14 "Software ID. Set to P826vxx or to P662vxx";
CM_ SG_ 2566838913 Appl_Id_Byte_15 "Software ID. Set to P826vxx or to P662vxx";
CM_ SG_ 2566838913 Appl_Id_Byte_16 "Software ID. Set to P826vxx or to P662vxx";
CM_ SG_ 2566838913 Appl_Id_Byte_17 "Software ID. Set to P826vxx or to P662vxx";
CM_ SG_ 2566838913 Appl_Id_Byte_18 "Software ID. Set to P826vxx or to P662vxx";
CM_ SG_ 2566838913 Appl_Id_Byte_19 "Software ID. Set to P826vxx or to P662vxx";
CM_ SG_ 2566838913 Appl_Id_Byte_20 "Software ID. Set to P826vxx or to P662vxx";
CM_ SG_ 2566838913 Appl_Id_Byte_21 "Software ID. Set to P826vxx or to P662vxx";
CM_ SG_ 2566838913 Appl_Id_Byte_22 "Software ID. Set to P826vxx or to P662vxx";
CM_ SG_ 2566838913 Appl_Id_Byte_23 "Software ID. Set to P826vxx or to P662vxx";
CM_ SG_ 2566838913 Appl_Id_Byte_24 "Software ID. Set to P826vxx or to P662vxx";
CM_ SG_ 2566838913 Appl_Id_Byte_25 "Software ID. Set to P826vxx or to P662vxx";
CM_ SG_ 2566838913 Appl_Id_Byte_26 "Software ID. Set to P826vxx or to P662vxx";
CM_ SG_ 2566838913 Appl_Id_Byte_27 "Software ID. Set to P826vxx or to P662vxx";
CM_ SG_ 2566838913 Appl_Id_Byte_28 "Software ID. Set to P826vxx or to P662vxx";
CM_ SG_ 2566838913 Appl_Id_Byte_29 "Software ID. Set to P826vxx or to P662vxx";
CM_ SG_ 2566838913 Appl_Id_Byte_30 "Software ID. Set to P826vxx or to P662vxx";
CM_ SG_ 2566838913 Appl_Id_Byte_31 "Software ID. Set to P826vxx or to P662vxx";
CM_ SG_ 2566838913 Appl_Id_Byte_32 "Software ID. Set to P826vxx or to P662vxx";
CM_ SG_ 2566838913 Appl_Id_Byte_33 "Software ID. Set to P826vxx or to P662vxx";
CM_ SG_ 2566838913 Appl_Id_Byte_34 "Software ID. Set to P826vxx or to P662vxx";
CM_ SG_ 2566838913 Appl_Id_Byte_35 "Software ID. Set to P826vxx or to P662vxx";
CM_ SG_ 2566838913 Appl_Id_Byte_36 "Software ID. Set to P826vxx or to P662vxx";
CM_ SG_ 2566838913 Appl_Id_Byte_37 "Software ID. Set to P826vxx or to P662vxx";
CM_ SG_ 2566838913 Appl_Id_Byte_38 "Software ID. Set to P826vxx or to P662vxx";
CM_ SG_ 2566838913 Appl_Id_Byte_39 "Software ID. Set to P826vxx or to P662vxx";
CM_ SG_ 2566838913 Appl_Id_Enum "Software ID.";
CM_ SG_ 2566838913 Bootloader_Id "Software ID.";
CM_ SG_ 2566838913 Bootloader_Id_Byte_01 "Software ID.";
CM_ SG_ 2566838913 Bootloader_Id_Byte_02 "Software ID.";
CM_ SG_ 2566838913 Bootloader_Id_Byte_03 "Software ID.";
CM_ SG_ 2566838913 Bootloader_Id_Byte_04 "Software ID.";
CM_ SG_ 2566838913 Bootloader_Id_Byte_05 "Software ID.";
CM_ SG_ 2566838913 Bootloader_Id_Byte_06 "Software ID.";
CM_ SG_ 2566838913 Bootloader_Id_Byte_07 "Software ID.";
CM_ SG_ 2566838913 Bootloader_Id_Byte_08 "Software ID.";
CM_ SG_ 2566838913 Bootloader_Id_Byte_09 "Software ID.";
CM_ SG_ 2566838913 Bootloader_Id_Byte_10 "Software ID.";
CM_ SG_ 2566838913 Bootloader_Id_Byte_11 "Software ID.";
CM_ SG_ 2566838913 Bootloader_Id_Byte_12 "Software ID.";
CM_ SG_ 2566838913 Bootloader_Id_Byte_13 "Software ID.";
CM_ SG_ 2566838913 Bootloader_Id_Byte_14 "Software ID.";
CM_ SG_ 2566838913 Bootloader_Id_Byte_15 "Software ID.";
CM_ SG_ 2566838913 Bootloader_Id_Byte_16 "Software ID.";
CM_ SG_ 2566838913 Bootloader_Id_Byte_17 "Software ID.";
CM_ SG_ 2566838913 Bootloader_Id_Byte_18 "Software ID.";
CM_ SG_ 2566838913 Bootloader_Id_Byte_19 "Software ID.";
CM_ SG_ 2566838913 Bootloader_Id_Byte_20 "Software ID.";
CM_ SG_ 2566838913 Bootloader_Id_Byte_21 "Software ID.";
CM_ SG_ 2566838913 Bootloader_Id_Byte_22 "Software ID.";
CM_ SG_ 2566838913 Bootloader_Id_Byte_23 "Software ID.";
CM_ SG_ 2566838913 Bootloader_Id_Byte_24 "Software ID.";
CM_ SG_ 2566838913 Bootloader_Id_Byte_25 "Software ID.";
CM_ SG_ 2566838913 Bootloader_Id_Byte_26 "Software ID.";
CM_ SG_ 2566838913 Bootloader_Id_Byte_27 "Software ID.";
CM_ SG_ 2566838913 Bootloader_Id_Byte_28 "Software ID.";
CM_ SG_ 2566838913 Bootloader_Id_Byte_29 "Software ID.";
CM_ SG_ 2566838913 Bootloader_Id_Byte_30 "Software ID.";
CM_ SG_ 2566838913 Bootloader_Id_Byte_31 "Software ID.";
CM_ SG_ 2566838913 Bootloader_Id_Byte_32 "Software ID.";
CM_ SG_ 2566838913 Bootloader_Id_Byte_33 "Software ID.";
CM_ SG_ 2566838913 Bootloader_Id_Byte_34 "Software ID.";
CM_ SG_ 2566838913 Bootloader_Id_Byte_35 "Software ID.";
CM_ SG_ 2566838913 Bootloader_Id_Byte_36 "Software ID.";
CM_ SG_ 2566838913 Bootloader_Id_Byte_37 "Software ID.";
CM_ SG_ 2566838913 Bootloader_Id_Byte_38 "Software ID.";
CM_ SG_ 2566838913 Bootloader_Id_Byte_39 "Software ID.";
CM_ SG_ 2566838913 Bootloader_Id_Enum "Software ID.";
CM_ SG_ 2566838913 EndStrng_00 "Software ID. ";
CM_ SG_ 2566838913 EndStrng_01 "Software ID. ";
CM_ SG_ 2566838913 NumSW_IdField "Number of software identification designators represented in the software identification parameter group.";
CM_ BO_ 2566838914 "Software Identification. 'On request'. Variable DLC for Joystick Steering Valve (Danfoss) 11 identification fields (see signals) separated by  '*'";
CM_ SG_ 2566838914 Appl_Id "Software ID. Set to P826vxx or to P662vxx";
CM_ SG_ 2566838914 Appl_Id_Byte_01 "Software ID. Set to P826vxx or to P662vxx";
CM_ SG_ 2566838914 Appl_Id_Byte_02 "Software ID. Set to P826vxx or to P662vxx";
CM_ SG_ 2566838914 Appl_Id_Byte_03 "Software ID. Set to P826vxx or to P662vxx";
CM_ SG_ 2566838914 Appl_Id_Byte_04 "Software ID. Set to P826vxx or to P662vxx";
CM_ SG_ 2566838914 Appl_Id_Byte_05 "Software ID. Set to P826vxx or to P662vxx";
CM_ SG_ 2566838914 Appl_Id_Byte_06 "Software ID. Set to P826vxx or to P662vxx";
CM_ SG_ 2566838914 Appl_Id_Byte_07 "Software ID. Set to P826vxx or to P662vxx";
CM_ SG_ 2566838914 Appl_Id_Byte_08 "Software ID. Set to P826vxx or to P662vxx";
CM_ SG_ 2566838914 Appl_Id_Byte_09 "Software ID. Set to P826vxx or to P662vxx";
CM_ SG_ 2566838914 Appl_Id_Byte_10 "Software ID. Set to P826vxx or to P662vxx";
CM_ SG_ 2566838914 Appl_Id_Byte_11 "Software ID. Set to P826vxx or to P662vxx";
CM_ SG_ 2566838914 Appl_Id_Byte_12 "Software ID. Set to P826vxx or to P662vxx";
CM_ SG_ 2566838914 Appl_Id_Byte_13 "Software ID. Set to P826vxx or to P662vxx";
CM_ SG_ 2566838914 Appl_Id_Byte_14 "Software ID. Set to P826vxx or to P662vxx";
CM_ SG_ 2566838914 Appl_Id_Byte_15 "Software ID. Set to P826vxx or to P662vxx";
CM_ SG_ 2566838914 Appl_Id_Byte_16 "Software ID. Set to P826vxx or to P662vxx";
CM_ SG_ 2566838914 Appl_Id_Byte_17 "Software ID. Set to P826vxx or to P662vxx";
CM_ SG_ 2566838914 Appl_Id_Byte_18 "Software ID. Set to P826vxx or to P662vxx";
CM_ SG_ 2566838914 Appl_Id_Byte_19 "Software ID. Set to P826vxx or to P662vxx";
CM_ SG_ 2566838914 Appl_Id_Byte_20 "Software ID. Set to P826vxx or to P662vxx";
CM_ SG_ 2566838914 Appl_Id_Byte_21 "Software ID. Set to P826vxx or to P662vxx";
CM_ SG_ 2566838914 Appl_Id_Byte_22 "Software ID. Set to P826vxx or to P662vxx";
CM_ SG_ 2566838914 Appl_Id_Byte_23 "Software ID. Set to P826vxx or to P662vxx";
CM_ SG_ 2566838914 Appl_Id_Byte_24 "Software ID. Set to P826vxx or to P662vxx";
CM_ SG_ 2566838914 Appl_Id_Byte_25 "Software ID. Set to P826vxx or to P662vxx";
CM_ SG_ 2566838914 Appl_Id_Byte_26 "Software ID. Set to P826vxx or to P662vxx";
CM_ SG_ 2566838914 Appl_Id_Byte_27 "Software ID. Set to P826vxx or to P662vxx";
CM_ SG_ 2566838914 Appl_Id_Byte_28 "Software ID. Set to P826vxx or to P662vxx";
CM_ SG_ 2566838914 Appl_Id_Byte_29 "Software ID. Set to P826vxx or to P662vxx";
CM_ SG_ 2566838914 Appl_Id_Byte_30 "Software ID. Set to P826vxx or to P662vxx";
CM_ SG_ 2566838914 Appl_Id_Byte_31 "Software ID. Set to P826vxx or to P662vxx";
CM_ SG_ 2566838914 Appl_Id_Byte_32 "Software ID. Set to P826vxx or to P662vxx";
CM_ SG_ 2566838914 Appl_Id_Byte_33 "Software ID. Set to P826vxx or to P662vxx";
CM_ SG_ 2566838914 Appl_Id_Byte_34 "Software ID. Set to P826vxx or to P662vxx";
CM_ SG_ 2566838914 Appl_Id_Byte_35 "Software ID. Set to P826vxx or to P662vxx";
CM_ SG_ 2566838914 Appl_Id_Byte_36 "Software ID. Set to P826vxx or to P662vxx";
CM_ SG_ 2566838914 Appl_Id_Byte_37 "Software ID. Set to P826vxx or to P662vxx";
CM_ SG_ 2566838914 Appl_Id_Byte_38 "Software ID. Set to P826vxx or to P662vxx";
CM_ SG_ 2566838914 Appl_Id_Byte_39 "Software ID. Set to P826vxx or to P662vxx";
CM_ SG_ 2566838914 Appl_Id_Enum "Software ID.";
CM_ SG_ 2566838914 Bootloader_Id "Software ID.";
CM_ SG_ 2566838914 Bootloader_Id_Byte_01 "Software ID.";
CM_ SG_ 2566838914 Bootloader_Id_Byte_02 "Software ID.";
CM_ SG_ 2566838914 Bootloader_Id_Byte_03 "Software ID.";
CM_ SG_ 2566838914 Bootloader_Id_Byte_04 "Software ID.";
CM_ SG_ 2566838914 Bootloader_Id_Byte_05 "Software ID.";
CM_ SG_ 2566838914 Bootloader_Id_Byte_06 "Software ID.";
CM_ SG_ 2566838914 Bootloader_Id_Byte_07 "Software ID.";
CM_ SG_ 2566838914 Bootloader_Id_Byte_08 "Software ID.";
CM_ SG_ 2566838914 Bootloader_Id_Byte_09 "Software ID.";
CM_ SG_ 2566838914 Bootloader_Id_Byte_10 "Software ID.";
CM_ SG_ 2566838914 Bootloader_Id_Byte_11 "Software ID.";
CM_ SG_ 2566838914 Bootloader_Id_Byte_12 "Software ID.";
CM_ SG_ 2566838914 Bootloader_Id_Byte_13 "Software ID.";
CM_ SG_ 2566838914 Bootloader_Id_Byte_14 "Software ID.";
CM_ SG_ 2566838914 Bootloader_Id_Byte_15 "Software ID.";
CM_ SG_ 2566838914 Bootloader_Id_Byte_16 "Software ID.";
CM_ SG_ 2566838914 Bootloader_Id_Byte_17 "Software ID.";
CM_ SG_ 2566838914 Bootloader_Id_Byte_18 "Software ID.";
CM_ SG_ 2566838914 Bootloader_Id_Byte_19 "Software ID.";
CM_ SG_ 2566838914 Bootloader_Id_Byte_20 "Software ID.";
CM_ SG_ 2566838914 Bootloader_Id_Byte_21 "Software ID.";
CM_ SG_ 2566838914 Bootloader_Id_Byte_22 "Software ID.";
CM_ SG_ 2566838914 Bootloader_Id_Byte_23 "Software ID.";
CM_ SG_ 2566838914 Bootloader_Id_Byte_24 "Software ID.";
CM_ SG_ 2566838914 Bootloader_Id_Byte_25 "Software ID.";
CM_ SG_ 2566838914 Bootloader_Id_Byte_26 "Software ID.";
CM_ SG_ 2566838914 Bootloader_Id_Byte_27 "Software ID.";
CM_ SG_ 2566838914 Bootloader_Id_Byte_28 "Software ID.";
CM_ SG_ 2566838914 Bootloader_Id_Byte_29 "Software ID.";
CM_ SG_ 2566838914 Bootloader_Id_Byte_30 "Software ID.";
CM_ SG_ 2566838914 Bootloader_Id_Byte_31 "Software ID.";
CM_ SG_ 2566838914 Bootloader_Id_Byte_32 "Software ID.";
CM_ SG_ 2566838914 Bootloader_Id_Byte_33 "Software ID.";
CM_ SG_ 2566838914 Bootloader_Id_Byte_34 "Software ID.";
CM_ SG_ 2566838914 Bootloader_Id_Byte_35 "Software ID.";
CM_ SG_ 2566838914 Bootloader_Id_Byte_36 "Software ID.";
CM_ SG_ 2566838914 Bootloader_Id_Byte_37 "Software ID.";
CM_ SG_ 2566838914 Bootloader_Id_Byte_38 "Software ID.";
CM_ SG_ 2566838914 Bootloader_Id_Byte_39 "Software ID.";
CM_ SG_ 2566838914 Bootloader_Id_Enum "Software ID.";
CM_ SG_ 2566838914 EndStrng_00 "Software ID. ";
CM_ SG_ 2566838914 EndStrng_01 "Software ID. ";
CM_ SG_ 2566838914 NumSW_IdField "Number of software identification designators represented in the software identification parameter group.";
CM_ BO_ 2566838915 "Software Identification. 'On request'. Variable DLC for Joystick Steering Valve (Danfoss) 11 identification fields (see signals) separated by  '*'";
CM_ SG_ 2566838915 Bootloader_Id_Byte_08 "Software ID.";
CM_ SG_ 2566838915 Bootloader_Id_Byte_09 "Software ID.";
CM_ SG_ 2566838915 Bootloader_Id_Byte_10 "Software ID.";
CM_ SG_ 2566838915 Bootloader_Id_Byte_11 "Software ID.";
CM_ SG_ 2566838915 Bootloader_Id_Byte_12 "Software ID.";
CM_ SG_ 2566838915 Bootloader_Id_Byte_13 "Software ID.";
CM_ SG_ 2566838915 Bootloader_Id_Byte_14 "Software ID.";
CM_ SG_ 2566838915 Bootloader_Id_Byte_15 "Software ID.";
CM_ SG_ 2566838915 Bootloader_Id_Byte_16 "Software ID.";
CM_ SG_ 2566838915 Bootloader_Id_Byte_17 "Software ID.";
CM_ SG_ 2566838915 Bootloader_Id_Byte_18 "Software ID.";
CM_ SG_ 2566838915 Bootloader_Id_Byte_19 "Software ID.";
CM_ SG_ 2566838915 Bootloader_Id_Byte_20 "Software ID.";
CM_ SG_ 2566838915 Bootloader_Id_Byte_21 "Software ID.";
CM_ SG_ 2566838915 Bootloader_Id_Byte_22 "Software ID.";
CM_ SG_ 2566838915 Bootloader_Id_Byte_23 "Software ID.";
CM_ SG_ 2566838915 Bootloader_Id_Byte_24 "Software ID.";
CM_ SG_ 2566838915 Bootloader_Id_Byte_25 "Software ID.";
CM_ SG_ 2566838915 Bootloader_Id_Byte_26 "Software ID.";
CM_ SG_ 2566838915 Bootloader_Id_Byte_27 "Software ID.";
CM_ SG_ 2566838915 Bootloader_Id_Byte_28 "Software ID.";
CM_ SG_ 2566838915 Bootloader_Id_Byte_29 "Software ID.";
CM_ SG_ 2566838915 Bootloader_Id_Byte_30 "Software ID.";
CM_ SG_ 2566838915 Bootloader_Id_Byte_31 "Software ID.";
CM_ SG_ 2566838915 Bootloader_Id_Byte_32 "Software ID.";
CM_ SG_ 2566838915 Bootloader_Id_Byte_33 "Software ID.";
CM_ SG_ 2566838915 Bootloader_Id_Byte_34 "Software ID.";
CM_ SG_ 2566838915 Bootloader_Id_Byte_35 "Software ID.";
CM_ SG_ 2566838915 Bootloader_Id_Byte_36 "Software ID.";
CM_ SG_ 2566838915 Bootloader_Id_Byte_37 "Software ID.";
CM_ SG_ 2566838915 Bootloader_Id_Byte_38 "Software ID.";
CM_ SG_ 2566838915 Bootloader_Id_Byte_39 "Software ID.";
CM_ SG_ 2566838915 Bootloader_Id_Enum "Software ID.";
CM_ SG_ 2566838915 EndStrng_00 "Software ID. ";
CM_ SG_ 2566838915 EndStrng_01 "Software ID. ";
CM_ SG_ 2566838915 NumSW_IdField "Number of software identification designators represented in the software identification parameter group.";
CM_ SG_ 2566838915 Appl_Id "Software ID. Set to P826vxx or to P662vxx";
CM_ SG_ 2566838915 Appl_Id_Byte_01 "Software ID. Set to P826vxx or to P662vxx";
CM_ SG_ 2566838915 Appl_Id_Byte_02 "Software ID. Set to P826vxx or to P662vxx";
CM_ SG_ 2566838915 Appl_Id_Byte_03 "Software ID. Set to P826vxx or to P662vxx";
CM_ SG_ 2566838915 Appl_Id_Byte_04 "Software ID. Set to P826vxx or to P662vxx";
CM_ SG_ 2566838915 Appl_Id_Byte_05 "Software ID. Set to P826vxx or to P662vxx";
CM_ SG_ 2566838915 Appl_Id_Byte_06 "Software ID. Set to P826vxx or to P662vxx";
CM_ SG_ 2566838915 Appl_Id_Byte_07 "Software ID. Set to P826vxx or to P662vxx";
CM_ SG_ 2566838915 Appl_Id_Byte_08 "Software ID. Set to P826vxx or to P662vxx";
CM_ SG_ 2566838915 Appl_Id_Byte_09 "Software ID. Set to P826vxx or to P662vxx";
CM_ SG_ 2566838915 Appl_Id_Byte_10 "Software ID. Set to P826vxx or to P662vxx";
CM_ SG_ 2566838915 Appl_Id_Byte_11 "Software ID. Set to P826vxx or to P662vxx";
CM_ SG_ 2566838915 Appl_Id_Byte_12 "Software ID. Set to P826vxx or to P662vxx";
CM_ SG_ 2566838915 Appl_Id_Byte_13 "Software ID. Set to P826vxx or to P662vxx";
CM_ SG_ 2566838915 Appl_Id_Byte_14 "Software ID. Set to P826vxx or to P662vxx";
CM_ SG_ 2566838915 Appl_Id_Byte_15 "Software ID. Set to P826vxx or to P662vxx";
CM_ SG_ 2566838915 Appl_Id_Byte_16 "Software ID. Set to P826vxx or to P662vxx";
CM_ SG_ 2566838915 Appl_Id_Byte_17 "Software ID. Set to P826vxx or to P662vxx";
CM_ SG_ 2566838915 Appl_Id_Byte_18 "Software ID. Set to P826vxx or to P662vxx";
CM_ SG_ 2566838915 Appl_Id_Byte_19 "Software ID. Set to P826vxx or to P662vxx";
CM_ SG_ 2566838915 Appl_Id_Byte_20 "Software ID. Set to P826vxx or to P662vxx";
CM_ SG_ 2566838915 Appl_Id_Byte_21 "Software ID. Set to P826vxx or to P662vxx";
CM_ SG_ 2566838915 Appl_Id_Byte_22 "Software ID. Set to P826vxx or to P662vxx";
CM_ SG_ 2566838915 Appl_Id_Byte_23 "Software ID. Set to P826vxx or to P662vxx";
CM_ SG_ 2566838915 Appl_Id_Byte_24 "Software ID. Set to P826vxx or to P662vxx";
CM_ SG_ 2566838915 Appl_Id_Byte_25 "Software ID. Set to P826vxx or to P662vxx";
CM_ SG_ 2566838915 Appl_Id_Byte_26 "Software ID. Set to P826vxx or to P662vxx";
CM_ SG_ 2566838915 Appl_Id_Byte_27 "Software ID. Set to P826vxx or to P662vxx";
CM_ SG_ 2566838915 Appl_Id_Byte_28 "Software ID. Set to P826vxx or to P662vxx";
CM_ SG_ 2566838915 Appl_Id_Byte_29 "Software ID. Set to P826vxx or to P662vxx";
CM_ SG_ 2566838915 Appl_Id_Byte_30 "Software ID. Set to P826vxx or to P662vxx";
CM_ SG_ 2566838915 Appl_Id_Byte_31 "Software ID. Set to P826vxx or to P662vxx";
CM_ SG_ 2566838915 Appl_Id_Byte_32 "Software ID. Set to P826vxx or to P662vxx";
CM_ SG_ 2566838915 Appl_Id_Byte_33 "Software ID. Set to P826vxx or to P662vxx";
CM_ SG_ 2566838915 Appl_Id_Byte_34 "Software ID. Set to P826vxx or to P662vxx";
CM_ SG_ 2566838915 Appl_Id_Byte_35 "Software ID. Set to P826vxx or to P662vxx";
CM_ SG_ 2566838915 Appl_Id_Byte_36 "Software ID. Set to P826vxx or to P662vxx";
CM_ SG_ 2566838915 Appl_Id_Byte_37 "Software ID. Set to P826vxx or to P662vxx";
CM_ SG_ 2566838915 Appl_Id_Byte_38 "Software ID. Set to P826vxx or to P662vxx";
CM_ SG_ 2566838915 Appl_Id_Byte_39 "Software ID. Set to P826vxx or to P662vxx";
CM_ SG_ 2566838915 Appl_Id_Enum "Software ID.";
CM_ SG_ 2566838915 Bootloader_Id "Software ID.";
CM_ SG_ 2566838915 Bootloader_Id_Byte_01 "Software ID.";
CM_ SG_ 2566838915 Bootloader_Id_Byte_02 "Software ID.";
CM_ SG_ 2566838915 Bootloader_Id_Byte_03 "Software ID.";
CM_ SG_ 2566838915 Bootloader_Id_Byte_04 "Software ID.";
CM_ SG_ 2566838915 Bootloader_Id_Byte_05 "Software ID.";
CM_ SG_ 2566838915 Bootloader_Id_Byte_06 "Software ID.";
CM_ SG_ 2566838915 Bootloader_Id_Byte_07 "Software ID.";
CM_ BO_ 2566838916 "Software Identification. 'On request'. Variable DLC for Joystick Steering Valve (Danfoss) 11 identification fields (see signals) separated by  '*'";
CM_ SG_ 2566838916 Appl_Id "Software ID. Set to P826vxx or to P662vxx";
CM_ SG_ 2566838916 Appl_Id_Byte_01 "Software ID. Set to P826vxx or to P662vxx";
CM_ SG_ 2566838916 Appl_Id_Byte_02 "Software ID. Set to P826vxx or to P662vxx";
CM_ SG_ 2566838916 Appl_Id_Byte_03 "Software ID. Set to P826vxx or to P662vxx";
CM_ SG_ 2566838916 Appl_Id_Byte_04 "Software ID. Set to P826vxx or to P662vxx";
CM_ SG_ 2566838916 Appl_Id_Byte_05 "Software ID. Set to P826vxx or to P662vxx";
CM_ SG_ 2566838916 Appl_Id_Byte_06 "Software ID. Set to P826vxx or to P662vxx";
CM_ SG_ 2566838916 Appl_Id_Byte_07 "Software ID. Set to P826vxx or to P662vxx";
CM_ SG_ 2566838916 Appl_Id_Byte_08 "Software ID. Set to P826vxx or to P662vxx";
CM_ SG_ 2566838916 Appl_Id_Byte_09 "Software ID. Set to P826vxx or to P662vxx";
CM_ SG_ 2566838916 Appl_Id_Byte_10 "Software ID. Set to P826vxx or to P662vxx";
CM_ SG_ 2566838916 Appl_Id_Byte_11 "Software ID. Set to P826vxx or to P662vxx";
CM_ SG_ 2566838916 Appl_Id_Byte_12 "Software ID. Set to P826vxx or to P662vxx";
CM_ SG_ 2566838916 Appl_Id_Byte_13 "Software ID. Set to P826vxx or to P662vxx";
CM_ SG_ 2566838916 Appl_Id_Byte_14 "Software ID. Set to P826vxx or to P662vxx";
CM_ SG_ 2566838916 Appl_Id_Byte_15 "Software ID. Set to P826vxx or to P662vxx";
CM_ SG_ 2566838916 Appl_Id_Byte_16 "Software ID. Set to P826vxx or to P662vxx";
CM_ SG_ 2566838916 Appl_Id_Byte_17 "Software ID. Set to P826vxx or to P662vxx";
CM_ SG_ 2566838916 Appl_Id_Byte_18 "Software ID. Set to P826vxx or to P662vxx";
CM_ SG_ 2566838916 Appl_Id_Byte_19 "Software ID. Set to P826vxx or to P662vxx";
CM_ SG_ 2566838916 Appl_Id_Byte_20 "Software ID. Set to P826vxx or to P662vxx";
CM_ SG_ 2566838916 Appl_Id_Byte_21 "Software ID. Set to P826vxx or to P662vxx";
CM_ SG_ 2566838916 Appl_Id_Byte_22 "Software ID. Set to P826vxx or to P662vxx";
CM_ SG_ 2566838916 Appl_Id_Byte_23 "Software ID. Set to P826vxx or to P662vxx";
CM_ SG_ 2566838916 Appl_Id_Byte_24 "Software ID. Set to P826vxx or to P662vxx";
CM_ SG_ 2566838916 Appl_Id_Byte_25 "Software ID. Set to P826vxx or to P662vxx";
CM_ SG_ 2566838916 Appl_Id_Byte_26 "Software ID. Set to P826vxx or to P662vxx";
CM_ SG_ 2566838916 Appl_Id_Byte_27 "Software ID. Set to P826vxx or to P662vxx";
CM_ SG_ 2566838916 Appl_Id_Byte_28 "Software ID. Set to P826vxx or to P662vxx";
CM_ SG_ 2566838916 Appl_Id_Byte_29 "Software ID. Set to P826vxx or to P662vxx";
CM_ SG_ 2566838916 Appl_Id_Byte_30 "Software ID. Set to P826vxx or to P662vxx";
CM_ SG_ 2566838916 Appl_Id_Byte_31 "Software ID. Set to P826vxx or to P662vxx";
CM_ SG_ 2566838916 Appl_Id_Byte_32 "Software ID. Set to P826vxx or to P662vxx";
CM_ SG_ 2566838916 Appl_Id_Byte_33 "Software ID. Set to P826vxx or to P662vxx";
CM_ SG_ 2566838916 Appl_Id_Byte_34 "Software ID. Set to P826vxx or to P662vxx";
CM_ SG_ 2566838916 Appl_Id_Byte_35 "Software ID. Set to P826vxx or to P662vxx";
CM_ SG_ 2566838916 Appl_Id_Byte_36 "Software ID. Set to P826vxx or to P662vxx";
CM_ SG_ 2566838916 Appl_Id_Byte_37 "Software ID. Set to P826vxx or to P662vxx";
CM_ SG_ 2566838916 Appl_Id_Byte_38 "Software ID. Set to P826vxx or to P662vxx";
CM_ SG_ 2566838916 Appl_Id_Byte_39 "Software ID. Set to P826vxx or to P662vxx";
CM_ SG_ 2566838916 Appl_Id_Enum "Software ID.";
CM_ SG_ 2566838916 Bootloader_Id "Software ID.";
CM_ SG_ 2566838916 Bootloader_Id_Byte_01 "Software ID.";
CM_ SG_ 2566838916 Bootloader_Id_Byte_02 "Software ID.";
CM_ SG_ 2566838916 Bootloader_Id_Byte_03 "Software ID.";
CM_ SG_ 2566838916 Bootloader_Id_Byte_04 "Software ID.";
CM_ SG_ 2566838916 Bootloader_Id_Byte_05 "Software ID.";
CM_ SG_ 2566838916 Bootloader_Id_Byte_06 "Software ID.";
CM_ SG_ 2566838916 Bootloader_Id_Byte_07 "Software ID.";
CM_ SG_ 2566838916 Bootloader_Id_Byte_08 "Software ID.";
CM_ SG_ 2566838916 Bootloader_Id_Byte_09 "Software ID.";
CM_ SG_ 2566838916 Bootloader_Id_Byte_10 "Software ID.";
CM_ SG_ 2566838916 Bootloader_Id_Byte_11 "Software ID.";
CM_ SG_ 2566838916 Bootloader_Id_Byte_12 "Software ID.";
CM_ SG_ 2566838916 Bootloader_Id_Byte_13 "Software ID.";
CM_ SG_ 2566838916 Bootloader_Id_Byte_14 "Software ID.";
CM_ SG_ 2566838916 Bootloader_Id_Byte_15 "Software ID.";
CM_ SG_ 2566838916 Bootloader_Id_Byte_16 "Software ID.";
CM_ SG_ 2566838916 Bootloader_Id_Byte_17 "Software ID.";
CM_ SG_ 2566838916 Bootloader_Id_Byte_18 "Software ID.";
CM_ SG_ 2566838916 Bootloader_Id_Byte_19 "Software ID.";
CM_ SG_ 2566838916 Bootloader_Id_Byte_20 "Software ID.";
CM_ SG_ 2566838916 Bootloader_Id_Byte_21 "Software ID.";
CM_ SG_ 2566838916 Bootloader_Id_Byte_22 "Software ID.";
CM_ SG_ 2566838916 Bootloader_Id_Byte_23 "Software ID.";
CM_ SG_ 2566838916 Bootloader_Id_Byte_24 "Software ID.";
CM_ SG_ 2566838916 Bootloader_Id_Byte_25 "Software ID.";
CM_ SG_ 2566838916 Bootloader_Id_Byte_26 "Software ID.";
CM_ SG_ 2566838916 Bootloader_Id_Byte_27 "Software ID.";
CM_ SG_ 2566838916 Bootloader_Id_Byte_28 "Software ID.";
CM_ SG_ 2566838916 Bootloader_Id_Byte_29 "Software ID.";
CM_ SG_ 2566838916 Bootloader_Id_Byte_30 "Software ID.";
CM_ SG_ 2566838916 Bootloader_Id_Byte_31 "Software ID.";
CM_ SG_ 2566838916 Bootloader_Id_Byte_32 "Software ID.";
CM_ SG_ 2566838916 Bootloader_Id_Byte_33 "Software ID.";
CM_ SG_ 2566838916 Bootloader_Id_Byte_34 "Software ID.";
CM_ SG_ 2566838916 Bootloader_Id_Byte_35 "Software ID.";
CM_ SG_ 2566838916 Bootloader_Id_Byte_36 "Software ID.";
CM_ SG_ 2566838916 Bootloader_Id_Byte_37 "Software ID.";
CM_ SG_ 2566838916 Bootloader_Id_Byte_38 "Software ID.";
CM_ SG_ 2566838916 Bootloader_Id_Byte_39 "Software ID.";
CM_ SG_ 2566838916 Bootloader_Id_Enum "Software ID.";
CM_ SG_ 2566838916 EndStrng_00 "Software ID. ";
CM_ SG_ 2566838916 EndStrng_01 "Software ID. ";
CM_ SG_ 2566838916 NumSW_IdField "Number of software identification designators represented in the software identification parameter group.";
CM_ BO_ 2566838921 "Software Identification. 'On request'. Variable DLC for Joystick Steering Valve (Danfoss) 11 identification fields (see signals) separated by  '*'";
CM_ SG_ 2566838921 Bootloader_Id_Byte_06 "Software ID.";
CM_ SG_ 2566838921 Bootloader_Id_Byte_07 "Software ID.";
CM_ SG_ 2566838921 Bootloader_Id_Byte_08 "Software ID.";
CM_ SG_ 2566838921 Bootloader_Id_Byte_09 "Software ID.";
CM_ SG_ 2566838921 Bootloader_Id_Byte_10 "Software ID.";
CM_ SG_ 2566838921 Bootloader_Id_Byte_11 "Software ID.";
CM_ SG_ 2566838921 Bootloader_Id_Byte_12 "Software ID.";
CM_ SG_ 2566838921 Bootloader_Id_Byte_13 "Software ID.";
CM_ SG_ 2566838921 Bootloader_Id_Byte_14 "Software ID.";
CM_ SG_ 2566838921 Bootloader_Id_Byte_15 "Software ID.";
CM_ SG_ 2566838921 Bootloader_Id_Byte_16 "Software ID.";
CM_ SG_ 2566838921 Bootloader_Id_Byte_17 "Software ID.";
CM_ SG_ 2566838921 Bootloader_Id_Byte_18 "Software ID.";
CM_ SG_ 2566838921 Bootloader_Id_Byte_19 "Software ID.";
CM_ SG_ 2566838921 Bootloader_Id_Byte_20 "Software ID.";
CM_ SG_ 2566838921 Bootloader_Id_Byte_21 "Software ID.";
CM_ SG_ 2566838921 Bootloader_Id_Byte_22 "Software ID.";
CM_ SG_ 2566838921 Bootloader_Id_Byte_23 "Software ID.";
CM_ SG_ 2566838921 Bootloader_Id_Byte_24 "Software ID.";
CM_ SG_ 2566838921 Bootloader_Id_Byte_25 "Software ID.";
CM_ SG_ 2566838921 Bootloader_Id_Byte_26 "Software ID.";
CM_ SG_ 2566838921 Bootloader_Id_Byte_27 "Software ID.";
CM_ SG_ 2566838921 Bootloader_Id_Byte_28 "Software ID.";
CM_ SG_ 2566838921 Bootloader_Id_Byte_29 "Software ID.";
CM_ SG_ 2566838921 Bootloader_Id_Byte_30 "Software ID.";
CM_ SG_ 2566838921 Bootloader_Id_Byte_31 "Software ID.";
CM_ SG_ 2566838921 Bootloader_Id_Byte_32 "Software ID.";
CM_ SG_ 2566838921 Bootloader_Id_Byte_33 "Software ID.";
CM_ SG_ 2566838921 Bootloader_Id_Byte_34 "Software ID.";
CM_ SG_ 2566838921 Bootloader_Id_Byte_35 "Software ID.";
CM_ SG_ 2566838921 Bootloader_Id_Byte_36 "Software ID.";
CM_ SG_ 2566838921 Bootloader_Id_Byte_37 "Software ID.";
CM_ SG_ 2566838921 Bootloader_Id_Byte_38 "Software ID.";
CM_ SG_ 2566838921 Bootloader_Id_Byte_39 "Software ID.";
CM_ SG_ 2566838921 Bootloader_Id_Enum "Software ID.";
CM_ SG_ 2566838921 EndStrng_00 "Software ID. ";
CM_ SG_ 2566838921 EndStrng_01 "Software ID. ";
CM_ SG_ 2566838921 NumSW_IdField "Number of software identification designators represented in the software identification parameter group.";
CM_ SG_ 2566838921 Appl_Id "Software ID. Set to P826vxx or to P662vxx";
CM_ SG_ 2566838921 Appl_Id_Byte_01 "Software ID. Set to P826vxx or to P662vxx";
CM_ SG_ 2566838921 Appl_Id_Byte_02 "Software ID. Set to P826vxx or to P662vxx";
CM_ SG_ 2566838921 Appl_Id_Byte_03 "Software ID. Set to P826vxx or to P662vxx";
CM_ SG_ 2566838921 Appl_Id_Byte_04 "Software ID. Set to P826vxx or to P662vxx";
CM_ SG_ 2566838921 Appl_Id_Byte_05 "Software ID. Set to P826vxx or to P662vxx";
CM_ SG_ 2566838921 Appl_Id_Byte_06 "Software ID. Set to P826vxx or to P662vxx";
CM_ SG_ 2566838921 Appl_Id_Byte_07 "Software ID. Set to P826vxx or to P662vxx";
CM_ SG_ 2566838921 Appl_Id_Byte_08 "Software ID. Set to P826vxx or to P662vxx";
CM_ SG_ 2566838921 Appl_Id_Byte_09 "Software ID. Set to P826vxx or to P662vxx";
CM_ SG_ 2566838921 Appl_Id_Byte_10 "Software ID. Set to P826vxx or to P662vxx";
CM_ SG_ 2566838921 Appl_Id_Byte_11 "Software ID. Set to P826vxx or to P662vxx";
CM_ SG_ 2566838921 Appl_Id_Byte_12 "Software ID. Set to P826vxx or to P662vxx";
CM_ SG_ 2566838921 Appl_Id_Byte_13 "Software ID. Set to P826vxx or to P662vxx";
CM_ SG_ 2566838921 Appl_Id_Byte_14 "Software ID. Set to P826vxx or to P662vxx";
CM_ SG_ 2566838921 Appl_Id_Byte_15 "Software ID. Set to P826vxx or to P662vxx";
CM_ SG_ 2566838921 Appl_Id_Byte_16 "Software ID. Set to P826vxx or to P662vxx";
CM_ SG_ 2566838921 Appl_Id_Byte_17 "Software ID. Set to P826vxx or to P662vxx";
CM_ SG_ 2566838921 Appl_Id_Byte_18 "Software ID. Set to P826vxx or to P662vxx";
CM_ SG_ 2566838921 Appl_Id_Byte_19 "Software ID. Set to P826vxx or to P662vxx";
CM_ SG_ 2566838921 Appl_Id_Byte_20 "Software ID. Set to P826vxx or to P662vxx";
CM_ SG_ 2566838921 Appl_Id_Byte_21 "Software ID. Set to P826vxx or to P662vxx";
CM_ SG_ 2566838921 Appl_Id_Byte_22 "Software ID. Set to P826vxx or to P662vxx";
CM_ SG_ 2566838921 Appl_Id_Byte_23 "Software ID. Set to P826vxx or to P662vxx";
CM_ SG_ 2566838921 Appl_Id_Byte_24 "Software ID. Set to P826vxx or to P662vxx";
CM_ SG_ 2566838921 Appl_Id_Byte_25 "Software ID. Set to P826vxx or to P662vxx";
CM_ SG_ 2566838921 Appl_Id_Byte_26 "Software ID. Set to P826vxx or to P662vxx";
CM_ SG_ 2566838921 Appl_Id_Byte_27 "Software ID. Set to P826vxx or to P662vxx";
CM_ SG_ 2566838921 Appl_Id_Byte_28 "Software ID. Set to P826vxx or to P662vxx";
CM_ SG_ 2566838921 Appl_Id_Byte_29 "Software ID. Set to P826vxx or to P662vxx";
CM_ SG_ 2566838921 Appl_Id_Byte_30 "Software ID. Set to P826vxx or to P662vxx";
CM_ SG_ 2566838921 Appl_Id_Byte_31 "Software ID. Set to P826vxx or to P662vxx";
CM_ SG_ 2566838921 Appl_Id_Byte_32 "Software ID. Set to P826vxx or to P662vxx";
CM_ SG_ 2566838921 Appl_Id_Byte_33 "Software ID. Set to P826vxx or to P662vxx";
CM_ SG_ 2566838921 Appl_Id_Byte_34 "Software ID. Set to P826vxx or to P662vxx";
CM_ SG_ 2566838921 Appl_Id_Byte_35 "Software ID. Set to P826vxx or to P662vxx";
CM_ SG_ 2566838921 Appl_Id_Byte_36 "Software ID. Set to P826vxx or to P662vxx";
CM_ SG_ 2566838921 Appl_Id_Byte_37 "Software ID. Set to P826vxx or to P662vxx";
CM_ SG_ 2566838921 Appl_Id_Byte_38 "Software ID. Set to P826vxx or to P662vxx";
CM_ SG_ 2566838921 Appl_Id_Byte_39 "Software ID. Set to P826vxx or to P662vxx";
CM_ SG_ 2566838921 Appl_Id_Enum "Software ID.";
CM_ SG_ 2566838921 Bootloader_Id "Software ID.";
CM_ SG_ 2566838921 Bootloader_Id_Byte_01 "Software ID.";
CM_ SG_ 2566838921 Bootloader_Id_Byte_02 "Software ID.";
CM_ SG_ 2566838921 Bootloader_Id_Byte_03 "Software ID.";
CM_ SG_ 2566838921 Bootloader_Id_Byte_04 "Software ID.";
CM_ SG_ 2566838921 Bootloader_Id_Byte_05 "Software ID.";
CM_ BO_ 2566866048 "The message is used 'On event' to configure the valves. Every byte not used, to be set 0xFF.";
CM_ SG_ 2566866048 EHR_ChksumSW "Calculated checksum of the application software.";
CM_ SG_ 2566866048 EHR_EvNumParamMux_12 "A status signal indicating the EHR valve number. Used for front & rear EHR's.";
CM_ SG_ 2566866048 EHR_ParamStsByte_2 "The signal has a fix value 0x3B";
CM_ SG_ 2566866048 EHR_RmpRndng "A status signal indicating the EHR valve number. Used for front & rear EHR's.";
CM_ BO_ 2566866049 "The message is used 'On event' to configure the valves. Every byte not used, to be set 0xFF.";
CM_ SG_ 2566866049 EHR_ChksumSW "Calculated checksum of the application software.";
CM_ SG_ 2566866049 EHR_EvNumParamMux_12 "A status signal indicating the EHR valve number. Used for front & rear EHR's.";
CM_ SG_ 2566866049 EHR_ParamStsByte_2 "The signal has a fix value 0x3B";
CM_ SG_ 2566866049 EHR_RmpRndng "A status signal indicating the EHR valve number. Used for front & rear EHR's.";
CM_ BO_ 2566866050 "The message is used 'On event' to configure the valves. Every byte not used, to be set 0xFF.";
CM_ SG_ 2566866050 EHR_ChksumSW "Calculated checksum of the application software.";
CM_ SG_ 2566866050 EHR_EvNumParamMux_12 "A status signal indicating the EHR valve number. Used for front & rear EHR's.";
CM_ SG_ 2566866050 EHR_ParamStsByte_2 "The signal has a fix value 0x3B";
CM_ SG_ 2566866050 EHR_RmpRndng "A status signal indicating the EHR valve number. Used for front & rear EHR's.";
CM_ BO_ 2566866051 "The message is used 'On event' to configure the valves. Every byte not used, to be set 0xFF.";
CM_ SG_ 2566866051 EHR_ChksumSW "Calculated checksum of the application software.";
CM_ SG_ 2566866051 EHR_EvNumParamMux_12 "A status signal indicating the EHR valve number. Used for front & rear EHR's.";
CM_ SG_ 2566866051 EHR_ParamStsByte_2 "The signal has a fix value 0x3B";
CM_ SG_ 2566866051 EHR_RmpRndng "A status signal indicating the EHR valve number. Used for front & rear EHR's.";
BA_DEF_ SG_  "GenSigReceiveSetting" STRING ;
BA_DEF_ SG_  "GenSigPreSetting" STRING ;
BA_DEF_ SG_  "GenSigPreIfSetting" STRING ;
BA_DEF_ SG_  "GenSigPostSetting" STRING ;
BA_DEF_ SG_  "GenSigPostIfSetting" STRING ;
BA_DEF_ SG_  "GenSigEnvVarType" ENUM  "int","float","undef";
BA_DEF_ SG_  "GenSigConditionalSend" STRING ;
BA_DEF_ SG_  "GenSigAutoGenSnd" ENUM  "No","Yes";
BA_DEF_ SG_  "GenSigAutoGenDsp" ENUM  "No","Yes";
BA_DEF_ SG_  "GenSigAssignSetting" STRING ;
BA_DEF_ SG_  "GenSigAltSetting" STRING ;
BA_DEF_ SG_  "SPN_Definition" STRING ;
BA_DEF_ SG_  "External_Reference_decod" STRING ;
BA_DEF_ SG_  "UtilizationOnNetwork" ENUM  "Used","NOT USED";
BA_DEF_ SG_  "CI_RepetitionNum" ENUM  "1","2";
BA_DEF_ SG_  "CI_RepetitionType" ENUM  "NA","1","2","3","4";
BA_DEF_ SG_  "CI_RepetitionComplemented" ENUM  "0","1","vector_leerstring";
BA_DEF_ SG_  "DDI" INT 0 65535;
BA_DEF_ SG_  "CI_FullName" STRING ;
BA_DEF_ SG_  "GenSigTimeoutTime" INT 0 3600000;
BA_DEF_ SG_  "CI_ParId" STRING ;
BA_DEF_ SG_  "CI_SLOT_Name" STRING ;
BA_DEF_ SG_  "CI_ParVersion" STRING ;
BA_DEF_ SG_  "GenSigSendType" ENUM  "Cyclic","OnWrite","OnWriteWithRepetition","OnChange","OnChangeWithRepetition","IfActive","IfActiveWithRepetition","NoSigSendType";
BA_DEF_ SG_  "GenSigInactiveValue" INT 0 2147483647;
BA_DEF_ SG_  "GenSigStartValue" INT 0 2147483647;
BA_DEF_ SG_  "GenSigEVName" STRING ;
BA_DEF_ SG_  "SPN" INT 0 524287;
BA_DEF_ SG_  "SigType" ENUM  "Default","Range","RangeSigned","ASCII","Discrete","Control","ReferencePGN","DTC","StringDelimiter","StringLength","StringLengthControl";
BA_DEF_ SG_  "GenSigILSupport" ENUM  "Yes","No";
BA_DEF_ BO_  "ShowSignals" INT -1 0;
BA_DEF_ BO_  "GroupSignals" INT 1 100;
BA_DEF_ BO_  "PGN_Definition" STRING ;
BA_DEF_ BO_  "External_Reference" STRING ;
BA_DEF_ BO_  "SingleFrame" INT 0 1;
BA_DEF_ BO_  "CI_AllowedLostMessages" ENUM  "NA","0","1","2","3","4";
BA_DEF_ BO_  "CI_AliveTimeout" INT 0 3600000;
BA_DEF_ BO_  "TpJ1939VarDlc" ENUM  "No","Yes";
BA_DEF_ BO_  "CI_ShowSignals" INT -1 0;
BA_DEF_ BO_  "CI_PgVersion" STRING ;
BA_DEF_ BO_  "CI_GroupSignals" INT 1 100;
BA_DEF_ BO_  "DiagUUDTResponse" ENUM  "No","Yes";
BA_DEF_ BO_  "DiagState" ENUM  "No","Yes";
BA_DEF_ BO_  "DiagResponse" ENUM  "No","Yes";
BA_DEF_ BO_  "DiagRequest" ENUM  "No","Yes";
BA_DEF_ BO_  "DiagConnection" INT 0 65535;
BA_DEF_ BO_  "GenMsgNrOfRepetition" INT 0 1000000;
BA_DEF_ BO_  "GenMsgILSupport" ENUM  "No","Yes";
BA_DEF_ BO_  "GenMsgFastOnStart" INT 0 100000;
BA_DEF_ BO_  "GenMsgCycleTimeFast" INT 0 3600000;
BA_DEF_ BO_  "GenMsgStartDelayTime" INT 0 100000;
BA_DEF_ BO_  "GenMsgDelayTime" INT 0 3600000;
BA_DEF_ BO_  "VFrameFormat" ENUM  "StandardCAN","ExtendedCAN","reserved","J1939PG";
BA_DEF_ BO_  "GenMsgCycleTime" INT 0 3600000;
BA_DEF_ BO_  "GenMsgRequestable" INT 0 1;
BA_DEF_ BO_  "GenMsgSendType" ENUM  "cyclic","reserved","cyclicIfActive","reserved","reserved","reserved","reserved","reserved","noMsgSendType";
BA_DEF_DEF_  "GenSigReceiveSetting" "";
BA_DEF_DEF_  "GenSigPreSetting" "";
BA_DEF_DEF_  "GenSigPreIfSetting" "";
BA_DEF_DEF_  "GenSigPostSetting" "";
BA_DEF_DEF_  "GenSigPostIfSetting" "";
BA_DEF_DEF_  "GenSigEnvVarType" "undef";
BA_DEF_DEF_  "GenSigConditionalSend" "";
BA_DEF_DEF_  "GenSigAutoGenSnd" "";
BA_DEF_DEF_  "GenSigAutoGenDsp" "";
BA_DEF_DEF_  "GenSigAssignSetting" "";
BA_DEF_DEF_  "GenSigAltSetting" "";
BA_DEF_DEF_  "SPN_Definition" "";
BA_DEF_DEF_  "External_Reference_decod" "";
BA_DEF_DEF_  "UtilizationOnNetwork" "Used";
BA_DEF_DEF_  "CI_RepetitionNum" "1";
BA_DEF_DEF_  "CI_RepetitionType" "NA";
BA_DEF_DEF_  "CI_RepetitionComplemented" "0";
BA_DEF_DEF_  "DDI" 0;
BA_DEF_DEF_  "CI_FullName" "";
BA_DEF_DEF_  "GenSigTimeoutTime" 0;
BA_DEF_DEF_  "CI_ParId" "";
BA_DEF_DEF_  "CI_SLOT_Name" "0";
BA_DEF_DEF_  "CI_ParVersion" "0";
BA_DEF_DEF_  "GenSigSendType" "NoSigSendType";
BA_DEF_DEF_  "GenSigInactiveValue" 0;
BA_DEF_DEF_  "GenSigStartValue" 0;
BA_DEF_DEF_  "GenSigEVName" "Env@Nodename_@Signame";
BA_DEF_DEF_  "SPN" 0;
BA_DEF_DEF_  "SigType" "Default";
BA_DEF_DEF_  "GenSigILSupport" "Yes";
BA_DEF_DEF_  "ShowSignals" -1;
BA_DEF_DEF_  "GroupSignals" 1;
BA_DEF_DEF_  "PGN_Definition" "N/A";
BA_DEF_DEF_  "External_Reference" "";
BA_DEF_DEF_  "SingleFrame" 1;
BA_DEF_DEF_  "CI_AllowedLostMessages" "NA";
BA_DEF_DEF_  "CI_AliveTimeout" 0;
BA_DEF_DEF_  "TpJ1939VarDlc" "No";
BA_DEF_DEF_  "CI_ShowSignals" -1;
BA_DEF_DEF_  "CI_PgVersion" "0";
BA_DEF_DEF_  "CI_GroupSignals" 1;
BA_DEF_DEF_  "DiagUUDTResponse" "No";
BA_DEF_DEF_  "DiagState" "No";
BA_DEF_DEF_  "DiagResponse" "No";
BA_DEF_DEF_  "DiagRequest" "No";
BA_DEF_DEF_  "DiagConnection" 0;
BA_DEF_DEF_  "GenMsgNrOfRepetition" 0;
BA_DEF_DEF_  "GenMsgILSupport" "Yes";
BA_DEF_DEF_  "GenMsgFastOnStart" 0;
BA_DEF_DEF_  "GenMsgCycleTimeFast" 0;
BA_DEF_DEF_  "GenMsgStartDelayTime" 0;
BA_DEF_DEF_  "GenMsgDelayTime" 1;
BA_DEF_DEF_  "VFrameFormat" "J1939PG";
BA_DEF_DEF_  "GenMsgCycleTime" 0;
BA_DEF_DEF_  "GenMsgRequestable" 0;
BA_DEF_DEF_  "GenMsgSendType" "noMsgSendType";
BA_ "PGN_Definition" BO_ 2566838913 "J1939 Standard";
BA_ "CI_ShowSignals" BO_ 2566838913 0;
BA_ "CI_PgVersion" BO_ 2566838913 "-1";
BA_ "CI_GroupSignals" BO_ 2566838913 10;
BA_ "GenMsgRequestable" BO_ 2566838913 1;
BA_ "PGN_Definition" BO_ 2566838914 "J1939 Standard";
BA_ "CI_ShowSignals" BO_ 2566838914 0;
BA_ "CI_PgVersion" BO_ 2566838914 "-1";
BA_ "CI_GroupSignals" BO_ 2566838914 10;
BA_ "GenMsgRequestable" BO_ 2566838914 1;
BA_ "PGN_Definition" BO_ 2566838915 "J1939 Standard";
BA_ "CI_ShowSignals" BO_ 2566838915 0;
BA_ "CI_PgVersion" BO_ 2566838915 "-1";
BA_ "CI_GroupSignals" BO_ 2566838915 10;
BA_ "GenMsgRequestable" BO_ 2566838915 1;
BA_ "PGN_Definition" BO_ 2566838916 "J1939 Standard";
BA_ "CI_ShowSignals" BO_ 2566838916 0;
BA_ "CI_PgVersion" BO_ 2566838916 "-1";
BA_ "CI_GroupSignals" BO_ 2566838916 10;
BA_ "GenMsgRequestable" BO_ 2566838916 1;
BA_ "PGN_Definition" BO_ 2566838921 "J1939 Standard";
BA_ "CI_ShowSignals" BO_ 2566838921 0;
BA_ "CI_PgVersion" BO_ 2566838921 "-1";
BA_ "CI_GroupSignals" BO_ 2566838921 10;
BA_ "GenMsgRequestable" BO_ 2566838921 1;
BA_ "CI_ShowSignals" BO_ 2566866049 0;
BA_ "CI_ShowSignals" BO_ 2566866050 0;
BA_ "CI_ShowSignals" BO_ 2566866051 0;
BA_ "CI_FullName" SG_ 2566838913 Appl_Id "Software Identification";
BA_ "CI_ParId" SG_ 2566838913 Appl_Id "ESMD_03139";
BA_ "CI_SLOT_Name" SG_ 2566838913 Appl_Id "SAEatad0200";
BA_ "SPN" SG_ 2566838913 Appl_Id 234;
BA_ "CI_FullName" SG_ 2566838913 Appl_Id_Byte_01 "Software Identification";
BA_ "CI_ParId" SG_ 2566838913 Appl_Id_Byte_01 "ESMD_03139";
BA_ "CI_SLOT_Name" SG_ 2566838913 Appl_Id_Byte_01 "SAEatad0200";
BA_ "SPN" SG_ 2566838913 Appl_Id_Byte_01 234;
BA_ "CI_FullName" SG_ 2566838913 Appl_Id_Byte_02 "Software Identification";
BA_ "CI_ParId" SG_ 2566838913 Appl_Id_Byte_02 "ESMD_03139";
BA_ "CI_SLOT_Name" SG_ 2566838913 Appl_Id_Byte_02 "SAEatad0200";
BA_ "SPN" SG_ 2566838913 Appl_Id_Byte_02 234;
BA_ "CI_FullName" SG_ 2566838913 Appl_Id_Byte_03 "Software Identification";
BA_ "CI_ParId" SG_ 2566838913 Appl_Id_Byte_03 "ESMD_03139";
BA_ "CI_SLOT_Name" SG_ 2566838913 Appl_Id_Byte_03 "SAEatad0200";
BA_ "SPN" SG_ 2566838913 Appl_Id_Byte_03 234;
BA_ "CI_FullName" SG_ 2566838913 Appl_Id_Byte_04 "Software Identification";
BA_ "CI_ParId" SG_ 2566838913 Appl_Id_Byte_04 "ESMD_03139";
BA_ "CI_SLOT_Name" SG_ 2566838913 Appl_Id_Byte_04 "SAEatad0200";
BA_ "SPN" SG_ 2566838913 Appl_Id_Byte_04 234;
BA_ "CI_FullName" SG_ 2566838913 Appl_Id_Byte_05 "Software Identification";
BA_ "CI_ParId" SG_ 2566838913 Appl_Id_Byte_05 "ESMD_03139";
BA_ "CI_SLOT_Name" SG_ 2566838913 Appl_Id_Byte_05 "SAEatad0200";
BA_ "SPN" SG_ 2566838913 Appl_Id_Byte_05 234;
BA_ "CI_FullName" SG_ 2566838913 Appl_Id_Byte_06 "Software Identification";
BA_ "CI_ParId" SG_ 2566838913 Appl_Id_Byte_06 "ESMD_03139";
BA_ "CI_SLOT_Name" SG_ 2566838913 Appl_Id_Byte_06 "SAEatad0200";
BA_ "SPN" SG_ 2566838913 Appl_Id_Byte_06 234;
BA_ "CI_FullName" SG_ 2566838913 Appl_Id_Byte_07 "Software Identification";
BA_ "CI_ParId" SG_ 2566838913 Appl_Id_Byte_07 "ESMD_03139";
BA_ "CI_SLOT_Name" SG_ 2566838913 Appl_Id_Byte_07 "SAEatad0200";
BA_ "SPN" SG_ 2566838913 Appl_Id_Byte_07 234;
BA_ "CI_FullName" SG_ 2566838913 Appl_Id_Byte_08 "Software Identification";
BA_ "CI_ParId" SG_ 2566838913 Appl_Id_Byte_08 "ESMD_03139";
BA_ "CI_SLOT_Name" SG_ 2566838913 Appl_Id_Byte_08 "SAEatad0200";
BA_ "SPN" SG_ 2566838913 Appl_Id_Byte_08 234;
BA_ "CI_FullName" SG_ 2566838913 Appl_Id_Byte_09 "Software Identification";
BA_ "CI_ParId" SG_ 2566838913 Appl_Id_Byte_09 "ESMD_03139";
BA_ "CI_SLOT_Name" SG_ 2566838913 Appl_Id_Byte_09 "SAEatad0200";
BA_ "SPN" SG_ 2566838913 Appl_Id_Byte_09 234;
BA_ "CI_FullName" SG_ 2566838913 Appl_Id_Byte_10 "Software Identification";
BA_ "CI_ParId" SG_ 2566838913 Appl_Id_Byte_10 "ESMD_03139";
BA_ "CI_SLOT_Name" SG_ 2566838913 Appl_Id_Byte_10 "SAEatad0200";
BA_ "SPN" SG_ 2566838913 Appl_Id_Byte_10 234;
BA_ "CI_FullName" SG_ 2566838913 Appl_Id_Byte_11 "Software Identification";
BA_ "CI_ParId" SG_ 2566838913 Appl_Id_Byte_11 "ESMD_03139";
BA_ "CI_SLOT_Name" SG_ 2566838913 Appl_Id_Byte_11 "SAEatad0200";
BA_ "SPN" SG_ 2566838913 Appl_Id_Byte_11 234;
BA_ "CI_FullName" SG_ 2566838913 Appl_Id_Byte_12 "Software Identification";
BA_ "CI_ParId" SG_ 2566838913 Appl_Id_Byte_12 "ESMD_03139";
BA_ "CI_SLOT_Name" SG_ 2566838913 Appl_Id_Byte_12 "SAEatad0200";
BA_ "SPN" SG_ 2566838913 Appl_Id_Byte_12 234;
BA_ "CI_FullName" SG_ 2566838913 Appl_Id_Byte_13 "Software Identification";
BA_ "CI_ParId" SG_ 2566838913 Appl_Id_Byte_13 "ESMD_03139";
BA_ "CI_SLOT_Name" SG_ 2566838913 Appl_Id_Byte_13 "SAEatad0200";
BA_ "SPN" SG_ 2566838913 Appl_Id_Byte_13 234;
BA_ "CI_FullName" SG_ 2566838913 Appl_Id_Byte_14 "Software Identification";
BA_ "CI_ParId" SG_ 2566838913 Appl_Id_Byte_14 "ESMD_03139";
BA_ "CI_SLOT_Name" SG_ 2566838913 Appl_Id_Byte_14 "SAEatad0200";
BA_ "SPN" SG_ 2566838913 Appl_Id_Byte_14 234;
BA_ "CI_FullName" SG_ 2566838913 Appl_Id_Byte_15 "Software Identification";
BA_ "CI_ParId" SG_ 2566838913 Appl_Id_Byte_15 "ESMD_03139";
BA_ "CI_SLOT_Name" SG_ 2566838913 Appl_Id_Byte_15 "SAEatad0200";
BA_ "SPN" SG_ 2566838913 Appl_Id_Byte_15 234;
BA_ "CI_FullName" SG_ 2566838913 Appl_Id_Byte_16 "Software Identification";
BA_ "CI_ParId" SG_ 2566838913 Appl_Id_Byte_16 "ESMD_03139";
BA_ "CI_SLOT_Name" SG_ 2566838913 Appl_Id_Byte_16 "SAEatad0200";
BA_ "SPN" SG_ 2566838913 Appl_Id_Byte_16 234;
BA_ "CI_FullName" SG_ 2566838913 Appl_Id_Byte_17 "Software Identification";
BA_ "CI_ParId" SG_ 2566838913 Appl_Id_Byte_17 "ESMD_03139";
BA_ "CI_SLOT_Name" SG_ 2566838913 Appl_Id_Byte_17 "SAEatad0200";
BA_ "SPN" SG_ 2566838913 Appl_Id_Byte_17 234;
BA_ "CI_FullName" SG_ 2566838913 Appl_Id_Byte_18 "Software Identification";
BA_ "CI_ParId" SG_ 2566838913 Appl_Id_Byte_18 "ESMD_03139";
BA_ "CI_SLOT_Name" SG_ 2566838913 Appl_Id_Byte_18 "SAEatad0200";
BA_ "SPN" SG_ 2566838913 Appl_Id_Byte_18 234;
BA_ "CI_FullName" SG_ 2566838913 Appl_Id_Byte_19 "Software Identification";
BA_ "CI_ParId" SG_ 2566838913 Appl_Id_Byte_19 "ESMD_03139";
BA_ "CI_SLOT_Name" SG_ 2566838913 Appl_Id_Byte_19 "SAEatad0200";
BA_ "SPN" SG_ 2566838913 Appl_Id_Byte_19 234;
BA_ "CI_FullName" SG_ 2566838913 Appl_Id_Byte_20 "Software Identification";
BA_ "CI_ParId" SG_ 2566838913 Appl_Id_Byte_20 "ESMD_03139";
BA_ "CI_SLOT_Name" SG_ 2566838913 Appl_Id_Byte_20 "SAEatad0200";
BA_ "SPN" SG_ 2566838913 Appl_Id_Byte_20 234;
BA_ "CI_FullName" SG_ 2566838913 Appl_Id_Byte_21 "Software Identification";
BA_ "CI_ParId" SG_ 2566838913 Appl_Id_Byte_21 "ESMD_03139";
BA_ "CI_SLOT_Name" SG_ 2566838913 Appl_Id_Byte_21 "SAEatad0200";
BA_ "SPN" SG_ 2566838913 Appl_Id_Byte_21 234;
BA_ "CI_FullName" SG_ 2566838913 Appl_Id_Byte_22 "Software Identification";
BA_ "CI_ParId" SG_ 2566838913 Appl_Id_Byte_22 "ESMD_03139";
BA_ "CI_SLOT_Name" SG_ 2566838913 Appl_Id_Byte_22 "SAEatad0200";
BA_ "SPN" SG_ 2566838913 Appl_Id_Byte_22 234;
BA_ "CI_FullName" SG_ 2566838913 Appl_Id_Byte_23 "Software Identification";
BA_ "CI_ParId" SG_ 2566838913 Appl_Id_Byte_23 "ESMD_03139";
BA_ "CI_SLOT_Name" SG_ 2566838913 Appl_Id_Byte_23 "SAEatad0200";
BA_ "SPN" SG_ 2566838913 Appl_Id_Byte_23 234;
BA_ "CI_FullName" SG_ 2566838913 Appl_Id_Byte_24 "Software Identification";
BA_ "CI_ParId" SG_ 2566838913 Appl_Id_Byte_24 "ESMD_03139";
BA_ "CI_SLOT_Name" SG_ 2566838913 Appl_Id_Byte_24 "SAEatad0200";
BA_ "SPN" SG_ 2566838913 Appl_Id_Byte_24 234;
BA_ "CI_FullName" SG_ 2566838913 Appl_Id_Byte_25 "Software Identification";
BA_ "CI_ParId" SG_ 2566838913 Appl_Id_Byte_25 "ESMD_03139";
BA_ "CI_SLOT_Name" SG_ 2566838913 Appl_Id_Byte_25 "SAEatad0200";
BA_ "SPN" SG_ 2566838913 Appl_Id_Byte_25 234;
BA_ "CI_FullName" SG_ 2566838913 Appl_Id_Byte_26 "Software Identification";
BA_ "CI_ParId" SG_ 2566838913 Appl_Id_Byte_26 "ESMD_03139";
BA_ "CI_SLOT_Name" SG_ 2566838913 Appl_Id_Byte_26 "SAEatad0200";
BA_ "SPN" SG_ 2566838913 Appl_Id_Byte_26 234;
BA_ "CI_FullName" SG_ 2566838913 Appl_Id_Byte_27 "Software Identification";
BA_ "CI_ParId" SG_ 2566838913 Appl_Id_Byte_27 "ESMD_03139";
BA_ "CI_SLOT_Name" SG_ 2566838913 Appl_Id_Byte_27 "SAEatad0200";
BA_ "SPN" SG_ 2566838913 Appl_Id_Byte_27 234;
BA_ "CI_FullName" SG_ 2566838913 Appl_Id_Byte_28 "Software Identification";
BA_ "CI_ParId" SG_ 2566838913 Appl_Id_Byte_28 "ESMD_03139";
BA_ "CI_SLOT_Name" SG_ 2566838913 Appl_Id_Byte_28 "SAEatad0200";
BA_ "SPN" SG_ 2566838913 Appl_Id_Byte_28 234;
BA_ "CI_FullName" SG_ 2566838913 Appl_Id_Byte_29 "Software Identification";
BA_ "CI_ParId" SG_ 2566838913 Appl_Id_Byte_29 "ESMD_03139";
BA_ "CI_SLOT_Name" SG_ 2566838913 Appl_Id_Byte_29 "SAEatad0200";
BA_ "SPN" SG_ 2566838913 Appl_Id_Byte_29 234;
BA_ "CI_FullName" SG_ 2566838913 Appl_Id_Byte_30 "Software Identification";
BA_ "CI_ParId" SG_ 2566838913 Appl_Id_Byte_30 "ESMD_03139";
BA_ "CI_SLOT_Name" SG_ 2566838913 Appl_Id_Byte_30 "SAEatad0200";
BA_ "SPN" SG_ 2566838913 Appl_Id_Byte_30 234;
BA_ "CI_FullName" SG_ 2566838913 Appl_Id_Byte_31 "Software Identification";
BA_ "CI_ParId" SG_ 2566838913 Appl_Id_Byte_31 "ESMD_03139";
BA_ "CI_SLOT_Name" SG_ 2566838913 Appl_Id_Byte_31 "SAEatad0200";
BA_ "SPN" SG_ 2566838913 Appl_Id_Byte_31 234;
BA_ "CI_FullName" SG_ 2566838913 Appl_Id_Byte_32 "Software Identification";
BA_ "CI_ParId" SG_ 2566838913 Appl_Id_Byte_32 "ESMD_03139";
BA_ "CI_SLOT_Name" SG_ 2566838913 Appl_Id_Byte_32 "SAEatad0200";
BA_ "SPN" SG_ 2566838913 Appl_Id_Byte_32 234;
BA_ "CI_FullName" SG_ 2566838913 Appl_Id_Byte_33 "Software Identification";
BA_ "CI_ParId" SG_ 2566838913 Appl_Id_Byte_33 "ESMD_03139";
BA_ "CI_SLOT_Name" SG_ 2566838913 Appl_Id_Byte_33 "SAEatad0200";
BA_ "SPN" SG_ 2566838913 Appl_Id_Byte_33 234;
BA_ "CI_FullName" SG_ 2566838913 Appl_Id_Byte_34 "Software Identification";
BA_ "CI_ParId" SG_ 2566838913 Appl_Id_Byte_34 "ESMD_03139";
BA_ "CI_SLOT_Name" SG_ 2566838913 Appl_Id_Byte_34 "SAEatad0200";
BA_ "SPN" SG_ 2566838913 Appl_Id_Byte_34 234;
BA_ "CI_FullName" SG_ 2566838913 Appl_Id_Byte_35 "Software Identification";
BA_ "CI_ParId" SG_ 2566838913 Appl_Id_Byte_35 "ESMD_03139";
BA_ "CI_SLOT_Name" SG_ 2566838913 Appl_Id_Byte_35 "SAEatad0200";
BA_ "SPN" SG_ 2566838913 Appl_Id_Byte_35 234;
BA_ "CI_FullName" SG_ 2566838913 Appl_Id_Byte_36 "Software Identification";
BA_ "CI_ParId" SG_ 2566838913 Appl_Id_Byte_36 "ESMD_03139";
BA_ "CI_SLOT_Name" SG_ 2566838913 Appl_Id_Byte_36 "SAEatad0200";
BA_ "SPN" SG_ 2566838913 Appl_Id_Byte_36 234;
BA_ "CI_FullName" SG_ 2566838913 Appl_Id_Byte_37 "Software Identification";
BA_ "CI_ParId" SG_ 2566838913 Appl_Id_Byte_37 "ESMD_03139";
BA_ "CI_SLOT_Name" SG_ 2566838913 Appl_Id_Byte_37 "SAEatad0200";
BA_ "SPN" SG_ 2566838913 Appl_Id_Byte_37 234;
BA_ "CI_FullName" SG_ 2566838913 Appl_Id_Byte_38 "Software Identification";
BA_ "CI_ParId" SG_ 2566838913 Appl_Id_Byte_38 "ESMD_03139";
BA_ "CI_SLOT_Name" SG_ 2566838913 Appl_Id_Byte_38 "SAEatad0200";
BA_ "SPN" SG_ 2566838913 Appl_Id_Byte_38 234;
BA_ "CI_FullName" SG_ 2566838913 Appl_Id_Byte_39 "Software Identification";
BA_ "CI_ParId" SG_ 2566838913 Appl_Id_Byte_39 "ESMD_03139";
BA_ "CI_SLOT_Name" SG_ 2566838913 Appl_Id_Byte_39 "SAEatad0200";
BA_ "SPN" SG_ 2566838913 Appl_Id_Byte_39 234;
BA_ "CI_FullName" SG_ 2566838913 Appl_Id_Enum "Software Identification";
BA_ "CI_ParId" SG_ 2566838913 Appl_Id_Enum "ESMD_03139";
BA_ "CI_SLOT_Name" SG_ 2566838913 Appl_Id_Enum "SAEbs24";
BA_ "SPN" SG_ 2566838913 Appl_Id_Enum 234;
BA_ "CI_FullName" SG_ 2566838913 Bootloader_Id "Software Identification";
BA_ "CI_ParId" SG_ 2566838913 Bootloader_Id "ESMD_03139";
BA_ "CI_SLOT_Name" SG_ 2566838913 Bootloader_Id "SAEatad0200";
BA_ "SPN" SG_ 2566838913 Bootloader_Id 234;
BA_ "CI_FullName" SG_ 2566838913 Bootloader_Id_Byte_01 "Software Identification";
BA_ "CI_ParId" SG_ 2566838913 Bootloader_Id_Byte_01 "ESMD_03139";
BA_ "CI_SLOT_Name" SG_ 2566838913 Bootloader_Id_Byte_01 "SAEatad0200";
BA_ "SPN" SG_ 2566838913 Bootloader_Id_Byte_01 234;
BA_ "CI_FullName" SG_ 2566838913 Bootloader_Id_Byte_02 "Software Identification";
BA_ "CI_ParId" SG_ 2566838913 Bootloader_Id_Byte_02 "ESMD_03139";
BA_ "CI_SLOT_Name" SG_ 2566838913 Bootloader_Id_Byte_02 "SAEatad0200";
BA_ "SPN" SG_ 2566838913 Bootloader_Id_Byte_02 234;
BA_ "CI_FullName" SG_ 2566838913 Bootloader_Id_Byte_03 "Software Identification";
BA_ "CI_ParId" SG_ 2566838913 Bootloader_Id_Byte_03 "ESMD_03139";
BA_ "CI_SLOT_Name" SG_ 2566838913 Bootloader_Id_Byte_03 "SAEatad0200";
BA_ "SPN" SG_ 2566838913 Bootloader_Id_Byte_03 234;
BA_ "CI_FullName" SG_ 2566838913 Bootloader_Id_Byte_04 "Software Identification";
BA_ "CI_ParId" SG_ 2566838913 Bootloader_Id_Byte_04 "ESMD_03139";
BA_ "CI_SLOT_Name" SG_ 2566838913 Bootloader_Id_Byte_04 "SAEatad0200";
BA_ "SPN" SG_ 2566838913 Bootloader_Id_Byte_04 234;
BA_ "CI_FullName" SG_ 2566838913 Bootloader_Id_Byte_05 "Software Identification";
BA_ "CI_ParId" SG_ 2566838913 Bootloader_Id_Byte_05 "ESMD_03139";
BA_ "CI_SLOT_Name" SG_ 2566838913 Bootloader_Id_Byte_05 "SAEatad0200";
BA_ "SPN" SG_ 2566838913 Bootloader_Id_Byte_05 234;
BA_ "CI_FullName" SG_ 2566838913 Bootloader_Id_Byte_06 "Software Identification";
BA_ "CI_ParId" SG_ 2566838913 Bootloader_Id_Byte_06 "ESMD_03139";
BA_ "CI_SLOT_Name" SG_ 2566838913 Bootloader_Id_Byte_06 "SAEatad0200";
BA_ "SPN" SG_ 2566838913 Bootloader_Id_Byte_06 234;
BA_ "CI_FullName" SG_ 2566838913 Bootloader_Id_Byte_07 "Software Identification";
BA_ "CI_ParId" SG_ 2566838913 Bootloader_Id_Byte_07 "ESMD_03139";
BA_ "CI_SLOT_Name" SG_ 2566838913 Bootloader_Id_Byte_07 "SAEatad0200";
BA_ "SPN" SG_ 2566838913 Bootloader_Id_Byte_07 234;
BA_ "CI_FullName" SG_ 2566838913 Bootloader_Id_Byte_08 "Software Identification";
BA_ "CI_ParId" SG_ 2566838913 Bootloader_Id_Byte_08 "ESMD_03139";
BA_ "CI_SLOT_Name" SG_ 2566838913 Bootloader_Id_Byte_08 "SAEatad0200";
BA_ "SPN" SG_ 2566838913 Bootloader_Id_Byte_08 234;
BA_ "CI_FullName" SG_ 2566838913 Bootloader_Id_Byte_09 "Software Identification";
BA_ "CI_ParId" SG_ 2566838913 Bootloader_Id_Byte_09 "ESMD_03139";
BA_ "CI_SLOT_Name" SG_ 2566838913 Bootloader_Id_Byte_09 "SAEatad0200";
BA_ "SPN" SG_ 2566838913 Bootloader_Id_Byte_09 234;
BA_ "CI_FullName" SG_ 2566838913 Bootloader_Id_Byte_10 "Software Identification";
BA_ "CI_ParId" SG_ 2566838913 Bootloader_Id_Byte_10 "ESMD_03139";
BA_ "CI_SLOT_Name" SG_ 2566838913 Bootloader_Id_Byte_10 "SAEatad0200";
BA_ "SPN" SG_ 2566838913 Bootloader_Id_Byte_10 234;
BA_ "CI_FullName" SG_ 2566838913 Bootloader_Id_Byte_11 "Software Identification";
BA_ "CI_ParId" SG_ 2566838913 Bootloader_Id_Byte_11 "ESMD_03139";
BA_ "CI_SLOT_Name" SG_ 2566838913 Bootloader_Id_Byte_11 "SAEatad0200";
BA_ "SPN" SG_ 2566838913 Bootloader_Id_Byte_11 234;
BA_ "CI_FullName" SG_ 2566838913 Bootloader_Id_Byte_12 "Software Identification";
BA_ "CI_ParId" SG_ 2566838913 Bootloader_Id_Byte_12 "ESMD_03139";
BA_ "CI_SLOT_Name" SG_ 2566838913 Bootloader_Id_Byte_12 "SAEatad0200";
BA_ "SPN" SG_ 2566838913 Bootloader_Id_Byte_12 234;
BA_ "CI_FullName" SG_ 2566838913 Bootloader_Id_Byte_13 "Software Identification";
BA_ "CI_ParId" SG_ 2566838913 Bootloader_Id_Byte_13 "ESMD_03139";
BA_ "CI_SLOT_Name" SG_ 2566838913 Bootloader_Id_Byte_13 "SAEatad0200";
BA_ "SPN" SG_ 2566838913 Bootloader_Id_Byte_13 234;
BA_ "CI_FullName" SG_ 2566838913 Bootloader_Id_Byte_14 "Software Identification";
BA_ "CI_ParId" SG_ 2566838913 Bootloader_Id_Byte_14 "ESMD_03139";
BA_ "CI_SLOT_Name" SG_ 2566838913 Bootloader_Id_Byte_14 "SAEatad0200";
BA_ "SPN" SG_ 2566838913 Bootloader_Id_Byte_14 234;
BA_ "CI_FullName" SG_ 2566838913 Bootloader_Id_Byte_15 "Software Identification";
BA_ "CI_ParId" SG_ 2566838913 Bootloader_Id_Byte_15 "ESMD_03139";
BA_ "CI_SLOT_Name" SG_ 2566838913 Bootloader_Id_Byte_15 "SAEatad0200";
BA_ "SPN" SG_ 2566838913 Bootloader_Id_Byte_15 234;
BA_ "CI_FullName" SG_ 2566838913 Bootloader_Id_Byte_16 "Software Identification";
BA_ "CI_ParId" SG_ 2566838913 Bootloader_Id_Byte_16 "ESMD_03139";
BA_ "CI_SLOT_Name" SG_ 2566838913 Bootloader_Id_Byte_16 "SAEatad0200";
BA_ "SPN" SG_ 2566838913 Bootloader_Id_Byte_16 234;
BA_ "CI_FullName" SG_ 2566838913 Bootloader_Id_Byte_17 "Software Identification";
BA_ "CI_ParId" SG_ 2566838913 Bootloader_Id_Byte_17 "ESMD_03139";
BA_ "CI_SLOT_Name" SG_ 2566838913 Bootloader_Id_Byte_17 "SAEatad0200";
BA_ "SPN" SG_ 2566838913 Bootloader_Id_Byte_17 234;
BA_ "CI_FullName" SG_ 2566838913 Bootloader_Id_Byte_18 "Software Identification";
BA_ "CI_ParId" SG_ 2566838913 Bootloader_Id_Byte_18 "ESMD_03139";
BA_ "CI_SLOT_Name" SG_ 2566838913 Bootloader_Id_Byte_18 "SAEatad0200";
BA_ "SPN" SG_ 2566838913 Bootloader_Id_Byte_18 234;
BA_ "CI_FullName" SG_ 2566838913 Bootloader_Id_Byte_19 "Software Identification";
BA_ "CI_ParId" SG_ 2566838913 Bootloader_Id_Byte_19 "ESMD_03139";
BA_ "CI_SLOT_Name" SG_ 2566838913 Bootloader_Id_Byte_19 "SAEatad0200";
BA_ "SPN" SG_ 2566838913 Bootloader_Id_Byte_19 234;
BA_ "CI_FullName" SG_ 2566838913 Bootloader_Id_Byte_20 "Software Identification";
BA_ "CI_ParId" SG_ 2566838913 Bootloader_Id_Byte_20 "ESMD_03139";
BA_ "CI_SLOT_Name" SG_ 2566838913 Bootloader_Id_Byte_20 "SAEatad0200";
BA_ "SPN" SG_ 2566838913 Bootloader_Id_Byte_20 234;
BA_ "CI_FullName" SG_ 2566838913 Bootloader_Id_Byte_21 "Software Identification";
BA_ "CI_ParId" SG_ 2566838913 Bootloader_Id_Byte_21 "ESMD_03139";
BA_ "CI_SLOT_Name" SG_ 2566838913 Bootloader_Id_Byte_21 "SAEatad0200";
BA_ "SPN" SG_ 2566838913 Bootloader_Id_Byte_21 234;
BA_ "CI_FullName" SG_ 2566838913 Bootloader_Id_Byte_22 "Software Identification";
BA_ "CI_ParId" SG_ 2566838913 Bootloader_Id_Byte_22 "ESMD_03139";
BA_ "CI_SLOT_Name" SG_ 2566838913 Bootloader_Id_Byte_22 "SAEatad0200";
BA_ "SPN" SG_ 2566838913 Bootloader_Id_Byte_22 234;
BA_ "CI_FullName" SG_ 2566838913 Bootloader_Id_Byte_23 "Software Identification";
BA_ "CI_ParId" SG_ 2566838913 Bootloader_Id_Byte_23 "ESMD_03139";
BA_ "CI_SLOT_Name" SG_ 2566838913 Bootloader_Id_Byte_23 "SAEatad0200";
BA_ "SPN" SG_ 2566838913 Bootloader_Id_Byte_23 234;
BA_ "CI_FullName" SG_ 2566838913 Bootloader_Id_Byte_24 "Software Identification";
BA_ "CI_ParId" SG_ 2566838913 Bootloader_Id_Byte_24 "ESMD_03139";
BA_ "CI_SLOT_Name" SG_ 2566838913 Bootloader_Id_Byte_24 "SAEatad0200";
BA_ "SPN" SG_ 2566838913 Bootloader_Id_Byte_24 234;
BA_ "CI_FullName" SG_ 2566838913 Bootloader_Id_Byte_25 "Software Identification";
BA_ "CI_ParId" SG_ 2566838913 Bootloader_Id_Byte_25 "ESMD_03139";
BA_ "CI_SLOT_Name" SG_ 2566838913 Bootloader_Id_Byte_25 "SAEatad0200";
BA_ "SPN" SG_ 2566838913 Bootloader_Id_Byte_25 234;
BA_ "CI_FullName" SG_ 2566838913 Bootloader_Id_Byte_26 "Software Identification";
BA_ "CI_ParId" SG_ 2566838913 Bootloader_Id_Byte_26 "ESMD_03139";
BA_ "CI_SLOT_Name" SG_ 2566838913 Bootloader_Id_Byte_26 "SAEatad0200";
BA_ "SPN" SG_ 2566838913 Bootloader_Id_Byte_26 234;
BA_ "CI_FullName" SG_ 2566838913 Bootloader_Id_Byte_27 "Software Identification";
BA_ "CI_ParId" SG_ 2566838913 Bootloader_Id_Byte_27 "ESMD_03139";
BA_ "CI_SLOT_Name" SG_ 2566838913 Bootloader_Id_Byte_27 "SAEatad0200";
BA_ "SPN" SG_ 2566838913 Bootloader_Id_Byte_27 234;
BA_ "CI_FullName" SG_ 2566838913 Bootloader_Id_Byte_28 "Software Identification";
BA_ "CI_ParId" SG_ 2566838913 Bootloader_Id_Byte_28 "ESMD_03139";
BA_ "CI_SLOT_Name" SG_ 2566838913 Bootloader_Id_Byte_28 "SAEatad0200";
BA_ "SPN" SG_ 2566838913 Bootloader_Id_Byte_28 234;
BA_ "CI_FullName" SG_ 2566838913 Bootloader_Id_Byte_29 "Software Identification";
BA_ "CI_ParId" SG_ 2566838913 Bootloader_Id_Byte_29 "ESMD_03139";
BA_ "CI_SLOT_Name" SG_ 2566838913 Bootloader_Id_Byte_29 "SAEatad0200";
BA_ "SPN" SG_ 2566838913 Bootloader_Id_Byte_29 234;
BA_ "CI_FullName" SG_ 2566838913 Bootloader_Id_Byte_30 "Software Identification";
BA_ "CI_ParId" SG_ 2566838913 Bootloader_Id_Byte_30 "ESMD_03139";
BA_ "CI_SLOT_Name" SG_ 2566838913 Bootloader_Id_Byte_30 "SAEatad0200";
BA_ "SPN" SG_ 2566838913 Bootloader_Id_Byte_30 234;
BA_ "CI_FullName" SG_ 2566838913 Bootloader_Id_Byte_31 "Software Identification";
BA_ "CI_ParId" SG_ 2566838913 Bootloader_Id_Byte_31 "ESMD_03139";
BA_ "CI_SLOT_Name" SG_ 2566838913 Bootloader_Id_Byte_31 "SAEatad0200";
BA_ "SPN" SG_ 2566838913 Bootloader_Id_Byte_31 234;
BA_ "CI_FullName" SG_ 2566838913 Bootloader_Id_Byte_32 "Software Identification";
BA_ "CI_ParId" SG_ 2566838913 Bootloader_Id_Byte_32 "ESMD_03139";
BA_ "CI_SLOT_Name" SG_ 2566838913 Bootloader_Id_Byte_32 "SAEatad0200";
BA_ "SPN" SG_ 2566838913 Bootloader_Id_Byte_32 234;
BA_ "CI_FullName" SG_ 2566838913 Bootloader_Id_Byte_33 "Software Identification";
BA_ "CI_ParId" SG_ 2566838913 Bootloader_Id_Byte_33 "ESMD_03139";
BA_ "CI_SLOT_Name" SG_ 2566838913 Bootloader_Id_Byte_33 "SAEatad0200";
BA_ "SPN" SG_ 2566838913 Bootloader_Id_Byte_33 234;
BA_ "CI_FullName" SG_ 2566838913 Bootloader_Id_Byte_34 "Software Identification";
BA_ "CI_ParId" SG_ 2566838913 Bootloader_Id_Byte_34 "ESMD_03139";
BA_ "CI_SLOT_Name" SG_ 2566838913 Bootloader_Id_Byte_34 "SAEatad0200";
BA_ "SPN" SG_ 2566838913 Bootloader_Id_Byte_34 234;
BA_ "CI_FullName" SG_ 2566838913 Bootloader_Id_Byte_35 "Software Identification";
BA_ "CI_ParId" SG_ 2566838913 Bootloader_Id_Byte_35 "ESMD_03139";
BA_ "CI_SLOT_Name" SG_ 2566838913 Bootloader_Id_Byte_35 "SAEatad0200";
BA_ "SPN" SG_ 2566838913 Bootloader_Id_Byte_35 234;
BA_ "CI_FullName" SG_ 2566838913 Bootloader_Id_Byte_36 "Software Identification";
BA_ "CI_ParId" SG_ 2566838913 Bootloader_Id_Byte_36 "ESMD_03139";
BA_ "CI_SLOT_Name" SG_ 2566838913 Bootloader_Id_Byte_36 "SAEatad0200";
BA_ "SPN" SG_ 2566838913 Bootloader_Id_Byte_36 234;
BA_ "CI_FullName" SG_ 2566838913 Bootloader_Id_Byte_37 "Software Identification";
BA_ "CI_ParId" SG_ 2566838913 Bootloader_Id_Byte_37 "ESMD_03139";
BA_ "CI_SLOT_Name" SG_ 2566838913 Bootloader_Id_Byte_37 "SAEatad0200";
BA_ "SPN" SG_ 2566838913 Bootloader_Id_Byte_37 234;
BA_ "CI_FullName" SG_ 2566838913 Bootloader_Id_Byte_38 "Software Identification";
BA_ "CI_ParId" SG_ 2566838913 Bootloader_Id_Byte_38 "ESMD_03139";
BA_ "CI_SLOT_Name" SG_ 2566838913 Bootloader_Id_Byte_38 "SAEatad0200";
BA_ "SPN" SG_ 2566838913 Bootloader_Id_Byte_38 234;
BA_ "CI_FullName" SG_ 2566838913 Bootloader_Id_Byte_39 "Software Identification";
BA_ "CI_ParId" SG_ 2566838913 Bootloader_Id_Byte_39 "ESMD_03139";
BA_ "CI_SLOT_Name" SG_ 2566838913 Bootloader_Id_Byte_39 "SAEatad0200";
BA_ "SPN" SG_ 2566838913 Bootloader_Id_Byte_39 234;
BA_ "CI_FullName" SG_ 2566838913 Bootloader_Id_Enum "Software Identification";
BA_ "CI_ParId" SG_ 2566838913 Bootloader_Id_Enum "ESMD_03139";
BA_ "CI_SLOT_Name" SG_ 2566838913 Bootloader_Id_Enum "SAEbs24";
BA_ "SPN" SG_ 2566838913 Bootloader_Id_Enum 234;
BA_ "CI_FullName" SG_ 2566838913 EndStrng_00 "Software Identification";
BA_ "CI_ParId" SG_ 2566838913 EndStrng_00 "ESMD_21930";
BA_ "CI_SLOT_Name" SG_ 2566838913 EndStrng_00 "SAEatad0200";
BA_ "GenSigStartValue" SG_ 2566838913 EndStrng_00 42;
BA_ "SigType" SG_ 2566838913 EndStrng_00 8;
BA_ "CI_FullName" SG_ 2566838913 EndStrng_01 "Software Identification";
BA_ "CI_ParId" SG_ 2566838913 EndStrng_01 "ESMD_21931";
BA_ "CI_SLOT_Name" SG_ 2566838913 EndStrng_01 "SAEatad0200";
BA_ "GenSigStartValue" SG_ 2566838913 EndStrng_01 42;
BA_ "SigType" SG_ 2566838913 EndStrng_01 8;
BA_ "GenSigAutoGenSnd" SG_ 2566838913 NumSW_IdField 0;
BA_ "GenSigAutoGenDsp" SG_ 2566838913 NumSW_IdField 0;
BA_ "CI_RepetitionComplemented" SG_ 2566838913 NumSW_IdField 2;
BA_ "CI_FullName" SG_ 2566838913 NumSW_IdField "Number of Software Identification Fields";
BA_ "CI_ParId" SG_ 2566838913 NumSW_IdField "ESMD_02746";
BA_ "CI_SLOT_Name" SG_ 2566838913 NumSW_IdField "SAEst01";
BA_ "SPN" SG_ 2566838913 NumSW_IdField 965;
BA_ "SigType" SG_ 2566838913 NumSW_IdField 1;
BA_ "CI_FullName" SG_ 2566838914 Appl_Id "Software Identification";
BA_ "CI_ParId" SG_ 2566838914 Appl_Id "ESMD_03139";
BA_ "CI_SLOT_Name" SG_ 2566838914 Appl_Id "SAEatad0200";
BA_ "SPN" SG_ 2566838914 Appl_Id 234;
BA_ "CI_FullName" SG_ 2566838914 Appl_Id_Byte_01 "Software Identification";
BA_ "CI_ParId" SG_ 2566838914 Appl_Id_Byte_01 "ESMD_03139";
BA_ "CI_SLOT_Name" SG_ 2566838914 Appl_Id_Byte_01 "SAEatad0200";
BA_ "SPN" SG_ 2566838914 Appl_Id_Byte_01 234;
BA_ "CI_FullName" SG_ 2566838914 Appl_Id_Byte_02 "Software Identification";
BA_ "CI_ParId" SG_ 2566838914 Appl_Id_Byte_02 "ESMD_03139";
BA_ "CI_SLOT_Name" SG_ 2566838914 Appl_Id_Byte_02 "SAEatad0200";
BA_ "SPN" SG_ 2566838914 Appl_Id_Byte_02 234;
BA_ "CI_FullName" SG_ 2566838914 Appl_Id_Byte_03 "Software Identification";
BA_ "CI_ParId" SG_ 2566838914 Appl_Id_Byte_03 "ESMD_03139";
BA_ "CI_SLOT_Name" SG_ 2566838914 Appl_Id_Byte_03 "SAEatad0200";
BA_ "SPN" SG_ 2566838914 Appl_Id_Byte_03 234;
BA_ "CI_FullName" SG_ 2566838914 Appl_Id_Byte_04 "Software Identification";
BA_ "CI_ParId" SG_ 2566838914 Appl_Id_Byte_04 "ESMD_03139";
BA_ "CI_SLOT_Name" SG_ 2566838914 Appl_Id_Byte_04 "SAEatad0200";
BA_ "SPN" SG_ 2566838914 Appl_Id_Byte_04 234;
BA_ "CI_FullName" SG_ 2566838914 Appl_Id_Byte_05 "Software Identification";
BA_ "CI_ParId" SG_ 2566838914 Appl_Id_Byte_05 "ESMD_03139";
BA_ "CI_SLOT_Name" SG_ 2566838914 Appl_Id_Byte_05 "SAEatad0200";
BA_ "SPN" SG_ 2566838914 Appl_Id_Byte_05 234;
BA_ "CI_FullName" SG_ 2566838914 Appl_Id_Byte_06 "Software Identification";
BA_ "CI_ParId" SG_ 2566838914 Appl_Id_Byte_06 "ESMD_03139";
BA_ "CI_SLOT_Name" SG_ 2566838914 Appl_Id_Byte_06 "SAEatad0200";
BA_ "SPN" SG_ 2566838914 Appl_Id_Byte_06 234;
BA_ "CI_FullName" SG_ 2566838914 Appl_Id_Byte_07 "Software Identification";
BA_ "CI_ParId" SG_ 2566838914 Appl_Id_Byte_07 "ESMD_03139";
BA_ "CI_SLOT_Name" SG_ 2566838914 Appl_Id_Byte_07 "SAEatad0200";
BA_ "SPN" SG_ 2566838914 Appl_Id_Byte_07 234;
BA_ "CI_FullName" SG_ 2566838914 Appl_Id_Byte_08 "Software Identification";
BA_ "CI_ParId" SG_ 2566838914 Appl_Id_Byte_08 "ESMD_03139";
BA_ "CI_SLOT_Name" SG_ 2566838914 Appl_Id_Byte_08 "SAEatad0200";
BA_ "SPN" SG_ 2566838914 Appl_Id_Byte_08 234;
BA_ "CI_FullName" SG_ 2566838914 Appl_Id_Byte_09 "Software Identification";
BA_ "CI_ParId" SG_ 2566838914 Appl_Id_Byte_09 "ESMD_03139";
BA_ "CI_SLOT_Name" SG_ 2566838914 Appl_Id_Byte_09 "SAEatad0200";
BA_ "SPN" SG_ 2566838914 Appl_Id_Byte_09 234;
BA_ "CI_FullName" SG_ 2566838914 Appl_Id_Byte_10 "Software Identification";
BA_ "CI_ParId" SG_ 2566838914 Appl_Id_Byte_10 "ESMD_03139";
BA_ "CI_SLOT_Name" SG_ 2566838914 Appl_Id_Byte_10 "SAEatad0200";
BA_ "SPN" SG_ 2566838914 Appl_Id_Byte_10 234;
BA_ "CI_FullName" SG_ 2566838914 Appl_Id_Byte_11 "Software Identification";
BA_ "CI_ParId" SG_ 2566838914 Appl_Id_Byte_11 "ESMD_03139";
BA_ "CI_SLOT_Name" SG_ 2566838914 Appl_Id_Byte_11 "SAEatad0200";
BA_ "SPN" SG_ 2566838914 Appl_Id_Byte_11 234;
BA_ "CI_FullName" SG_ 2566838914 Appl_Id_Byte_12 "Software Identification";
BA_ "CI_ParId" SG_ 2566838914 Appl_Id_Byte_12 "ESMD_03139";
BA_ "CI_SLOT_Name" SG_ 2566838914 Appl_Id_Byte_12 "SAEatad0200";
BA_ "SPN" SG_ 2566838914 Appl_Id_Byte_12 234;
BA_ "CI_FullName" SG_ 2566838914 Appl_Id_Byte_13 "Software Identification";
BA_ "CI_ParId" SG_ 2566838914 Appl_Id_Byte_13 "ESMD_03139";
BA_ "CI_SLOT_Name" SG_ 2566838914 Appl_Id_Byte_13 "SAEatad0200";
BA_ "SPN" SG_ 2566838914 Appl_Id_Byte_13 234;
BA_ "CI_FullName" SG_ 2566838914 Appl_Id_Byte_14 "Software Identification";
BA_ "CI_ParId" SG_ 2566838914 Appl_Id_Byte_14 "ESMD_03139";
BA_ "CI_SLOT_Name" SG_ 2566838914 Appl_Id_Byte_14 "SAEatad0200";
BA_ "SPN" SG_ 2566838914 Appl_Id_Byte_14 234;
BA_ "CI_FullName" SG_ 2566838914 Appl_Id_Byte_15 "Software Identification";
BA_ "CI_ParId" SG_ 2566838914 Appl_Id_Byte_15 "ESMD_03139";
BA_ "CI_SLOT_Name" SG_ 2566838914 Appl_Id_Byte_15 "SAEatad0200";
BA_ "SPN" SG_ 2566838914 Appl_Id_Byte_15 234;
BA_ "CI_FullName" SG_ 2566838914 Appl_Id_Byte_16 "Software Identification";
BA_ "CI_ParId" SG_ 2566838914 Appl_Id_Byte_16 "ESMD_03139";
BA_ "CI_SLOT_Name" SG_ 2566838914 Appl_Id_Byte_16 "SAEatad0200";
BA_ "SPN" SG_ 2566838914 Appl_Id_Byte_16 234;
BA_ "CI_FullName" SG_ 2566838914 Appl_Id_Byte_17 "Software Identification";
BA_ "CI_ParId" SG_ 2566838914 Appl_Id_Byte_17 "ESMD_03139";
BA_ "CI_SLOT_Name" SG_ 2566838914 Appl_Id_Byte_17 "SAEatad0200";
BA_ "SPN" SG_ 2566838914 Appl_Id_Byte_17 234;
BA_ "CI_FullName" SG_ 2566838914 Appl_Id_Byte_18 "Software Identification";
BA_ "CI_ParId" SG_ 2566838914 Appl_Id_Byte_18 "ESMD_03139";
BA_ "CI_SLOT_Name" SG_ 2566838914 Appl_Id_Byte_18 "SAEatad0200";
BA_ "SPN" SG_ 2566838914 Appl_Id_Byte_18 234;
BA_ "CI_FullName" SG_ 2566838914 Appl_Id_Byte_19 "Software Identification";
BA_ "CI_ParId" SG_ 2566838914 Appl_Id_Byte_19 "ESMD_03139";
BA_ "CI_SLOT_Name" SG_ 2566838914 Appl_Id_Byte_19 "SAEatad0200";
BA_ "SPN" SG_ 2566838914 Appl_Id_Byte_19 234;
BA_ "CI_FullName" SG_ 2566838914 Appl_Id_Byte_20 "Software Identification";
BA_ "CI_ParId" SG_ 2566838914 Appl_Id_Byte_20 "ESMD_03139";
BA_ "CI_SLOT_Name" SG_ 2566838914 Appl_Id_Byte_20 "SAEatad0200";
BA_ "SPN" SG_ 2566838914 Appl_Id_Byte_20 234;
BA_ "CI_FullName" SG_ 2566838914 Appl_Id_Byte_21 "Software Identification";
BA_ "CI_ParId" SG_ 2566838914 Appl_Id_Byte_21 "ESMD_03139";
BA_ "CI_SLOT_Name" SG_ 2566838914 Appl_Id_Byte_21 "SAEatad0200";
BA_ "SPN" SG_ 2566838914 Appl_Id_Byte_21 234;
BA_ "CI_FullName" SG_ 2566838914 Appl_Id_Byte_22 "Software Identification";
BA_ "CI_ParId" SG_ 2566838914 Appl_Id_Byte_22 "ESMD_03139";
BA_ "CI_SLOT_Name" SG_ 2566838914 Appl_Id_Byte_22 "SAEatad0200";
BA_ "SPN" SG_ 2566838914 Appl_Id_Byte_22 234;
BA_ "CI_FullName" SG_ 2566838914 Appl_Id_Byte_23 "Software Identification";
BA_ "CI_ParId" SG_ 2566838914 Appl_Id_Byte_23 "ESMD_03139";
BA_ "CI_SLOT_Name" SG_ 2566838914 Appl_Id_Byte_23 "SAEatad0200";
BA_ "SPN" SG_ 2566838914 Appl_Id_Byte_23 234;
BA_ "CI_FullName" SG_ 2566838914 Appl_Id_Byte_24 "Software Identification";
BA_ "CI_ParId" SG_ 2566838914 Appl_Id_Byte_24 "ESMD_03139";
BA_ "CI_SLOT_Name" SG_ 2566838914 Appl_Id_Byte_24 "SAEatad0200";
BA_ "SPN" SG_ 2566838914 Appl_Id_Byte_24 234;
BA_ "CI_FullName" SG_ 2566838914 Appl_Id_Byte_25 "Software Identification";
BA_ "CI_ParId" SG_ 2566838914 Appl_Id_Byte_25 "ESMD_03139";
BA_ "CI_SLOT_Name" SG_ 2566838914 Appl_Id_Byte_25 "SAEatad0200";
BA_ "SPN" SG_ 2566838914 Appl_Id_Byte_25 234;
BA_ "CI_FullName" SG_ 2566838914 Appl_Id_Byte_26 "Software Identification";
BA_ "CI_ParId" SG_ 2566838914 Appl_Id_Byte_26 "ESMD_03139";
BA_ "CI_SLOT_Name" SG_ 2566838914 Appl_Id_Byte_26 "SAEatad0200";
BA_ "SPN" SG_ 2566838914 Appl_Id_Byte_26 234;
BA_ "CI_FullName" SG_ 2566838914 Appl_Id_Byte_27 "Software Identification";
BA_ "CI_ParId" SG_ 2566838914 Appl_Id_Byte_27 "ESMD_03139";
BA_ "CI_SLOT_Name" SG_ 2566838914 Appl_Id_Byte_27 "SAEatad0200";
BA_ "SPN" SG_ 2566838914 Appl_Id_Byte_27 234;
BA_ "CI_FullName" SG_ 2566838914 Appl_Id_Byte_28 "Software Identification";
BA_ "CI_ParId" SG_ 2566838914 Appl_Id_Byte_28 "ESMD_03139";
BA_ "CI_SLOT_Name" SG_ 2566838914 Appl_Id_Byte_28 "SAEatad0200";
BA_ "SPN" SG_ 2566838914 Appl_Id_Byte_28 234;
BA_ "CI_FullName" SG_ 2566838914 Appl_Id_Byte_29 "Software Identification";
BA_ "CI_ParId" SG_ 2566838914 Appl_Id_Byte_29 "ESMD_03139";
BA_ "CI_SLOT_Name" SG_ 2566838914 Appl_Id_Byte_29 "SAEatad0200";
BA_ "SPN" SG_ 2566838914 Appl_Id_Byte_29 234;
BA_ "CI_FullName" SG_ 2566838914 Appl_Id_Byte_30 "Software Identification";
BA_ "CI_ParId" SG_ 2566838914 Appl_Id_Byte_30 "ESMD_03139";
BA_ "CI_SLOT_Name" SG_ 2566838914 Appl_Id_Byte_30 "SAEatad0200";
BA_ "SPN" SG_ 2566838914 Appl_Id_Byte_30 234;
BA_ "CI_FullName" SG_ 2566838914 Appl_Id_Byte_31 "Software Identification";
BA_ "CI_ParId" SG_ 2566838914 Appl_Id_Byte_31 "ESMD_03139";
BA_ "CI_SLOT_Name" SG_ 2566838914 Appl_Id_Byte_31 "SAEatad0200";
BA_ "SPN" SG_ 2566838914 Appl_Id_Byte_31 234;
BA_ "CI_FullName" SG_ 2566838914 Appl_Id_Byte_32 "Software Identification";
BA_ "CI_ParId" SG_ 2566838914 Appl_Id_Byte_32 "ESMD_03139";
BA_ "CI_SLOT_Name" SG_ 2566838914 Appl_Id_Byte_32 "SAEatad0200";
BA_ "SPN" SG_ 2566838914 Appl_Id_Byte_32 234;
BA_ "CI_FullName" SG_ 2566838914 Appl_Id_Byte_33 "Software Identification";
BA_ "CI_ParId" SG_ 2566838914 Appl_Id_Byte_33 "ESMD_03139";
BA_ "CI_SLOT_Name" SG_ 2566838914 Appl_Id_Byte_33 "SAEatad0200";
BA_ "SPN" SG_ 2566838914 Appl_Id_Byte_33 234;
BA_ "CI_FullName" SG_ 2566838914 Appl_Id_Byte_34 "Software Identification";
BA_ "CI_ParId" SG_ 2566838914 Appl_Id_Byte_34 "ESMD_03139";
BA_ "CI_SLOT_Name" SG_ 2566838914 Appl_Id_Byte_34 "SAEatad0200";
BA_ "SPN" SG_ 2566838914 Appl_Id_Byte_34 234;
BA_ "CI_FullName" SG_ 2566838914 Appl_Id_Byte_35 "Software Identification";
BA_ "CI_ParId" SG_ 2566838914 Appl_Id_Byte_35 "ESMD_03139";
BA_ "CI_SLOT_Name" SG_ 2566838914 Appl_Id_Byte_35 "SAEatad0200";
BA_ "SPN" SG_ 2566838914 Appl_Id_Byte_35 234;
BA_ "CI_FullName" SG_ 2566838914 Appl_Id_Byte_36 "Software Identification";
BA_ "CI_ParId" SG_ 2566838914 Appl_Id_Byte_36 "ESMD_03139";
BA_ "CI_SLOT_Name" SG_ 2566838914 Appl_Id_Byte_36 "SAEatad0200";
BA_ "SPN" SG_ 2566838914 Appl_Id_Byte_36 234;
BA_ "CI_FullName" SG_ 2566838914 Appl_Id_Byte_37 "Software Identification";
BA_ "CI_ParId" SG_ 2566838914 Appl_Id_Byte_37 "ESMD_03139";
BA_ "CI_SLOT_Name" SG_ 2566838914 Appl_Id_Byte_37 "SAEatad0200";
BA_ "SPN" SG_ 2566838914 Appl_Id_Byte_37 234;
BA_ "CI_FullName" SG_ 2566838914 Appl_Id_Byte_38 "Software Identification";
BA_ "CI_ParId" SG_ 2566838914 Appl_Id_Byte_38 "ESMD_03139";
BA_ "CI_SLOT_Name" SG_ 2566838914 Appl_Id_Byte_38 "SAEatad0200";
BA_ "SPN" SG_ 2566838914 Appl_Id_Byte_38 234;
BA_ "CI_FullName" SG_ 2566838914 Appl_Id_Byte_39 "Software Identification";
BA_ "CI_ParId" SG_ 2566838914 Appl_Id_Byte_39 "ESMD_03139";
BA_ "CI_SLOT_Name" SG_ 2566838914 Appl_Id_Byte_39 "SAEatad0200";
BA_ "SPN" SG_ 2566838914 Appl_Id_Byte_39 234;
BA_ "CI_FullName" SG_ 2566838914 Appl_Id_Enum "Software Identification";
BA_ "CI_ParId" SG_ 2566838914 Appl_Id_Enum "ESMD_03139";
BA_ "CI_SLOT_Name" SG_ 2566838914 Appl_Id_Enum "SAEbs24";
BA_ "SPN" SG_ 2566838914 Appl_Id_Enum 234;
BA_ "CI_FullName" SG_ 2566838914 Bootloader_Id "Software Identification";
BA_ "CI_ParId" SG_ 2566838914 Bootloader_Id "ESMD_03139";
BA_ "CI_SLOT_Name" SG_ 2566838914 Bootloader_Id "SAEatad0200";
BA_ "SPN" SG_ 2566838914 Bootloader_Id 234;
BA_ "CI_FullName" SG_ 2566838914 Bootloader_Id_Byte_01 "Software Identification";
BA_ "CI_ParId" SG_ 2566838914 Bootloader_Id_Byte_01 "ESMD_03139";
BA_ "CI_SLOT_Name" SG_ 2566838914 Bootloader_Id_Byte_01 "SAEatad0200";
BA_ "SPN" SG_ 2566838914 Bootloader_Id_Byte_01 234;
BA_ "CI_FullName" SG_ 2566838914 Bootloader_Id_Byte_02 "Software Identification";
BA_ "CI_ParId" SG_ 2566838914 Bootloader_Id_Byte_02 "ESMD_03139";
BA_ "CI_SLOT_Name" SG_ 2566838914 Bootloader_Id_Byte_02 "SAEatad0200";
BA_ "SPN" SG_ 2566838914 Bootloader_Id_Byte_02 234;
BA_ "CI_FullName" SG_ 2566838914 Bootloader_Id_Byte_03 "Software Identification";
BA_ "CI_ParId" SG_ 2566838914 Bootloader_Id_Byte_03 "ESMD_03139";
BA_ "CI_SLOT_Name" SG_ 2566838914 Bootloader_Id_Byte_03 "SAEatad0200";
BA_ "SPN" SG_ 2566838914 Bootloader_Id_Byte_03 234;
BA_ "CI_FullName" SG_ 2566838914 Bootloader_Id_Byte_04 "Software Identification";
BA_ "CI_ParId" SG_ 2566838914 Bootloader_Id_Byte_04 "ESMD_03139";
BA_ "CI_SLOT_Name" SG_ 2566838914 Bootloader_Id_Byte_04 "SAEatad0200";
BA_ "SPN" SG_ 2566838914 Bootloader_Id_Byte_04 234;
BA_ "CI_FullName" SG_ 2566838914 Bootloader_Id_Byte_05 "Software Identification";
BA_ "CI_ParId" SG_ 2566838914 Bootloader_Id_Byte_05 "ESMD_03139";
BA_ "CI_SLOT_Name" SG_ 2566838914 Bootloader_Id_Byte_05 "SAEatad0200";
BA_ "SPN" SG_ 2566838914 Bootloader_Id_Byte_05 234;
BA_ "CI_FullName" SG_ 2566838914 Bootloader_Id_Byte_06 "Software Identification";
BA_ "CI_ParId" SG_ 2566838914 Bootloader_Id_Byte_06 "ESMD_03139";
BA_ "CI_SLOT_Name" SG_ 2566838914 Bootloader_Id_Byte_06 "SAEatad0200";
BA_ "SPN" SG_ 2566838914 Bootloader_Id_Byte_06 234;
BA_ "CI_FullName" SG_ 2566838914 Bootloader_Id_Byte_07 "Software Identification";
BA_ "CI_ParId" SG_ 2566838914 Bootloader_Id_Byte_07 "ESMD_03139";
BA_ "CI_SLOT_Name" SG_ 2566838914 Bootloader_Id_Byte_07 "SAEatad0200";
BA_ "SPN" SG_ 2566838914 Bootloader_Id_Byte_07 234;
BA_ "CI_FullName" SG_ 2566838914 Bootloader_Id_Byte_08 "Software Identification";
BA_ "CI_ParId" SG_ 2566838914 Bootloader_Id_Byte_08 "ESMD_03139";
BA_ "CI_SLOT_Name" SG_ 2566838914 Bootloader_Id_Byte_08 "SAEatad0200";
BA_ "SPN" SG_ 2566838914 Bootloader_Id_Byte_08 234;
BA_ "CI_FullName" SG_ 2566838914 Bootloader_Id_Byte_09 "Software Identification";
BA_ "CI_ParId" SG_ 2566838914 Bootloader_Id_Byte_09 "ESMD_03139";
BA_ "CI_SLOT_Name" SG_ 2566838914 Bootloader_Id_Byte_09 "SAEatad0200";
BA_ "SPN" SG_ 2566838914 Bootloader_Id_Byte_09 234;
BA_ "CI_FullName" SG_ 2566838914 Bootloader_Id_Byte_10 "Software Identification";
BA_ "CI_ParId" SG_ 2566838914 Bootloader_Id_Byte_10 "ESMD_03139";
BA_ "CI_SLOT_Name" SG_ 2566838914 Bootloader_Id_Byte_10 "SAEatad0200";
BA_ "SPN" SG_ 2566838914 Bootloader_Id_Byte_10 234;
BA_ "CI_FullName" SG_ 2566838914 Bootloader_Id_Byte_11 "Software Identification";
BA_ "CI_ParId" SG_ 2566838914 Bootloader_Id_Byte_11 "ESMD_03139";
BA_ "CI_SLOT_Name" SG_ 2566838914 Bootloader_Id_Byte_11 "SAEatad0200";
BA_ "SPN" SG_ 2566838914 Bootloader_Id_Byte_11 234;
BA_ "CI_FullName" SG_ 2566838914 Bootloader_Id_Byte_12 "Software Identification";
BA_ "CI_ParId" SG_ 2566838914 Bootloader_Id_Byte_12 "ESMD_03139";
BA_ "CI_SLOT_Name" SG_ 2566838914 Bootloader_Id_Byte_12 "SAEatad0200";
BA_ "SPN" SG_ 2566838914 Bootloader_Id_Byte_12 234;
BA_ "CI_FullName" SG_ 2566838914 Bootloader_Id_Byte_13 "Software Identification";
BA_ "CI_ParId" SG_ 2566838914 Bootloader_Id_Byte_13 "ESMD_03139";
BA_ "CI_SLOT_Name" SG_ 2566838914 Bootloader_Id_Byte_13 "SAEatad0200";
BA_ "SPN" SG_ 2566838914 Bootloader_Id_Byte_13 234;
BA_ "CI_FullName" SG_ 2566838914 Bootloader_Id_Byte_14 "Software Identification";
BA_ "CI_ParId" SG_ 2566838914 Bootloader_Id_Byte_14 "ESMD_03139";
BA_ "CI_SLOT_Name" SG_ 2566838914 Bootloader_Id_Byte_14 "SAEatad0200";
BA_ "SPN" SG_ 2566838914 Bootloader_Id_Byte_14 234;
BA_ "CI_FullName" SG_ 2566838914 Bootloader_Id_Byte_15 "Software Identification";
BA_ "CI_ParId" SG_ 2566838914 Bootloader_Id_Byte_15 "ESMD_03139";
BA_ "CI_SLOT_Name" SG_ 2566838914 Bootloader_Id_Byte_15 "SAEatad0200";
BA_ "SPN" SG_ 2566838914 Bootloader_Id_Byte_15 234;
BA_ "CI_FullName" SG_ 2566838914 Bootloader_Id_Byte_16 "Software Identification";
BA_ "CI_ParId" SG_ 2566838914 Bootloader_Id_Byte_16 "ESMD_03139";
BA_ "CI_SLOT_Name" SG_ 2566838914 Bootloader_Id_Byte_16 "SAEatad0200";
BA_ "SPN" SG_ 2566838914 Bootloader_Id_Byte_16 234;
BA_ "CI_FullName" SG_ 2566838914 Bootloader_Id_Byte_17 "Software Identification";
BA_ "CI_ParId" SG_ 2566838914 Bootloader_Id_Byte_17 "ESMD_03139";
BA_ "CI_SLOT_Name" SG_ 2566838914 Bootloader_Id_Byte_17 "SAEatad0200";
BA_ "SPN" SG_ 2566838914 Bootloader_Id_Byte_17 234;
BA_ "CI_FullName" SG_ 2566838914 Bootloader_Id_Byte_18 "Software Identification";
BA_ "CI_ParId" SG_ 2566838914 Bootloader_Id_Byte_18 "ESMD_03139";
BA_ "CI_SLOT_Name" SG_ 2566838914 Bootloader_Id_Byte_18 "SAEatad0200";
BA_ "SPN" SG_ 2566838914 Bootloader_Id_Byte_18 234;
BA_ "CI_FullName" SG_ 2566838914 Bootloader_Id_Byte_19 "Software Identification";
BA_ "CI_ParId" SG_ 2566838914 Bootloader_Id_Byte_19 "ESMD_03139";
BA_ "CI_SLOT_Name" SG_ 2566838914 Bootloader_Id_Byte_19 "SAEatad0200";
BA_ "SPN" SG_ 2566838914 Bootloader_Id_Byte_19 234;
BA_ "CI_FullName" SG_ 2566838914 Bootloader_Id_Byte_20 "Software Identification";
BA_ "CI_ParId" SG_ 2566838914 Bootloader_Id_Byte_20 "ESMD_03139";
BA_ "CI_SLOT_Name" SG_ 2566838914 Bootloader_Id_Byte_20 "SAEatad0200";
BA_ "SPN" SG_ 2566838914 Bootloader_Id_Byte_20 234;
BA_ "CI_FullName" SG_ 2566838914 Bootloader_Id_Byte_21 "Software Identification";
BA_ "CI_ParId" SG_ 2566838914 Bootloader_Id_Byte_21 "ESMD_03139";
BA_ "CI_SLOT_Name" SG_ 2566838914 Bootloader_Id_Byte_21 "SAEatad0200";
BA_ "SPN" SG_ 2566838914 Bootloader_Id_Byte_21 234;
BA_ "CI_FullName" SG_ 2566838914 Bootloader_Id_Byte_22 "Software Identification";
BA_ "CI_ParId" SG_ 2566838914 Bootloader_Id_Byte_22 "ESMD_03139";
BA_ "CI_SLOT_Name" SG_ 2566838914 Bootloader_Id_Byte_22 "SAEatad0200";
BA_ "SPN" SG_ 2566838914 Bootloader_Id_Byte_22 234;
BA_ "CI_FullName" SG_ 2566838914 Bootloader_Id_Byte_23 "Software Identification";
BA_ "CI_ParId" SG_ 2566838914 Bootloader_Id_Byte_23 "ESMD_03139";
BA_ "CI_SLOT_Name" SG_ 2566838914 Bootloader_Id_Byte_23 "SAEatad0200";
BA_ "SPN" SG_ 2566838914 Bootloader_Id_Byte_23 234;
BA_ "CI_FullName" SG_ 2566838914 Bootloader_Id_Byte_24 "Software Identification";
BA_ "CI_ParId" SG_ 2566838914 Bootloader_Id_Byte_24 "ESMD_03139";
BA_ "CI_SLOT_Name" SG_ 2566838914 Bootloader_Id_Byte_24 "SAEatad0200";
BA_ "SPN" SG_ 2566838914 Bootloader_Id_Byte_24 234;
BA_ "CI_FullName" SG_ 2566838914 Bootloader_Id_Byte_25 "Software Identification";
BA_ "CI_ParId" SG_ 2566838914 Bootloader_Id_Byte_25 "ESMD_03139";
BA_ "CI_SLOT_Name" SG_ 2566838914 Bootloader_Id_Byte_25 "SAEatad0200";
BA_ "SPN" SG_ 2566838914 Bootloader_Id_Byte_25 234;
BA_ "CI_FullName" SG_ 2566838914 Bootloader_Id_Byte_26 "Software Identification";
BA_ "CI_ParId" SG_ 2566838914 Bootloader_Id_Byte_26 "ESMD_03139";
BA_ "CI_SLOT_Name" SG_ 2566838914 Bootloader_Id_Byte_26 "SAEatad0200";
BA_ "SPN" SG_ 2566838914 Bootloader_Id_Byte_26 234;
BA_ "CI_FullName" SG_ 2566838914 Bootloader_Id_Byte_27 "Software Identification";
BA_ "CI_ParId" SG_ 2566838914 Bootloader_Id_Byte_27 "ESMD_03139";
BA_ "CI_SLOT_Name" SG_ 2566838914 Bootloader_Id_Byte_27 "SAEatad0200";
BA_ "SPN" SG_ 2566838914 Bootloader_Id_Byte_27 234;
BA_ "CI_FullName" SG_ 2566838914 Bootloader_Id_Byte_28 "Software Identification";
BA_ "CI_ParId" SG_ 2566838914 Bootloader_Id_Byte_28 "ESMD_03139";
BA_ "CI_SLOT_Name" SG_ 2566838914 Bootloader_Id_Byte_28 "SAEatad0200";
BA_ "SPN" SG_ 2566838914 Bootloader_Id_Byte_28 234;
BA_ "CI_FullName" SG_ 2566838914 Bootloader_Id_Byte_29 "Software Identification";
BA_ "CI_ParId" SG_ 2566838914 Bootloader_Id_Byte_29 "ESMD_03139";
BA_ "CI_SLOT_Name" SG_ 2566838914 Bootloader_Id_Byte_29 "SAEatad0200";
BA_ "SPN" SG_ 2566838914 Bootloader_Id_Byte_29 234;
BA_ "CI_FullName" SG_ 2566838914 Bootloader_Id_Byte_30 "Software Identification";
BA_ "CI_ParId" SG_ 2566838914 Bootloader_Id_Byte_30 "ESMD_03139";
BA_ "CI_SLOT_Name" SG_ 2566838914 Bootloader_Id_Byte_30 "SAEatad0200";
BA_ "SPN" SG_ 2566838914 Bootloader_Id_Byte_30 234;
BA_ "CI_FullName" SG_ 2566838914 Bootloader_Id_Byte_31 "Software Identification";
BA_ "CI_ParId" SG_ 2566838914 Bootloader_Id_Byte_31 "ESMD_03139";
BA_ "CI_SLOT_Name" SG_ 2566838914 Bootloader_Id_Byte_31 "SAEatad0200";
BA_ "SPN" SG_ 2566838914 Bootloader_Id_Byte_31 234;
BA_ "CI_FullName" SG_ 2566838914 Bootloader_Id_Byte_32 "Software Identification";
BA_ "CI_ParId" SG_ 2566838914 Bootloader_Id_Byte_32 "ESMD_03139";
BA_ "CI_SLOT_Name" SG_ 2566838914 Bootloader_Id_Byte_32 "SAEatad0200";
BA_ "SPN" SG_ 2566838914 Bootloader_Id_Byte_32 234;
BA_ "CI_FullName" SG_ 2566838914 Bootloader_Id_Byte_33 "Software Identification";
BA_ "CI_ParId" SG_ 2566838914 Bootloader_Id_Byte_33 "ESMD_03139";
BA_ "CI_SLOT_Name" SG_ 2566838914 Bootloader_Id_Byte_33 "SAEatad0200";
BA_ "SPN" SG_ 2566838914 Bootloader_Id_Byte_33 234;
BA_ "CI_FullName" SG_ 2566838914 Bootloader_Id_Byte_34 "Software Identification";
BA_ "CI_ParId" SG_ 2566838914 Bootloader_Id_Byte_34 "ESMD_03139";
BA_ "CI_SLOT_Name" SG_ 2566838914 Bootloader_Id_Byte_34 "SAEatad0200";
BA_ "SPN" SG_ 2566838914 Bootloader_Id_Byte_34 234;
BA_ "CI_FullName" SG_ 2566838914 Bootloader_Id_Byte_35 "Software Identification";
BA_ "CI_ParId" SG_ 2566838914 Bootloader_Id_Byte_35 "ESMD_03139";
BA_ "CI_SLOT_Name" SG_ 2566838914 Bootloader_Id_Byte_35 "SAEatad0200";
BA_ "SPN" SG_ 2566838914 Bootloader_Id_Byte_35 234;
BA_ "CI_FullName" SG_ 2566838914 Bootloader_Id_Byte_36 "Software Identification";
BA_ "CI_ParId" SG_ 2566838914 Bootloader_Id_Byte_36 "ESMD_03139";
BA_ "CI_SLOT_Name" SG_ 2566838914 Bootloader_Id_Byte_36 "SAEatad0200";
BA_ "SPN" SG_ 2566838914 Bootloader_Id_Byte_36 234;
BA_ "CI_FullName" SG_ 2566838914 Bootloader_Id_Byte_37 "Software Identification";
BA_ "CI_ParId" SG_ 2566838914 Bootloader_Id_Byte_37 "ESMD_03139";
BA_ "CI_SLOT_Name" SG_ 2566838914 Bootloader_Id_Byte_37 "SAEatad0200";
BA_ "SPN" SG_ 2566838914 Bootloader_Id_Byte_37 234;
BA_ "CI_FullName" SG_ 2566838914 Bootloader_Id_Byte_38 "Software Identification";
BA_ "CI_ParId" SG_ 2566838914 Bootloader_Id_Byte_38 "ESMD_03139";
BA_ "CI_SLOT_Name" SG_ 2566838914 Bootloader_Id_Byte_38 "SAEatad0200";
BA_ "SPN" SG_ 2566838914 Bootloader_Id_Byte_38 234;
BA_ "CI_FullName" SG_ 2566838914 Bootloader_Id_Byte_39 "Software Identification";
BA_ "CI_ParId" SG_ 2566838914 Bootloader_Id_Byte_39 "ESMD_03139";
BA_ "CI_SLOT_Name" SG_ 2566838914 Bootloader_Id_Byte_39 "SAEatad0200";
BA_ "SPN" SG_ 2566838914 Bootloader_Id_Byte_39 234;
BA_ "CI_FullName" SG_ 2566838914 Bootloader_Id_Enum "Software Identification";
BA_ "CI_ParId" SG_ 2566838914 Bootloader_Id_Enum "ESMD_03139";
BA_ "CI_SLOT_Name" SG_ 2566838914 Bootloader_Id_Enum "SAEbs24";
BA_ "SPN" SG_ 2566838914 Bootloader_Id_Enum 234;
BA_ "CI_FullName" SG_ 2566838914 EndStrng_00 "Software Identification";
BA_ "CI_ParId" SG_ 2566838914 EndStrng_00 "ESMD_21930";
BA_ "CI_SLOT_Name" SG_ 2566838914 EndStrng_00 "SAEatad0200";
BA_ "GenSigStartValue" SG_ 2566838914 EndStrng_00 42;
BA_ "SigType" SG_ 2566838914 EndStrng_00 8;
BA_ "CI_FullName" SG_ 2566838914 EndStrng_01 "Software Identification";
BA_ "CI_ParId" SG_ 2566838914 EndStrng_01 "ESMD_21931";
BA_ "CI_SLOT_Name" SG_ 2566838914 EndStrng_01 "SAEatad0200";
BA_ "GenSigStartValue" SG_ 2566838914 EndStrng_01 42;
BA_ "SigType" SG_ 2566838914 EndStrng_01 8;
BA_ "GenSigAutoGenSnd" SG_ 2566838914 NumSW_IdField 0;
BA_ "GenSigAutoGenDsp" SG_ 2566838914 NumSW_IdField 0;
BA_ "CI_RepetitionComplemented" SG_ 2566838914 NumSW_IdField 2;
BA_ "CI_FullName" SG_ 2566838914 NumSW_IdField "Number of Software Identification Fields";
BA_ "CI_ParId" SG_ 2566838914 NumSW_IdField "ESMD_02746";
BA_ "CI_SLOT_Name" SG_ 2566838914 NumSW_IdField "SAEst01";
BA_ "SPN" SG_ 2566838914 NumSW_IdField 965;
BA_ "SigType" SG_ 2566838914 NumSW_IdField 1;
BA_ "CI_FullName" SG_ 2566838915 Bootloader_Id_Byte_08 "Software Identification";
BA_ "CI_ParId" SG_ 2566838915 Bootloader_Id_Byte_08 "ESMD_03139";
BA_ "CI_SLOT_Name" SG_ 2566838915 Bootloader_Id_Byte_08 "SAEatad0200";
BA_ "SPN" SG_ 2566838915 Bootloader_Id_Byte_08 234;
BA_ "CI_FullName" SG_ 2566838915 Bootloader_Id_Byte_09 "Software Identification";
BA_ "CI_ParId" SG_ 2566838915 Bootloader_Id_Byte_09 "ESMD_03139";
BA_ "CI_SLOT_Name" SG_ 2566838915 Bootloader_Id_Byte_09 "SAEatad0200";
BA_ "SPN" SG_ 2566838915 Bootloader_Id_Byte_09 234;
BA_ "CI_FullName" SG_ 2566838915 Bootloader_Id_Byte_10 "Software Identification";
BA_ "CI_ParId" SG_ 2566838915 Bootloader_Id_Byte_10 "ESMD_03139";
BA_ "CI_SLOT_Name" SG_ 2566838915 Bootloader_Id_Byte_10 "SAEatad0200";
BA_ "SPN" SG_ 2566838915 Bootloader_Id_Byte_10 234;
BA_ "CI_FullName" SG_ 2566838915 Bootloader_Id_Byte_11 "Software Identification";
BA_ "CI_ParId" SG_ 2566838915 Bootloader_Id_Byte_11 "ESMD_03139";
BA_ "CI_SLOT_Name" SG_ 2566838915 Bootloader_Id_Byte_11 "SAEatad0200";
BA_ "SPN" SG_ 2566838915 Bootloader_Id_Byte_11 234;
BA_ "CI_FullName" SG_ 2566838915 Bootloader_Id_Byte_12 "Software Identification";
BA_ "CI_ParId" SG_ 2566838915 Bootloader_Id_Byte_12 "ESMD_03139";
BA_ "CI_SLOT_Name" SG_ 2566838915 Bootloader_Id_Byte_12 "SAEatad0200";
BA_ "SPN" SG_ 2566838915 Bootloader_Id_Byte_12 234;
BA_ "CI_FullName" SG_ 2566838915 Bootloader_Id_Byte_13 "Software Identification";
BA_ "CI_ParId" SG_ 2566838915 Bootloader_Id_Byte_13 "ESMD_03139";
BA_ "CI_SLOT_Name" SG_ 2566838915 Bootloader_Id_Byte_13 "SAEatad0200";
BA_ "SPN" SG_ 2566838915 Bootloader_Id_Byte_13 234;
BA_ "CI_FullName" SG_ 2566838915 Bootloader_Id_Byte_14 "Software Identification";
BA_ "CI_ParId" SG_ 2566838915 Bootloader_Id_Byte_14 "ESMD_03139";
BA_ "CI_SLOT_Name" SG_ 2566838915 Bootloader_Id_Byte_14 "SAEatad0200";
BA_ "SPN" SG_ 2566838915 Bootloader_Id_Byte_14 234;
BA_ "CI_FullName" SG_ 2566838915 Bootloader_Id_Byte_15 "Software Identification";
BA_ "CI_ParId" SG_ 2566838915 Bootloader_Id_Byte_15 "ESMD_03139";
BA_ "CI_SLOT_Name" SG_ 2566838915 Bootloader_Id_Byte_15 "SAEatad0200";
BA_ "SPN" SG_ 2566838915 Bootloader_Id_Byte_15 234;
BA_ "CI_FullName" SG_ 2566838915 Bootloader_Id_Byte_16 "Software Identification";
BA_ "CI_ParId" SG_ 2566838915 Bootloader_Id_Byte_16 "ESMD_03139";
BA_ "CI_SLOT_Name" SG_ 2566838915 Bootloader_Id_Byte_16 "SAEatad0200";
BA_ "SPN" SG_ 2566838915 Bootloader_Id_Byte_16 234;
BA_ "CI_FullName" SG_ 2566838915 Bootloader_Id_Byte_17 "Software Identification";
BA_ "CI_ParId" SG_ 2566838915 Bootloader_Id_Byte_17 "ESMD_03139";
BA_ "CI_SLOT_Name" SG_ 2566838915 Bootloader_Id_Byte_17 "SAEatad0200";
BA_ "SPN" SG_ 2566838915 Bootloader_Id_Byte_17 234;
BA_ "CI_FullName" SG_ 2566838915 Bootloader_Id_Byte_18 "Software Identification";
BA_ "CI_ParId" SG_ 2566838915 Bootloader_Id_Byte_18 "ESMD_03139";
BA_ "CI_SLOT_Name" SG_ 2566838915 Bootloader_Id_Byte_18 "SAEatad0200";
BA_ "SPN" SG_ 2566838915 Bootloader_Id_Byte_18 234;
BA_ "CI_FullName" SG_ 2566838915 Bootloader_Id_Byte_19 "Software Identification";
BA_ "CI_ParId" SG_ 2566838915 Bootloader_Id_Byte_19 "ESMD_03139";
BA_ "CI_SLOT_Name" SG_ 2566838915 Bootloader_Id_Byte_19 "SAEatad0200";
BA_ "SPN" SG_ 2566838915 Bootloader_Id_Byte_19 234;
BA_ "CI_FullName" SG_ 2566838915 Bootloader_Id_Byte_20 "Software Identification";
BA_ "CI_ParId" SG_ 2566838915 Bootloader_Id_Byte_20 "ESMD_03139";
BA_ "CI_SLOT_Name" SG_ 2566838915 Bootloader_Id_Byte_20 "SAEatad0200";
BA_ "SPN" SG_ 2566838915 Bootloader_Id_Byte_20 234;
BA_ "CI_FullName" SG_ 2566838915 Bootloader_Id_Byte_21 "Software Identification";
BA_ "CI_ParId" SG_ 2566838915 Bootloader_Id_Byte_21 "ESMD_03139";
BA_ "CI_SLOT_Name" SG_ 2566838915 Bootloader_Id_Byte_21 "SAEatad0200";
BA_ "SPN" SG_ 2566838915 Bootloader_Id_Byte_21 234;
BA_ "CI_FullName" SG_ 2566838915 Bootloader_Id_Byte_22 "Software Identification";
BA_ "CI_ParId" SG_ 2566838915 Bootloader_Id_Byte_22 "ESMD_03139";
BA_ "CI_SLOT_Name" SG_ 2566838915 Bootloader_Id_Byte_22 "SAEatad0200";
BA_ "SPN" SG_ 2566838915 Bootloader_Id_Byte_22 234;
BA_ "CI_FullName" SG_ 2566838915 Bootloader_Id_Byte_23 "Software Identification";
BA_ "CI_ParId" SG_ 2566838915 Bootloader_Id_Byte_23 "ESMD_03139";
BA_ "CI_SLOT_Name" SG_ 2566838915 Bootloader_Id_Byte_23 "SAEatad0200";
BA_ "SPN" SG_ 2566838915 Bootloader_Id_Byte_23 234;
BA_ "CI_FullName" SG_ 2566838915 Bootloader_Id_Byte_24 "Software Identification";
BA_ "CI_ParId" SG_ 2566838915 Bootloader_Id_Byte_24 "ESMD_03139";
BA_ "CI_SLOT_Name" SG_ 2566838915 Bootloader_Id_Byte_24 "SAEatad0200";
BA_ "SPN" SG_ 2566838915 Bootloader_Id_Byte_24 234;
BA_ "CI_FullName" SG_ 2566838915 Bootloader_Id_Byte_25 "Software Identification";
BA_ "CI_ParId" SG_ 2566838915 Bootloader_Id_Byte_25 "ESMD_03139";
BA_ "CI_SLOT_Name" SG_ 2566838915 Bootloader_Id_Byte_25 "SAEatad0200";
BA_ "SPN" SG_ 2566838915 Bootloader_Id_Byte_25 234;
BA_ "CI_FullName" SG_ 2566838915 Bootloader_Id_Byte_26 "Software Identification";
BA_ "CI_ParId" SG_ 2566838915 Bootloader_Id_Byte_26 "ESMD_03139";
BA_ "CI_SLOT_Name" SG_ 2566838915 Bootloader_Id_Byte_26 "SAEatad0200";
BA_ "SPN" SG_ 2566838915 Bootloader_Id_Byte_26 234;
BA_ "CI_FullName" SG_ 2566838915 Bootloader_Id_Byte_27 "Software Identification";
BA_ "CI_ParId" SG_ 2566838915 Bootloader_Id_Byte_27 "ESMD_03139";
BA_ "CI_SLOT_Name" SG_ 2566838915 Bootloader_Id_Byte_27 "SAEatad0200";
BA_ "SPN" SG_ 2566838915 Bootloader_Id_Byte_27 234;
BA_ "CI_FullName" SG_ 2566838915 Bootloader_Id_Byte_28 "Software Identification";
BA_ "CI_ParId" SG_ 2566838915 Bootloader_Id_Byte_28 "ESMD_03139";
BA_ "CI_SLOT_Name" SG_ 2566838915 Bootloader_Id_Byte_28 "SAEatad0200";
BA_ "SPN" SG_ 2566838915 Bootloader_Id_Byte_28 234;
BA_ "CI_FullName" SG_ 2566838915 Bootloader_Id_Byte_29 "Software Identification";
BA_ "CI_ParId" SG_ 2566838915 Bootloader_Id_Byte_29 "ESMD_03139";
BA_ "CI_SLOT_Name" SG_ 2566838915 Bootloader_Id_Byte_29 "SAEatad0200";
BA_ "SPN" SG_ 2566838915 Bootloader_Id_Byte_29 234;
BA_ "CI_FullName" SG_ 2566838915 Bootloader_Id_Byte_30 "Software Identification";
BA_ "CI_ParId" SG_ 2566838915 Bootloader_Id_Byte_30 "ESMD_03139";
BA_ "CI_SLOT_Name" SG_ 2566838915 Bootloader_Id_Byte_30 "SAEatad0200";
BA_ "SPN" SG_ 2566838915 Bootloader_Id_Byte_30 234;
BA_ "CI_FullName" SG_ 2566838915 Bootloader_Id_Byte_31 "Software Identification";
BA_ "CI_ParId" SG_ 2566838915 Bootloader_Id_Byte_31 "ESMD_03139";
BA_ "CI_SLOT_Name" SG_ 2566838915 Bootloader_Id_Byte_31 "SAEatad0200";
BA_ "SPN" SG_ 2566838915 Bootloader_Id_Byte_31 234;
BA_ "CI_FullName" SG_ 2566838915 Bootloader_Id_Byte_32 "Software Identification";
BA_ "CI_ParId" SG_ 2566838915 Bootloader_Id_Byte_32 "ESMD_03139";
BA_ "CI_SLOT_Name" SG_ 2566838915 Bootloader_Id_Byte_32 "SAEatad0200";
BA_ "SPN" SG_ 2566838915 Bootloader_Id_Byte_32 234;
BA_ "CI_FullName" SG_ 2566838915 Bootloader_Id_Byte_33 "Software Identification";
BA_ "CI_ParId" SG_ 2566838915 Bootloader_Id_Byte_33 "ESMD_03139";
BA_ "CI_SLOT_Name" SG_ 2566838915 Bootloader_Id_Byte_33 "SAEatad0200";
BA_ "SPN" SG_ 2566838915 Bootloader_Id_Byte_33 234;
BA_ "CI_FullName" SG_ 2566838915 Bootloader_Id_Byte_34 "Software Identification";
BA_ "CI_ParId" SG_ 2566838915 Bootloader_Id_Byte_34 "ESMD_03139";
BA_ "CI_SLOT_Name" SG_ 2566838915 Bootloader_Id_Byte_34 "SAEatad0200";
BA_ "SPN" SG_ 2566838915 Bootloader_Id_Byte_34 234;
BA_ "CI_FullName" SG_ 2566838915 Bootloader_Id_Byte_35 "Software Identification";
BA_ "CI_ParId" SG_ 2566838915 Bootloader_Id_Byte_35 "ESMD_03139";
BA_ "CI_SLOT_Name" SG_ 2566838915 Bootloader_Id_Byte_35 "SAEatad0200";
BA_ "SPN" SG_ 2566838915 Bootloader_Id_Byte_35 234;
BA_ "CI_FullName" SG_ 2566838915 Bootloader_Id_Byte_36 "Software Identification";
BA_ "CI_ParId" SG_ 2566838915 Bootloader_Id_Byte_36 "ESMD_03139";
BA_ "CI_SLOT_Name" SG_ 2566838915 Bootloader_Id_Byte_36 "SAEatad0200";
BA_ "SPN" SG_ 2566838915 Bootloader_Id_Byte_36 234;
BA_ "CI_FullName" SG_ 2566838915 Bootloader_Id_Byte_37 "Software Identification";
BA_ "CI_ParId" SG_ 2566838915 Bootloader_Id_Byte_37 "ESMD_03139";
BA_ "CI_SLOT_Name" SG_ 2566838915 Bootloader_Id_Byte_37 "SAEatad0200";
BA_ "SPN" SG_ 2566838915 Bootloader_Id_Byte_37 234;
BA_ "CI_FullName" SG_ 2566838915 Bootloader_Id_Byte_38 "Software Identification";
BA_ "CI_ParId" SG_ 2566838915 Bootloader_Id_Byte_38 "ESMD_03139";
BA_ "CI_SLOT_Name" SG_ 2566838915 Bootloader_Id_Byte_38 "SAEatad0200";
BA_ "SPN" SG_ 2566838915 Bootloader_Id_Byte_38 234;
BA_ "CI_FullName" SG_ 2566838915 Bootloader_Id_Byte_39 "Software Identification";
BA_ "CI_ParId" SG_ 2566838915 Bootloader_Id_Byte_39 "ESMD_03139";
BA_ "CI_SLOT_Name" SG_ 2566838915 Bootloader_Id_Byte_39 "SAEatad0200";
BA_ "SPN" SG_ 2566838915 Bootloader_Id_Byte_39 234;
BA_ "CI_FullName" SG_ 2566838915 Bootloader_Id_Enum "Software Identification";
BA_ "CI_ParId" SG_ 2566838915 Bootloader_Id_Enum "ESMD_03139";
BA_ "CI_SLOT_Name" SG_ 2566838915 Bootloader_Id_Enum "SAEbs24";
BA_ "SPN" SG_ 2566838915 Bootloader_Id_Enum 234;
BA_ "CI_FullName" SG_ 2566838915 EndStrng_00 "Software Identification";
BA_ "CI_ParId" SG_ 2566838915 EndStrng_00 "ESMD_21930";
BA_ "CI_SLOT_Name" SG_ 2566838915 EndStrng_00 "SAEatad0200";
BA_ "GenSigStartValue" SG_ 2566838915 EndStrng_00 42;
BA_ "SigType" SG_ 2566838915 EndStrng_00 8;
BA_ "CI_FullName" SG_ 2566838915 EndStrng_01 "Software Identification";
BA_ "CI_ParId" SG_ 2566838915 EndStrng_01 "ESMD_21931";
BA_ "CI_SLOT_Name" SG_ 2566838915 EndStrng_01 "SAEatad0200";
BA_ "GenSigStartValue" SG_ 2566838915 EndStrng_01 42;
BA_ "SigType" SG_ 2566838915 EndStrng_01 8;
BA_ "GenSigAutoGenSnd" SG_ 2566838915 NumSW_IdField 0;
BA_ "GenSigAutoGenDsp" SG_ 2566838915 NumSW_IdField 0;
BA_ "CI_RepetitionComplemented" SG_ 2566838915 NumSW_IdField 2;
BA_ "CI_FullName" SG_ 2566838915 NumSW_IdField "Number of Software Identification Fields";
BA_ "CI_ParId" SG_ 2566838915 NumSW_IdField "ESMD_02746";
BA_ "CI_SLOT_Name" SG_ 2566838915 NumSW_IdField "SAEst01";
BA_ "SPN" SG_ 2566838915 NumSW_IdField 965;
BA_ "SigType" SG_ 2566838915 NumSW_IdField 1;
BA_ "CI_FullName" SG_ 2566838915 Appl_Id "Software Identification";
BA_ "CI_ParId" SG_ 2566838915 Appl_Id "ESMD_03139";
BA_ "CI_SLOT_Name" SG_ 2566838915 Appl_Id "SAEatad0200";
BA_ "SPN" SG_ 2566838915 Appl_Id 234;
BA_ "CI_FullName" SG_ 2566838915 Appl_Id_Byte_01 "Software Identification";
BA_ "CI_ParId" SG_ 2566838915 Appl_Id_Byte_01 "ESMD_03139";
BA_ "CI_SLOT_Name" SG_ 2566838915 Appl_Id_Byte_01 "SAEatad0200";
BA_ "SPN" SG_ 2566838915 Appl_Id_Byte_01 234;
BA_ "CI_FullName" SG_ 2566838915 Appl_Id_Byte_02 "Software Identification";
BA_ "CI_ParId" SG_ 2566838915 Appl_Id_Byte_02 "ESMD_03139";
BA_ "CI_SLOT_Name" SG_ 2566838915 Appl_Id_Byte_02 "SAEatad0200";
BA_ "SPN" SG_ 2566838915 Appl_Id_Byte_02 234;
BA_ "CI_FullName" SG_ 2566838915 Appl_Id_Byte_03 "Software Identification";
BA_ "CI_ParId" SG_ 2566838915 Appl_Id_Byte_03 "ESMD_03139";
BA_ "CI_SLOT_Name" SG_ 2566838915 Appl_Id_Byte_03 "SAEatad0200";
BA_ "SPN" SG_ 2566838915 Appl_Id_Byte_03 234;
BA_ "CI_FullName" SG_ 2566838915 Appl_Id_Byte_04 "Software Identification";
BA_ "CI_ParId" SG_ 2566838915 Appl_Id_Byte_04 "ESMD_03139";
BA_ "CI_SLOT_Name" SG_ 2566838915 Appl_Id_Byte_04 "SAEatad0200";
BA_ "SPN" SG_ 2566838915 Appl_Id_Byte_04 234;
BA_ "CI_FullName" SG_ 2566838915 Appl_Id_Byte_05 "Software Identification";
BA_ "CI_ParId" SG_ 2566838915 Appl_Id_Byte_05 "ESMD_03139";
BA_ "CI_SLOT_Name" SG_ 2566838915 Appl_Id_Byte_05 "SAEatad0200";
BA_ "SPN" SG_ 2566838915 Appl_Id_Byte_05 234;
BA_ "CI_FullName" SG_ 2566838915 Appl_Id_Byte_06 "Software Identification";
BA_ "CI_ParId" SG_ 2566838915 Appl_Id_Byte_06 "ESMD_03139";
BA_ "CI_SLOT_Name" SG_ 2566838915 Appl_Id_Byte_06 "SAEatad0200";
BA_ "SPN" SG_ 2566838915 Appl_Id_Byte_06 234;
BA_ "CI_FullName" SG_ 2566838915 Appl_Id_Byte_07 "Software Identification";
BA_ "CI_ParId" SG_ 2566838915 Appl_Id_Byte_07 "ESMD_03139";
BA_ "CI_SLOT_Name" SG_ 2566838915 Appl_Id_Byte_07 "SAEatad0200";
BA_ "SPN" SG_ 2566838915 Appl_Id_Byte_07 234;
BA_ "CI_FullName" SG_ 2566838915 Appl_Id_Byte_08 "Software Identification";
BA_ "CI_ParId" SG_ 2566838915 Appl_Id_Byte_08 "ESMD_03139";
BA_ "CI_SLOT_Name" SG_ 2566838915 Appl_Id_Byte_08 "SAEatad0200";
BA_ "SPN" SG_ 2566838915 Appl_Id_Byte_08 234;
BA_ "CI_FullName" SG_ 2566838915 Appl_Id_Byte_09 "Software Identification";
BA_ "CI_ParId" SG_ 2566838915 Appl_Id_Byte_09 "ESMD_03139";
BA_ "CI_SLOT_Name" SG_ 2566838915 Appl_Id_Byte_09 "SAEatad0200";
BA_ "SPN" SG_ 2566838915 Appl_Id_Byte_09 234;
BA_ "CI_FullName" SG_ 2566838915 Appl_Id_Byte_10 "Software Identification";
BA_ "CI_ParId" SG_ 2566838915 Appl_Id_Byte_10 "ESMD_03139";
BA_ "CI_SLOT_Name" SG_ 2566838915 Appl_Id_Byte_10 "SAEatad0200";
BA_ "SPN" SG_ 2566838915 Appl_Id_Byte_10 234;
BA_ "CI_FullName" SG_ 2566838915 Appl_Id_Byte_11 "Software Identification";
BA_ "CI_ParId" SG_ 2566838915 Appl_Id_Byte_11 "ESMD_03139";
BA_ "CI_SLOT_Name" SG_ 2566838915 Appl_Id_Byte_11 "SAEatad0200";
BA_ "SPN" SG_ 2566838915 Appl_Id_Byte_11 234;
BA_ "CI_FullName" SG_ 2566838915 Appl_Id_Byte_12 "Software Identification";
BA_ "CI_ParId" SG_ 2566838915 Appl_Id_Byte_12 "ESMD_03139";
BA_ "CI_SLOT_Name" SG_ 2566838915 Appl_Id_Byte_12 "SAEatad0200";
BA_ "SPN" SG_ 2566838915 Appl_Id_Byte_12 234;
BA_ "CI_FullName" SG_ 2566838915 Appl_Id_Byte_13 "Software Identification";
BA_ "CI_ParId" SG_ 2566838915 Appl_Id_Byte_13 "ESMD_03139";
BA_ "CI_SLOT_Name" SG_ 2566838915 Appl_Id_Byte_13 "SAEatad0200";
BA_ "SPN" SG_ 2566838915 Appl_Id_Byte_13 234;
BA_ "CI_FullName" SG_ 2566838915 Appl_Id_Byte_14 "Software Identification";
BA_ "CI_ParId" SG_ 2566838915 Appl_Id_Byte_14 "ESMD_03139";
BA_ "CI_SLOT_Name" SG_ 2566838915 Appl_Id_Byte_14 "SAEatad0200";
BA_ "SPN" SG_ 2566838915 Appl_Id_Byte_14 234;
BA_ "CI_FullName" SG_ 2566838915 Appl_Id_Byte_15 "Software Identification";
BA_ "CI_ParId" SG_ 2566838915 Appl_Id_Byte_15 "ESMD_03139";
BA_ "CI_SLOT_Name" SG_ 2566838915 Appl_Id_Byte_15 "SAEatad0200";
BA_ "SPN" SG_ 2566838915 Appl_Id_Byte_15 234;
BA_ "CI_FullName" SG_ 2566838915 Appl_Id_Byte_16 "Software Identification";
BA_ "CI_ParId" SG_ 2566838915 Appl_Id_Byte_16 "ESMD_03139";
BA_ "CI_SLOT_Name" SG_ 2566838915 Appl_Id_Byte_16 "SAEatad0200";
BA_ "SPN" SG_ 2566838915 Appl_Id_Byte_16 234;
BA_ "CI_FullName" SG_ 2566838915 Appl_Id_Byte_17 "Software Identification";
BA_ "CI_ParId" SG_ 2566838915 Appl_Id_Byte_17 "ESMD_03139";
BA_ "CI_SLOT_Name" SG_ 2566838915 Appl_Id_Byte_17 "SAEatad0200";
BA_ "SPN" SG_ 2566838915 Appl_Id_Byte_17 234;
BA_ "CI_FullName" SG_ 2566838915 Appl_Id_Byte_18 "Software Identification";
BA_ "CI_ParId" SG_ 2566838915 Appl_Id_Byte_18 "ESMD_03139";
BA_ "CI_SLOT_Name" SG_ 2566838915 Appl_Id_Byte_18 "SAEatad0200";
BA_ "SPN" SG_ 2566838915 Appl_Id_Byte_18 234;
BA_ "CI_FullName" SG_ 2566838915 Appl_Id_Byte_19 "Software Identification";
BA_ "CI_ParId" SG_ 2566838915 Appl_Id_Byte_19 "ESMD_03139";
BA_ "CI_SLOT_Name" SG_ 2566838915 Appl_Id_Byte_19 "SAEatad0200";
BA_ "SPN" SG_ 2566838915 Appl_Id_Byte_19 234;
BA_ "CI_FullName" SG_ 2566838915 Appl_Id_Byte_20 "Software Identification";
BA_ "CI_ParId" SG_ 2566838915 Appl_Id_Byte_20 "ESMD_03139";
BA_ "CI_SLOT_Name" SG_ 2566838915 Appl_Id_Byte_20 "SAEatad0200";
BA_ "SPN" SG_ 2566838915 Appl_Id_Byte_20 234;
BA_ "CI_FullName" SG_ 2566838915 Appl_Id_Byte_21 "Software Identification";
BA_ "CI_ParId" SG_ 2566838915 Appl_Id_Byte_21 "ESMD_03139";
BA_ "CI_SLOT_Name" SG_ 2566838915 Appl_Id_Byte_21 "SAEatad0200";
BA_ "SPN" SG_ 2566838915 Appl_Id_Byte_21 234;
BA_ "CI_FullName" SG_ 2566838915 Appl_Id_Byte_22 "Software Identification";
BA_ "CI_ParId" SG_ 2566838915 Appl_Id_Byte_22 "ESMD_03139";
BA_ "CI_SLOT_Name" SG_ 2566838915 Appl_Id_Byte_22 "SAEatad0200";
BA_ "SPN" SG_ 2566838915 Appl_Id_Byte_22 234;
BA_ "CI_FullName" SG_ 2566838915 Appl_Id_Byte_23 "Software Identification";
BA_ "CI_ParId" SG_ 2566838915 Appl_Id_Byte_23 "ESMD_03139";
BA_ "CI_SLOT_Name" SG_ 2566838915 Appl_Id_Byte_23 "SAEatad0200";
BA_ "SPN" SG_ 2566838915 Appl_Id_Byte_23 234;
BA_ "CI_FullName" SG_ 2566838915 Appl_Id_Byte_24 "Software Identification";
BA_ "CI_ParId" SG_ 2566838915 Appl_Id_Byte_24 "ESMD_03139";
BA_ "CI_SLOT_Name" SG_ 2566838915 Appl_Id_Byte_24 "SAEatad0200";
BA_ "SPN" SG_ 2566838915 Appl_Id_Byte_24 234;
BA_ "CI_FullName" SG_ 2566838915 Appl_Id_Byte_25 "Software Identification";
BA_ "CI_ParId" SG_ 2566838915 Appl_Id_Byte_25 "ESMD_03139";
BA_ "CI_SLOT_Name" SG_ 2566838915 Appl_Id_Byte_25 "SAEatad0200";
BA_ "SPN" SG_ 2566838915 Appl_Id_Byte_25 234;
BA_ "CI_FullName" SG_ 2566838915 Appl_Id_Byte_26 "Software Identification";
BA_ "CI_ParId" SG_ 2566838915 Appl_Id_Byte_26 "ESMD_03139";
BA_ "CI_SLOT_Name" SG_ 2566838915 Appl_Id_Byte_26 "SAEatad0200";
BA_ "SPN" SG_ 2566838915 Appl_Id_Byte_26 234;
BA_ "CI_FullName" SG_ 2566838915 Appl_Id_Byte_27 "Software Identification";
BA_ "CI_ParId" SG_ 2566838915 Appl_Id_Byte_27 "ESMD_03139";
BA_ "CI_SLOT_Name" SG_ 2566838915 Appl_Id_Byte_27 "SAEatad0200";
BA_ "SPN" SG_ 2566838915 Appl_Id_Byte_27 234;
BA_ "CI_FullName" SG_ 2566838915 Appl_Id_Byte_28 "Software Identification";
BA_ "CI_ParId" SG_ 2566838915 Appl_Id_Byte_28 "ESMD_03139";
BA_ "CI_SLOT_Name" SG_ 2566838915 Appl_Id_Byte_28 "SAEatad0200";
BA_ "SPN" SG_ 2566838915 Appl_Id_Byte_28 234;
BA_ "CI_FullName" SG_ 2566838915 Appl_Id_Byte_29 "Software Identification";
BA_ "CI_ParId" SG_ 2566838915 Appl_Id_Byte_29 "ESMD_03139";
BA_ "CI_SLOT_Name" SG_ 2566838915 Appl_Id_Byte_29 "SAEatad0200";
BA_ "SPN" SG_ 2566838915 Appl_Id_Byte_29 234;
BA_ "CI_FullName" SG_ 2566838915 Appl_Id_Byte_30 "Software Identification";
BA_ "CI_ParId" SG_ 2566838915 Appl_Id_Byte_30 "ESMD_03139";
BA_ "CI_SLOT_Name" SG_ 2566838915 Appl_Id_Byte_30 "SAEatad0200";
BA_ "SPN" SG_ 2566838915 Appl_Id_Byte_30 234;
BA_ "CI_FullName" SG_ 2566838915 Appl_Id_Byte_31 "Software Identification";
BA_ "CI_ParId" SG_ 2566838915 Appl_Id_Byte_31 "ESMD_03139";
BA_ "CI_SLOT_Name" SG_ 2566838915 Appl_Id_Byte_31 "SAEatad0200";
BA_ "SPN" SG_ 2566838915 Appl_Id_Byte_31 234;
BA_ "CI_FullName" SG_ 2566838915 Appl_Id_Byte_32 "Software Identification";
BA_ "CI_ParId" SG_ 2566838915 Appl_Id_Byte_32 "ESMD_03139";
BA_ "CI_SLOT_Name" SG_ 2566838915 Appl_Id_Byte_32 "SAEatad0200";
BA_ "SPN" SG_ 2566838915 Appl_Id_Byte_32 234;
BA_ "CI_FullName" SG_ 2566838915 Appl_Id_Byte_33 "Software Identification";
BA_ "CI_ParId" SG_ 2566838915 Appl_Id_Byte_33 "ESMD_03139";
BA_ "CI_SLOT_Name" SG_ 2566838915 Appl_Id_Byte_33 "SAEatad0200";
BA_ "SPN" SG_ 2566838915 Appl_Id_Byte_33 234;
BA_ "CI_FullName" SG_ 2566838915 Appl_Id_Byte_34 "Software Identification";
BA_ "CI_ParId" SG_ 2566838915 Appl_Id_Byte_34 "ESMD_03139";
BA_ "CI_SLOT_Name" SG_ 2566838915 Appl_Id_Byte_34 "SAEatad0200";
BA_ "SPN" SG_ 2566838915 Appl_Id_Byte_34 234;
BA_ "CI_FullName" SG_ 2566838915 Appl_Id_Byte_35 "Software Identification";
BA_ "CI_ParId" SG_ 2566838915 Appl_Id_Byte_35 "ESMD_03139";
BA_ "CI_SLOT_Name" SG_ 2566838915 Appl_Id_Byte_35 "SAEatad0200";
BA_ "SPN" SG_ 2566838915 Appl_Id_Byte_35 234;
BA_ "CI_FullName" SG_ 2566838915 Appl_Id_Byte_36 "Software Identification";
BA_ "CI_ParId" SG_ 2566838915 Appl_Id_Byte_36 "ESMD_03139";
BA_ "CI_SLOT_Name" SG_ 2566838915 Appl_Id_Byte_36 "SAEatad0200";
BA_ "SPN" SG_ 2566838915 Appl_Id_Byte_36 234;
BA_ "CI_FullName" SG_ 2566838915 Appl_Id_Byte_37 "Software Identification";
BA_ "CI_ParId" SG_ 2566838915 Appl_Id_Byte_37 "ESMD_03139";
BA_ "CI_SLOT_Name" SG_ 2566838915 Appl_Id_Byte_37 "SAEatad0200";
BA_ "SPN" SG_ 2566838915 Appl_Id_Byte_37 234;
BA_ "CI_FullName" SG_ 2566838915 Appl_Id_Byte_38 "Software Identification";
BA_ "CI_ParId" SG_ 2566838915 Appl_Id_Byte_38 "ESMD_03139";
BA_ "CI_SLOT_Name" SG_ 2566838915 Appl_Id_Byte_38 "SAEatad0200";
BA_ "SPN" SG_ 2566838915 Appl_Id_Byte_38 234;
BA_ "CI_FullName" SG_ 2566838915 Appl_Id_Byte_39 "Software Identification";
BA_ "CI_ParId" SG_ 2566838915 Appl_Id_Byte_39 "ESMD_03139";
BA_ "CI_SLOT_Name" SG_ 2566838915 Appl_Id_Byte_39 "SAEatad0200";
BA_ "SPN" SG_ 2566838915 Appl_Id_Byte_39 234;
BA_ "CI_FullName" SG_ 2566838915 Appl_Id_Enum "Software Identification";
BA_ "CI_ParId" SG_ 2566838915 Appl_Id_Enum "ESMD_03139";
BA_ "CI_SLOT_Name" SG_ 2566838915 Appl_Id_Enum "SAEbs24";
BA_ "SPN" SG_ 2566838915 Appl_Id_Enum 234;
BA_ "CI_FullName" SG_ 2566838915 Bootloader_Id "Software Identification";
BA_ "CI_ParId" SG_ 2566838915 Bootloader_Id "ESMD_03139";
BA_ "CI_SLOT_Name" SG_ 2566838915 Bootloader_Id "SAEatad0200";
BA_ "SPN" SG_ 2566838915 Bootloader_Id 234;
BA_ "CI_FullName" SG_ 2566838915 Bootloader_Id_Byte_01 "Software Identification";
BA_ "CI_ParId" SG_ 2566838915 Bootloader_Id_Byte_01 "ESMD_03139";
BA_ "CI_SLOT_Name" SG_ 2566838915 Bootloader_Id_Byte_01 "SAEatad0200";
BA_ "SPN" SG_ 2566838915 Bootloader_Id_Byte_01 234;
BA_ "CI_FullName" SG_ 2566838915 Bootloader_Id_Byte_02 "Software Identification";
BA_ "CI_ParId" SG_ 2566838915 Bootloader_Id_Byte_02 "ESMD_03139";
BA_ "CI_SLOT_Name" SG_ 2566838915 Bootloader_Id_Byte_02 "SAEatad0200";
BA_ "SPN" SG_ 2566838915 Bootloader_Id_Byte_02 234;
BA_ "CI_FullName" SG_ 2566838915 Bootloader_Id_Byte_03 "Software Identification";
BA_ "CI_ParId" SG_ 2566838915 Bootloader_Id_Byte_03 "ESMD_03139";
BA_ "CI_SLOT_Name" SG_ 2566838915 Bootloader_Id_Byte_03 "SAEatad0200";
BA_ "SPN" SG_ 2566838915 Bootloader_Id_Byte_03 234;
BA_ "CI_FullName" SG_ 2566838915 Bootloader_Id_Byte_04 "Software Identification";
BA_ "CI_ParId" SG_ 2566838915 Bootloader_Id_Byte_04 "ESMD_03139";
BA_ "CI_SLOT_Name" SG_ 2566838915 Bootloader_Id_Byte_04 "SAEatad0200";
BA_ "SPN" SG_ 2566838915 Bootloader_Id_Byte_04 234;
BA_ "CI_FullName" SG_ 2566838915 Bootloader_Id_Byte_05 "Software Identification";
BA_ "CI_ParId" SG_ 2566838915 Bootloader_Id_Byte_05 "ESMD_03139";
BA_ "CI_SLOT_Name" SG_ 2566838915 Bootloader_Id_Byte_05 "SAEatad0200";
BA_ "SPN" SG_ 2566838915 Bootloader_Id_Byte_05 234;
BA_ "CI_FullName" SG_ 2566838915 Bootloader_Id_Byte_06 "Software Identification";
BA_ "CI_ParId" SG_ 2566838915 Bootloader_Id_Byte_06 "ESMD_03139";
BA_ "CI_SLOT_Name" SG_ 2566838915 Bootloader_Id_Byte_06 "SAEatad0200";
BA_ "SPN" SG_ 2566838915 Bootloader_Id_Byte_06 234;
BA_ "CI_FullName" SG_ 2566838915 Bootloader_Id_Byte_07 "Software Identification";
BA_ "CI_ParId" SG_ 2566838915 Bootloader_Id_Byte_07 "ESMD_03139";
BA_ "CI_SLOT_Name" SG_ 2566838915 Bootloader_Id_Byte_07 "SAEatad0200";
BA_ "SPN" SG_ 2566838915 Bootloader_Id_Byte_07 234;
BA_ "CI_FullName" SG_ 2566838916 Appl_Id "Software Identification";
BA_ "CI_ParId" SG_ 2566838916 Appl_Id "ESMD_03139";
BA_ "CI_SLOT_Name" SG_ 2566838916 Appl_Id "SAEatad0200";
BA_ "SPN" SG_ 2566838916 Appl_Id 234;
BA_ "CI_FullName" SG_ 2566838916 Appl_Id_Byte_01 "Software Identification";
BA_ "CI_ParId" SG_ 2566838916 Appl_Id_Byte_01 "ESMD_03139";
BA_ "CI_SLOT_Name" SG_ 2566838916 Appl_Id_Byte_01 "SAEatad0200";
BA_ "SPN" SG_ 2566838916 Appl_Id_Byte_01 234;
BA_ "CI_FullName" SG_ 2566838916 Appl_Id_Byte_02 "Software Identification";
BA_ "CI_ParId" SG_ 2566838916 Appl_Id_Byte_02 "ESMD_03139";
BA_ "CI_SLOT_Name" SG_ 2566838916 Appl_Id_Byte_02 "SAEatad0200";
BA_ "SPN" SG_ 2566838916 Appl_Id_Byte_02 234;
BA_ "CI_FullName" SG_ 2566838916 Appl_Id_Byte_03 "Software Identification";
BA_ "CI_ParId" SG_ 2566838916 Appl_Id_Byte_03 "ESMD_03139";
BA_ "CI_SLOT_Name" SG_ 2566838916 Appl_Id_Byte_03 "SAEatad0200";
BA_ "SPN" SG_ 2566838916 Appl_Id_Byte_03 234;
BA_ "CI_FullName" SG_ 2566838916 Appl_Id_Byte_04 "Software Identification";
BA_ "CI_ParId" SG_ 2566838916 Appl_Id_Byte_04 "ESMD_03139";
BA_ "CI_SLOT_Name" SG_ 2566838916 Appl_Id_Byte_04 "SAEatad0200";
BA_ "SPN" SG_ 2566838916 Appl_Id_Byte_04 234;
BA_ "CI_FullName" SG_ 2566838916 Appl_Id_Byte_05 "Software Identification";
BA_ "CI_ParId" SG_ 2566838916 Appl_Id_Byte_05 "ESMD_03139";
BA_ "CI_SLOT_Name" SG_ 2566838916 Appl_Id_Byte_05 "SAEatad0200";
BA_ "SPN" SG_ 2566838916 Appl_Id_Byte_05 234;
BA_ "CI_FullName" SG_ 2566838916 Appl_Id_Byte_06 "Software Identification";
BA_ "CI_ParId" SG_ 2566838916 Appl_Id_Byte_06 "ESMD_03139";
BA_ "CI_SLOT_Name" SG_ 2566838916 Appl_Id_Byte_06 "SAEatad0200";
BA_ "SPN" SG_ 2566838916 Appl_Id_Byte_06 234;
BA_ "CI_FullName" SG_ 2566838916 Appl_Id_Byte_07 "Software Identification";
BA_ "CI_ParId" SG_ 2566838916 Appl_Id_Byte_07 "ESMD_03139";
BA_ "CI_SLOT_Name" SG_ 2566838916 Appl_Id_Byte_07 "SAEatad0200";
BA_ "SPN" SG_ 2566838916 Appl_Id_Byte_07 234;
BA_ "CI_FullName" SG_ 2566838916 Appl_Id_Byte_08 "Software Identification";
BA_ "CI_ParId" SG_ 2566838916 Appl_Id_Byte_08 "ESMD_03139";
BA_ "CI_SLOT_Name" SG_ 2566838916 Appl_Id_Byte_08 "SAEatad0200";
BA_ "SPN" SG_ 2566838916 Appl_Id_Byte_08 234;
BA_ "CI_FullName" SG_ 2566838916 Appl_Id_Byte_09 "Software Identification";
BA_ "CI_ParId" SG_ 2566838916 Appl_Id_Byte_09 "ESMD_03139";
BA_ "CI_SLOT_Name" SG_ 2566838916 Appl_Id_Byte_09 "SAEatad0200";
BA_ "SPN" SG_ 2566838916 Appl_Id_Byte_09 234;
BA_ "CI_FullName" SG_ 2566838916 Appl_Id_Byte_10 "Software Identification";
BA_ "CI_ParId" SG_ 2566838916 Appl_Id_Byte_10 "ESMD_03139";
BA_ "CI_SLOT_Name" SG_ 2566838916 Appl_Id_Byte_10 "SAEatad0200";
BA_ "SPN" SG_ 2566838916 Appl_Id_Byte_10 234;
BA_ "CI_FullName" SG_ 2566838916 Appl_Id_Byte_11 "Software Identification";
BA_ "CI_ParId" SG_ 2566838916 Appl_Id_Byte_11 "ESMD_03139";
BA_ "CI_SLOT_Name" SG_ 2566838916 Appl_Id_Byte_11 "SAEatad0200";
BA_ "SPN" SG_ 2566838916 Appl_Id_Byte_11 234;
BA_ "CI_FullName" SG_ 2566838916 Appl_Id_Byte_12 "Software Identification";
BA_ "CI_ParId" SG_ 2566838916 Appl_Id_Byte_12 "ESMD_03139";
BA_ "CI_SLOT_Name" SG_ 2566838916 Appl_Id_Byte_12 "SAEatad0200";
BA_ "SPN" SG_ 2566838916 Appl_Id_Byte_12 234;
BA_ "CI_FullName" SG_ 2566838916 Appl_Id_Byte_13 "Software Identification";
BA_ "CI_ParId" SG_ 2566838916 Appl_Id_Byte_13 "ESMD_03139";
BA_ "CI_SLOT_Name" SG_ 2566838916 Appl_Id_Byte_13 "SAEatad0200";
BA_ "SPN" SG_ 2566838916 Appl_Id_Byte_13 234;
BA_ "CI_FullName" SG_ 2566838916 Appl_Id_Byte_14 "Software Identification";
BA_ "CI_ParId" SG_ 2566838916 Appl_Id_Byte_14 "ESMD_03139";
BA_ "CI_SLOT_Name" SG_ 2566838916 Appl_Id_Byte_14 "SAEatad0200";
BA_ "SPN" SG_ 2566838916 Appl_Id_Byte_14 234;
BA_ "CI_FullName" SG_ 2566838916 Appl_Id_Byte_15 "Software Identification";
BA_ "CI_ParId" SG_ 2566838916 Appl_Id_Byte_15 "ESMD_03139";
BA_ "CI_SLOT_Name" SG_ 2566838916 Appl_Id_Byte_15 "SAEatad0200";
BA_ "SPN" SG_ 2566838916 Appl_Id_Byte_15 234;
BA_ "CI_FullName" SG_ 2566838916 Appl_Id_Byte_16 "Software Identification";
BA_ "CI_ParId" SG_ 2566838916 Appl_Id_Byte_16 "ESMD_03139";
BA_ "CI_SLOT_Name" SG_ 2566838916 Appl_Id_Byte_16 "SAEatad0200";
BA_ "SPN" SG_ 2566838916 Appl_Id_Byte_16 234;
BA_ "CI_FullName" SG_ 2566838916 Appl_Id_Byte_17 "Software Identification";
BA_ "CI_ParId" SG_ 2566838916 Appl_Id_Byte_17 "ESMD_03139";
BA_ "CI_SLOT_Name" SG_ 2566838916 Appl_Id_Byte_17 "SAEatad0200";
BA_ "SPN" SG_ 2566838916 Appl_Id_Byte_17 234;
BA_ "CI_FullName" SG_ 2566838916 Appl_Id_Byte_18 "Software Identification";
BA_ "CI_ParId" SG_ 2566838916 Appl_Id_Byte_18 "ESMD_03139";
BA_ "CI_SLOT_Name" SG_ 2566838916 Appl_Id_Byte_18 "SAEatad0200";
BA_ "SPN" SG_ 2566838916 Appl_Id_Byte_18 234;
BA_ "CI_FullName" SG_ 2566838916 Appl_Id_Byte_19 "Software Identification";
BA_ "CI_ParId" SG_ 2566838916 Appl_Id_Byte_19 "ESMD_03139";
BA_ "CI_SLOT_Name" SG_ 2566838916 Appl_Id_Byte_19 "SAEatad0200";
BA_ "SPN" SG_ 2566838916 Appl_Id_Byte_19 234;
BA_ "CI_FullName" SG_ 2566838916 Appl_Id_Byte_20 "Software Identification";
BA_ "CI_ParId" SG_ 2566838916 Appl_Id_Byte_20 "ESMD_03139";
BA_ "CI_SLOT_Name" SG_ 2566838916 Appl_Id_Byte_20 "SAEatad0200";
BA_ "SPN" SG_ 2566838916 Appl_Id_Byte_20 234;
BA_ "CI_FullName" SG_ 2566838916 Appl_Id_Byte_21 "Software Identification";
BA_ "CI_ParId" SG_ 2566838916 Appl_Id_Byte_21 "ESMD_03139";
BA_ "CI_SLOT_Name" SG_ 2566838916 Appl_Id_Byte_21 "SAEatad0200";
BA_ "SPN" SG_ 2566838916 Appl_Id_Byte_21 234;
BA_ "CI_FullName" SG_ 2566838916 Appl_Id_Byte_22 "Software Identification";
BA_ "CI_ParId" SG_ 2566838916 Appl_Id_Byte_22 "ESMD_03139";
BA_ "CI_SLOT_Name" SG_ 2566838916 Appl_Id_Byte_22 "SAEatad0200";
BA_ "SPN" SG_ 2566838916 Appl_Id_Byte_22 234;
BA_ "CI_FullName" SG_ 2566838916 Appl_Id_Byte_23 "Software Identification";
BA_ "CI_ParId" SG_ 2566838916 Appl_Id_Byte_23 "ESMD_03139";
BA_ "CI_SLOT_Name" SG_ 2566838916 Appl_Id_Byte_23 "SAEatad0200";
BA_ "SPN" SG_ 2566838916 Appl_Id_Byte_23 234;
BA_ "CI_FullName" SG_ 2566838916 Appl_Id_Byte_24 "Software Identification";
BA_ "CI_ParId" SG_ 2566838916 Appl_Id_Byte_24 "ESMD_03139";
BA_ "CI_SLOT_Name" SG_ 2566838916 Appl_Id_Byte_24 "SAEatad0200";
BA_ "SPN" SG_ 2566838916 Appl_Id_Byte_24 234;
BA_ "CI_FullName" SG_ 2566838916 Appl_Id_Byte_25 "Software Identification";
BA_ "CI_ParId" SG_ 2566838916 Appl_Id_Byte_25 "ESMD_03139";
BA_ "CI_SLOT_Name" SG_ 2566838916 Appl_Id_Byte_25 "SAEatad0200";
BA_ "SPN" SG_ 2566838916 Appl_Id_Byte_25 234;
BA_ "CI_FullName" SG_ 2566838916 Appl_Id_Byte_26 "Software Identification";
BA_ "CI_ParId" SG_ 2566838916 Appl_Id_Byte_26 "ESMD_03139";
BA_ "CI_SLOT_Name" SG_ 2566838916 Appl_Id_Byte_26 "SAEatad0200";
BA_ "SPN" SG_ 2566838916 Appl_Id_Byte_26 234;
BA_ "CI_FullName" SG_ 2566838916 Appl_Id_Byte_27 "Software Identification";
BA_ "CI_ParId" SG_ 2566838916 Appl_Id_Byte_27 "ESMD_03139";
BA_ "CI_SLOT_Name" SG_ 2566838916 Appl_Id_Byte_27 "SAEatad0200";
BA_ "SPN" SG_ 2566838916 Appl_Id_Byte_27 234;
BA_ "CI_FullName" SG_ 2566838916 Appl_Id_Byte_28 "Software Identification";
BA_ "CI_ParId" SG_ 2566838916 Appl_Id_Byte_28 "ESMD_03139";
BA_ "CI_SLOT_Name" SG_ 2566838916 Appl_Id_Byte_28 "SAEatad0200";
BA_ "SPN" SG_ 2566838916 Appl_Id_Byte_28 234;
BA_ "CI_FullName" SG_ 2566838916 Appl_Id_Byte_29 "Software Identification";
BA_ "CI_ParId" SG_ 2566838916 Appl_Id_Byte_29 "ESMD_03139";
BA_ "CI_SLOT_Name" SG_ 2566838916 Appl_Id_Byte_29 "SAEatad0200";
BA_ "SPN" SG_ 2566838916 Appl_Id_Byte_29 234;
BA_ "CI_FullName" SG_ 2566838916 Appl_Id_Byte_30 "Software Identification";
BA_ "CI_ParId" SG_ 2566838916 Appl_Id_Byte_30 "ESMD_03139";
BA_ "CI_SLOT_Name" SG_ 2566838916 Appl_Id_Byte_30 "SAEatad0200";
BA_ "SPN" SG_ 2566838916 Appl_Id_Byte_30 234;
BA_ "CI_FullName" SG_ 2566838916 Appl_Id_Byte_31 "Software Identification";
BA_ "CI_ParId" SG_ 2566838916 Appl_Id_Byte_31 "ESMD_03139";
BA_ "CI_SLOT_Name" SG_ 2566838916 Appl_Id_Byte_31 "SAEatad0200";
BA_ "SPN" SG_ 2566838916 Appl_Id_Byte_31 234;
BA_ "CI_FullName" SG_ 2566838916 Appl_Id_Byte_32 "Software Identification";
BA_ "CI_ParId" SG_ 2566838916 Appl_Id_Byte_32 "ESMD_03139";
BA_ "CI_SLOT_Name" SG_ 2566838916 Appl_Id_Byte_32 "SAEatad0200";
BA_ "SPN" SG_ 2566838916 Appl_Id_Byte_32 234;
BA_ "CI_FullName" SG_ 2566838916 Appl_Id_Byte_33 "Software Identification";
BA_ "CI_ParId" SG_ 2566838916 Appl_Id_Byte_33 "ESMD_03139";
BA_ "CI_SLOT_Name" SG_ 2566838916 Appl_Id_Byte_33 "SAEatad0200";
BA_ "SPN" SG_ 2566838916 Appl_Id_Byte_33 234;
BA_ "CI_FullName" SG_ 2566838916 Appl_Id_Byte_34 "Software Identification";
BA_ "CI_ParId" SG_ 2566838916 Appl_Id_Byte_34 "ESMD_03139";
BA_ "CI_SLOT_Name" SG_ 2566838916 Appl_Id_Byte_34 "SAEatad0200";
BA_ "SPN" SG_ 2566838916 Appl_Id_Byte_34 234;
BA_ "CI_FullName" SG_ 2566838916 Appl_Id_Byte_35 "Software Identification";
BA_ "CI_ParId" SG_ 2566838916 Appl_Id_Byte_35 "ESMD_03139";
BA_ "CI_SLOT_Name" SG_ 2566838916 Appl_Id_Byte_35 "SAEatad0200";
BA_ "SPN" SG_ 2566838916 Appl_Id_Byte_35 234;
BA_ "CI_FullName" SG_ 2566838916 Appl_Id_Byte_36 "Software Identification";
BA_ "CI_ParId" SG_ 2566838916 Appl_Id_Byte_36 "ESMD_03139";
BA_ "CI_SLOT_Name" SG_ 2566838916 Appl_Id_Byte_36 "SAEatad0200";
BA_ "SPN" SG_ 2566838916 Appl_Id_Byte_36 234;
BA_ "CI_FullName" SG_ 2566838916 Appl_Id_Byte_37 "Software Identification";
BA_ "CI_ParId" SG_ 2566838916 Appl_Id_Byte_37 "ESMD_03139";
BA_ "CI_SLOT_Name" SG_ 2566838916 Appl_Id_Byte_37 "SAEatad0200";
BA_ "SPN" SG_ 2566838916 Appl_Id_Byte_37 234;
BA_ "CI_FullName" SG_ 2566838916 Appl_Id_Byte_38 "Software Identification";
BA_ "CI_ParId" SG_ 2566838916 Appl_Id_Byte_38 "ESMD_03139";
BA_ "CI_SLOT_Name" SG_ 2566838916 Appl_Id_Byte_38 "SAEatad0200";
BA_ "SPN" SG_ 2566838916 Appl_Id_Byte_38 234;
BA_ "CI_FullName" SG_ 2566838916 Appl_Id_Byte_39 "Software Identification";
BA_ "CI_ParId" SG_ 2566838916 Appl_Id_Byte_39 "ESMD_03139";
BA_ "CI_SLOT_Name" SG_ 2566838916 Appl_Id_Byte_39 "SAEatad0200";
BA_ "SPN" SG_ 2566838916 Appl_Id_Byte_39 234;
BA_ "CI_FullName" SG_ 2566838916 Appl_Id_Enum "Software Identification";
BA_ "CI_ParId" SG_ 2566838916 Appl_Id_Enum "ESMD_03139";
BA_ "CI_SLOT_Name" SG_ 2566838916 Appl_Id_Enum "SAEbs24";
BA_ "SPN" SG_ 2566838916 Appl_Id_Enum 234;
BA_ "CI_FullName" SG_ 2566838916 Bootloader_Id "Software Identification";
BA_ "CI_ParId" SG_ 2566838916 Bootloader_Id "ESMD_03139";
BA_ "CI_SLOT_Name" SG_ 2566838916 Bootloader_Id "SAEatad0200";
BA_ "SPN" SG_ 2566838916 Bootloader_Id 234;
BA_ "CI_FullName" SG_ 2566838916 Bootloader_Id_Byte_01 "Software Identification";
BA_ "CI_ParId" SG_ 2566838916 Bootloader_Id_Byte_01 "ESMD_03139";
BA_ "CI_SLOT_Name" SG_ 2566838916 Bootloader_Id_Byte_01 "SAEatad0200";
BA_ "SPN" SG_ 2566838916 Bootloader_Id_Byte_01 234;
BA_ "CI_FullName" SG_ 2566838916 Bootloader_Id_Byte_02 "Software Identification";
BA_ "CI_ParId" SG_ 2566838916 Bootloader_Id_Byte_02 "ESMD_03139";
BA_ "CI_SLOT_Name" SG_ 2566838916 Bootloader_Id_Byte_02 "SAEatad0200";
BA_ "SPN" SG_ 2566838916 Bootloader_Id_Byte_02 234;
BA_ "CI_FullName" SG_ 2566838916 Bootloader_Id_Byte_03 "Software Identification";
BA_ "CI_ParId" SG_ 2566838916 Bootloader_Id_Byte_03 "ESMD_03139";
BA_ "CI_SLOT_Name" SG_ 2566838916 Bootloader_Id_Byte_03 "SAEatad0200";
BA_ "SPN" SG_ 2566838916 Bootloader_Id_Byte_03 234;
BA_ "CI_FullName" SG_ 2566838916 Bootloader_Id_Byte_04 "Software Identification";
BA_ "CI_ParId" SG_ 2566838916 Bootloader_Id_Byte_04 "ESMD_03139";
BA_ "CI_SLOT_Name" SG_ 2566838916 Bootloader_Id_Byte_04 "SAEatad0200";
BA_ "SPN" SG_ 2566838916 Bootloader_Id_Byte_04 234;
BA_ "CI_FullName" SG_ 2566838916 Bootloader_Id_Byte_05 "Software Identification";
BA_ "CI_ParId" SG_ 2566838916 Bootloader_Id_Byte_05 "ESMD_03139";
BA_ "CI_SLOT_Name" SG_ 2566838916 Bootloader_Id_Byte_05 "SAEatad0200";
BA_ "SPN" SG_ 2566838916 Bootloader_Id_Byte_05 234;
BA_ "CI_FullName" SG_ 2566838916 Bootloader_Id_Byte_06 "Software Identification";
BA_ "CI_ParId" SG_ 2566838916 Bootloader_Id_Byte_06 "ESMD_03139";
BA_ "CI_SLOT_Name" SG_ 2566838916 Bootloader_Id_Byte_06 "SAEatad0200";
BA_ "SPN" SG_ 2566838916 Bootloader_Id_Byte_06 234;
BA_ "CI_FullName" SG_ 2566838916 Bootloader_Id_Byte_07 "Software Identification";
BA_ "CI_ParId" SG_ 2566838916 Bootloader_Id_Byte_07 "ESMD_03139";
BA_ "CI_SLOT_Name" SG_ 2566838916 Bootloader_Id_Byte_07 "SAEatad0200";
BA_ "SPN" SG_ 2566838916 Bootloader_Id_Byte_07 234;
BA_ "CI_FullName" SG_ 2566838916 Bootloader_Id_Byte_08 "Software Identification";
BA_ "CI_ParId" SG_ 2566838916 Bootloader_Id_Byte_08 "ESMD_03139";
BA_ "CI_SLOT_Name" SG_ 2566838916 Bootloader_Id_Byte_08 "SAEatad0200";
BA_ "SPN" SG_ 2566838916 Bootloader_Id_Byte_08 234;
BA_ "CI_FullName" SG_ 2566838916 Bootloader_Id_Byte_09 "Software Identification";
BA_ "CI_ParId" SG_ 2566838916 Bootloader_Id_Byte_09 "ESMD_03139";
BA_ "CI_SLOT_Name" SG_ 2566838916 Bootloader_Id_Byte_09 "SAEatad0200";
BA_ "SPN" SG_ 2566838916 Bootloader_Id_Byte_09 234;
BA_ "CI_FullName" SG_ 2566838916 Bootloader_Id_Byte_10 "Software Identification";
BA_ "CI_ParId" SG_ 2566838916 Bootloader_Id_Byte_10 "ESMD_03139";
BA_ "CI_SLOT_Name" SG_ 2566838916 Bootloader_Id_Byte_10 "SAEatad0200";
BA_ "SPN" SG_ 2566838916 Bootloader_Id_Byte_10 234;
BA_ "CI_FullName" SG_ 2566838916 Bootloader_Id_Byte_11 "Software Identification";
BA_ "CI_ParId" SG_ 2566838916 Bootloader_Id_Byte_11 "ESMD_03139";
BA_ "CI_SLOT_Name" SG_ 2566838916 Bootloader_Id_Byte_11 "SAEatad0200";
BA_ "SPN" SG_ 2566838916 Bootloader_Id_Byte_11 234;
BA_ "CI_FullName" SG_ 2566838916 Bootloader_Id_Byte_12 "Software Identification";
BA_ "CI_ParId" SG_ 2566838916 Bootloader_Id_Byte_12 "ESMD_03139";
BA_ "CI_SLOT_Name" SG_ 2566838916 Bootloader_Id_Byte_12 "SAEatad0200";
BA_ "SPN" SG_ 2566838916 Bootloader_Id_Byte_12 234;
BA_ "CI_FullName" SG_ 2566838916 Bootloader_Id_Byte_13 "Software Identification";
BA_ "CI_ParId" SG_ 2566838916 Bootloader_Id_Byte_13 "ESMD_03139";
BA_ "CI_SLOT_Name" SG_ 2566838916 Bootloader_Id_Byte_13 "SAEatad0200";
BA_ "SPN" SG_ 2566838916 Bootloader_Id_Byte_13 234;
BA_ "CI_FullName" SG_ 2566838916 Bootloader_Id_Byte_14 "Software Identification";
BA_ "CI_ParId" SG_ 2566838916 Bootloader_Id_Byte_14 "ESMD_03139";
BA_ "CI_SLOT_Name" SG_ 2566838916 Bootloader_Id_Byte_14 "SAEatad0200";
BA_ "SPN" SG_ 2566838916 Bootloader_Id_Byte_14 234;
BA_ "CI_FullName" SG_ 2566838916 Bootloader_Id_Byte_15 "Software Identification";
BA_ "CI_ParId" SG_ 2566838916 Bootloader_Id_Byte_15 "ESMD_03139";
BA_ "CI_SLOT_Name" SG_ 2566838916 Bootloader_Id_Byte_15 "SAEatad0200";
BA_ "SPN" SG_ 2566838916 Bootloader_Id_Byte_15 234;
BA_ "CI_FullName" SG_ 2566838916 Bootloader_Id_Byte_16 "Software Identification";
BA_ "CI_ParId" SG_ 2566838916 Bootloader_Id_Byte_16 "ESMD_03139";
BA_ "CI_SLOT_Name" SG_ 2566838916 Bootloader_Id_Byte_16 "SAEatad0200";
BA_ "SPN" SG_ 2566838916 Bootloader_Id_Byte_16 234;
BA_ "CI_FullName" SG_ 2566838916 Bootloader_Id_Byte_17 "Software Identification";
BA_ "CI_ParId" SG_ 2566838916 Bootloader_Id_Byte_17 "ESMD_03139";
BA_ "CI_SLOT_Name" SG_ 2566838916 Bootloader_Id_Byte_17 "SAEatad0200";
BA_ "SPN" SG_ 2566838916 Bootloader_Id_Byte_17 234;
BA_ "CI_FullName" SG_ 2566838916 Bootloader_Id_Byte_18 "Software Identification";
BA_ "CI_ParId" SG_ 2566838916 Bootloader_Id_Byte_18 "ESMD_03139";
BA_ "CI_SLOT_Name" SG_ 2566838916 Bootloader_Id_Byte_18 "SAEatad0200";
BA_ "SPN" SG_ 2566838916 Bootloader_Id_Byte_18 234;
BA_ "CI_FullName" SG_ 2566838916 Bootloader_Id_Byte_19 "Software Identification";
BA_ "CI_ParId" SG_ 2566838916 Bootloader_Id_Byte_19 "ESMD_03139";
BA_ "CI_SLOT_Name" SG_ 2566838916 Bootloader_Id_Byte_19 "SAEatad0200";
BA_ "SPN" SG_ 2566838916 Bootloader_Id_Byte_19 234;
BA_ "CI_FullName" SG_ 2566838916 Bootloader_Id_Byte_20 "Software Identification";
BA_ "CI_ParId" SG_ 2566838916 Bootloader_Id_Byte_20 "ESMD_03139";
BA_ "CI_SLOT_Name" SG_ 2566838916 Bootloader_Id_Byte_20 "SAEatad0200";
BA_ "SPN" SG_ 2566838916 Bootloader_Id_Byte_20 234;
BA_ "CI_FullName" SG_ 2566838916 Bootloader_Id_Byte_21 "Software Identification";
BA_ "CI_ParId" SG_ 2566838916 Bootloader_Id_Byte_21 "ESMD_03139";
BA_ "CI_SLOT_Name" SG_ 2566838916 Bootloader_Id_Byte_21 "SAEatad0200";
BA_ "SPN" SG_ 2566838916 Bootloader_Id_Byte_21 234;
BA_ "CI_FullName" SG_ 2566838916 Bootloader_Id_Byte_22 "Software Identification";
BA_ "CI_ParId" SG_ 2566838916 Bootloader_Id_Byte_22 "ESMD_03139";
BA_ "CI_SLOT_Name" SG_ 2566838916 Bootloader_Id_Byte_22 "SAEatad0200";
BA_ "SPN" SG_ 2566838916 Bootloader_Id_Byte_22 234;
BA_ "CI_FullName" SG_ 2566838916 Bootloader_Id_Byte_23 "Software Identification";
BA_ "CI_ParId" SG_ 2566838916 Bootloader_Id_Byte_23 "ESMD_03139";
BA_ "CI_SLOT_Name" SG_ 2566838916 Bootloader_Id_Byte_23 "SAEatad0200";
BA_ "SPN" SG_ 2566838916 Bootloader_Id_Byte_23 234;
BA_ "CI_FullName" SG_ 2566838916 Bootloader_Id_Byte_24 "Software Identification";
BA_ "CI_ParId" SG_ 2566838916 Bootloader_Id_Byte_24 "ESMD_03139";
BA_ "CI_SLOT_Name" SG_ 2566838916 Bootloader_Id_Byte_24 "SAEatad0200";
BA_ "SPN" SG_ 2566838916 Bootloader_Id_Byte_24 234;
BA_ "CI_FullName" SG_ 2566838916 Bootloader_Id_Byte_25 "Software Identification";
BA_ "CI_ParId" SG_ 2566838916 Bootloader_Id_Byte_25 "ESMD_03139";
BA_ "CI_SLOT_Name" SG_ 2566838916 Bootloader_Id_Byte_25 "SAEatad0200";
BA_ "SPN" SG_ 2566838916 Bootloader_Id_Byte_25 234;
BA_ "CI_FullName" SG_ 2566838916 Bootloader_Id_Byte_26 "Software Identification";
BA_ "CI_ParId" SG_ 2566838916 Bootloader_Id_Byte_26 "ESMD_03139";
BA_ "CI_SLOT_Name" SG_ 2566838916 Bootloader_Id_Byte_26 "SAEatad0200";
BA_ "SPN" SG_ 2566838916 Bootloader_Id_Byte_26 234;
BA_ "CI_FullName" SG_ 2566838916 Bootloader_Id_Byte_27 "Software Identification";
BA_ "CI_ParId" SG_ 2566838916 Bootloader_Id_Byte_27 "ESMD_03139";
BA_ "CI_SLOT_Name" SG_ 2566838916 Bootloader_Id_Byte_27 "SAEatad0200";
BA_ "SPN" SG_ 2566838916 Bootloader_Id_Byte_27 234;
BA_ "CI_FullName" SG_ 2566838916 Bootloader_Id_Byte_28 "Software Identification";
BA_ "CI_ParId" SG_ 2566838916 Bootloader_Id_Byte_28 "ESMD_03139";
BA_ "CI_SLOT_Name" SG_ 2566838916 Bootloader_Id_Byte_28 "SAEatad0200";
BA_ "SPN" SG_ 2566838916 Bootloader_Id_Byte_28 234;
BA_ "CI_FullName" SG_ 2566838916 Bootloader_Id_Byte_29 "Software Identification";
BA_ "CI_ParId" SG_ 2566838916 Bootloader_Id_Byte_29 "ESMD_03139";
BA_ "CI_SLOT_Name" SG_ 2566838916 Bootloader_Id_Byte_29 "SAEatad0200";
BA_ "SPN" SG_ 2566838916 Bootloader_Id_Byte_29 234;
BA_ "CI_FullName" SG_ 2566838916 Bootloader_Id_Byte_30 "Software Identification";
BA_ "CI_ParId" SG_ 2566838916 Bootloader_Id_Byte_30 "ESMD_03139";
BA_ "CI_SLOT_Name" SG_ 2566838916 Bootloader_Id_Byte_30 "SAEatad0200";
BA_ "SPN" SG_ 2566838916 Bootloader_Id_Byte_30 234;
BA_ "CI_FullName" SG_ 2566838916 Bootloader_Id_Byte_31 "Software Identification";
BA_ "CI_ParId" SG_ 2566838916 Bootloader_Id_Byte_31 "ESMD_03139";
BA_ "CI_SLOT_Name" SG_ 2566838916 Bootloader_Id_Byte_31 "SAEatad0200";
BA_ "SPN" SG_ 2566838916 Bootloader_Id_Byte_31 234;
BA_ "CI_FullName" SG_ 2566838916 Bootloader_Id_Byte_32 "Software Identification";
BA_ "CI_ParId" SG_ 2566838916 Bootloader_Id_Byte_32 "ESMD_03139";
BA_ "CI_SLOT_Name" SG_ 2566838916 Bootloader_Id_Byte_32 "SAEatad0200";
BA_ "SPN" SG_ 2566838916 Bootloader_Id_Byte_32 234;
BA_ "CI_FullName" SG_ 2566838916 Bootloader_Id_Byte_33 "Software Identification";
BA_ "CI_ParId" SG_ 2566838916 Bootloader_Id_Byte_33 "ESMD_03139";
BA_ "CI_SLOT_Name" SG_ 2566838916 Bootloader_Id_Byte_33 "SAEatad0200";
BA_ "SPN" SG_ 2566838916 Bootloader_Id_Byte_33 234;
BA_ "CI_FullName" SG_ 2566838916 Bootloader_Id_Byte_34 "Software Identification";
BA_ "CI_ParId" SG_ 2566838916 Bootloader_Id_Byte_34 "ESMD_03139";
BA_ "CI_SLOT_Name" SG_ 2566838916 Bootloader_Id_Byte_34 "SAEatad0200";
BA_ "SPN" SG_ 2566838916 Bootloader_Id_Byte_34 234;
BA_ "CI_FullName" SG_ 2566838916 Bootloader_Id_Byte_35 "Software Identification";
BA_ "CI_ParId" SG_ 2566838916 Bootloader_Id_Byte_35 "ESMD_03139";
BA_ "CI_SLOT_Name" SG_ 2566838916 Bootloader_Id_Byte_35 "SAEatad0200";
BA_ "SPN" SG_ 2566838916 Bootloader_Id_Byte_35 234;
BA_ "CI_FullName" SG_ 2566838916 Bootloader_Id_Byte_36 "Software Identification";
BA_ "CI_ParId" SG_ 2566838916 Bootloader_Id_Byte_36 "ESMD_03139";
BA_ "CI_SLOT_Name" SG_ 2566838916 Bootloader_Id_Byte_36 "SAEatad0200";
BA_ "SPN" SG_ 2566838916 Bootloader_Id_Byte_36 234;
BA_ "CI_FullName" SG_ 2566838916 Bootloader_Id_Byte_37 "Software Identification";
BA_ "CI_ParId" SG_ 2566838916 Bootloader_Id_Byte_37 "ESMD_03139";
BA_ "CI_SLOT_Name" SG_ 2566838916 Bootloader_Id_Byte_37 "SAEatad0200";
BA_ "SPN" SG_ 2566838916 Bootloader_Id_Byte_37 234;
BA_ "CI_FullName" SG_ 2566838916 Bootloader_Id_Byte_38 "Software Identification";
BA_ "CI_ParId" SG_ 2566838916 Bootloader_Id_Byte_38 "ESMD_03139";
BA_ "CI_SLOT_Name" SG_ 2566838916 Bootloader_Id_Byte_38 "SAEatad0200";
BA_ "SPN" SG_ 2566838916 Bootloader_Id_Byte_38 234;
BA_ "CI_FullName" SG_ 2566838916 Bootloader_Id_Byte_39 "Software Identification";
BA_ "CI_ParId" SG_ 2566838916 Bootloader_Id_Byte_39 "ESMD_03139";
BA_ "CI_SLOT_Name" SG_ 2566838916 Bootloader_Id_Byte_39 "SAEatad0200";
BA_ "SPN" SG_ 2566838916 Bootloader_Id_Byte_39 234;
BA_ "CI_FullName" SG_ 2566838916 Bootloader_Id_Enum "Software Identification";
BA_ "CI_ParId" SG_ 2566838916 Bootloader_Id_Enum "ESMD_03139";
BA_ "CI_SLOT_Name" SG_ 2566838916 Bootloader_Id_Enum "SAEbs24";
BA_ "SPN" SG_ 2566838916 Bootloader_Id_Enum 234;
BA_ "CI_FullName" SG_ 2566838916 EndStrng_00 "Software Identification";
BA_ "CI_ParId" SG_ 2566838916 EndStrng_00 "ESMD_21930";
BA_ "CI_SLOT_Name" SG_ 2566838916 EndStrng_00 "SAEatad0200";
BA_ "GenSigStartValue" SG_ 2566838916 EndStrng_00 42;
BA_ "SigType" SG_ 2566838916 EndStrng_00 8;
BA_ "CI_FullName" SG_ 2566838916 EndStrng_01 "Software Identification";
BA_ "CI_ParId" SG_ 2566838916 EndStrng_01 "ESMD_21931";
BA_ "CI_SLOT_Name" SG_ 2566838916 EndStrng_01 "SAEatad0200";
BA_ "GenSigStartValue" SG_ 2566838916 EndStrng_01 42;
BA_ "SigType" SG_ 2566838916 EndStrng_01 8;
BA_ "GenSigAutoGenSnd" SG_ 2566838916 NumSW_IdField 0;
BA_ "GenSigAutoGenDsp" SG_ 2566838916 NumSW_IdField 0;
BA_ "CI_RepetitionComplemented" SG_ 2566838916 NumSW_IdField 2;
BA_ "CI_FullName" SG_ 2566838916 NumSW_IdField "Number of Software Identification Fields";
BA_ "CI_ParId" SG_ 2566838916 NumSW_IdField "ESMD_02746";
BA_ "CI_SLOT_Name" SG_ 2566838916 NumSW_IdField "SAEst01";
BA_ "SPN" SG_ 2566838916 NumSW_IdField 965;
BA_ "SigType" SG_ 2566838916 NumSW_IdField 1;
BA_ "CI_FullName" SG_ 2566838921 Bootloader_Id_Byte_06 "Software Identification";
BA_ "CI_ParId" SG_ 2566838921 Bootloader_Id_Byte_06 "ESMD_03139";
BA_ "CI_SLOT_Name" SG_ 2566838921 Bootloader_Id_Byte_06 "SAEatad0200";
BA_ "SPN" SG_ 2566838921 Bootloader_Id_Byte_06 234;
BA_ "CI_FullName" SG_ 2566838921 Bootloader_Id_Byte_07 "Software Identification";
BA_ "CI_ParId" SG_ 2566838921 Bootloader_Id_Byte_07 "ESMD_03139";
BA_ "CI_SLOT_Name" SG_ 2566838921 Bootloader_Id_Byte_07 "SAEatad0200";
BA_ "SPN" SG_ 2566838921 Bootloader_Id_Byte_07 234;
BA_ "CI_FullName" SG_ 2566838921 Bootloader_Id_Byte_08 "Software Identification";
BA_ "CI_ParId" SG_ 2566838921 Bootloader_Id_Byte_08 "ESMD_03139";
BA_ "CI_SLOT_Name" SG_ 2566838921 Bootloader_Id_Byte_08 "SAEatad0200";
BA_ "SPN" SG_ 2566838921 Bootloader_Id_Byte_08 234;
BA_ "CI_FullName" SG_ 2566838921 Bootloader_Id_Byte_09 "Software Identification";
BA_ "CI_ParId" SG_ 2566838921 Bootloader_Id_Byte_09 "ESMD_03139";
BA_ "CI_SLOT_Name" SG_ 2566838921 Bootloader_Id_Byte_09 "SAEatad0200";
BA_ "SPN" SG_ 2566838921 Bootloader_Id_Byte_09 234;
BA_ "CI_FullName" SG_ 2566838921 Bootloader_Id_Byte_10 "Software Identification";
BA_ "CI_ParId" SG_ 2566838921 Bootloader_Id_Byte_10 "ESMD_03139";
BA_ "CI_SLOT_Name" SG_ 2566838921 Bootloader_Id_Byte_10 "SAEatad0200";
BA_ "SPN" SG_ 2566838921 Bootloader_Id_Byte_10 234;
BA_ "CI_FullName" SG_ 2566838921 Bootloader_Id_Byte_11 "Software Identification";
BA_ "CI_ParId" SG_ 2566838921 Bootloader_Id_Byte_11 "ESMD_03139";
BA_ "CI_SLOT_Name" SG_ 2566838921 Bootloader_Id_Byte_11 "SAEatad0200";
BA_ "SPN" SG_ 2566838921 Bootloader_Id_Byte_11 234;
BA_ "CI_FullName" SG_ 2566838921 Bootloader_Id_Byte_12 "Software Identification";
BA_ "CI_ParId" SG_ 2566838921 Bootloader_Id_Byte_12 "ESMD_03139";
BA_ "CI_SLOT_Name" SG_ 2566838921 Bootloader_Id_Byte_12 "SAEatad0200";
BA_ "SPN" SG_ 2566838921 Bootloader_Id_Byte_12 234;
BA_ "CI_FullName" SG_ 2566838921 Bootloader_Id_Byte_13 "Software Identification";
BA_ "CI_ParId" SG_ 2566838921 Bootloader_Id_Byte_13 "ESMD_03139";
BA_ "CI_SLOT_Name" SG_ 2566838921 Bootloader_Id_Byte_13 "SAEatad0200";
BA_ "SPN" SG_ 2566838921 Bootloader_Id_Byte_13 234;
BA_ "CI_FullName" SG_ 2566838921 Bootloader_Id_Byte_14 "Software Identification";
BA_ "CI_ParId" SG_ 2566838921 Bootloader_Id_Byte_14 "ESMD_03139";
BA_ "CI_SLOT_Name" SG_ 2566838921 Bootloader_Id_Byte_14 "SAEatad0200";
BA_ "SPN" SG_ 2566838921 Bootloader_Id_Byte_14 234;
BA_ "CI_FullName" SG_ 2566838921 Bootloader_Id_Byte_15 "Software Identification";
BA_ "CI_ParId" SG_ 2566838921 Bootloader_Id_Byte_15 "ESMD_03139";
BA_ "CI_SLOT_Name" SG_ 2566838921 Bootloader_Id_Byte_15 "SAEatad0200";
BA_ "SPN" SG_ 2566838921 Bootloader_Id_Byte_15 234;
BA_ "CI_FullName" SG_ 2566838921 Bootloader_Id_Byte_16 "Software Identification";
BA_ "CI_ParId" SG_ 2566838921 Bootloader_Id_Byte_16 "ESMD_03139";
BA_ "CI_SLOT_Name" SG_ 2566838921 Bootloader_Id_Byte_16 "SAEatad0200";
BA_ "SPN" SG_ 2566838921 Bootloader_Id_Byte_16 234;
BA_ "CI_FullName" SG_ 2566838921 Bootloader_Id_Byte_17 "Software Identification";
BA_ "CI_ParId" SG_ 2566838921 Bootloader_Id_Byte_17 "ESMD_03139";
BA_ "CI_SLOT_Name" SG_ 2566838921 Bootloader_Id_Byte_17 "SAEatad0200";
BA_ "SPN" SG_ 2566838921 Bootloader_Id_Byte_17 234;
BA_ "CI_FullName" SG_ 2566838921 Bootloader_Id_Byte_18 "Software Identification";
BA_ "CI_ParId" SG_ 2566838921 Bootloader_Id_Byte_18 "ESMD_03139";
BA_ "CI_SLOT_Name" SG_ 2566838921 Bootloader_Id_Byte_18 "SAEatad0200";
BA_ "SPN" SG_ 2566838921 Bootloader_Id_Byte_18 234;
BA_ "CI_FullName" SG_ 2566838921 Bootloader_Id_Byte_19 "Software Identification";
BA_ "CI_ParId" SG_ 2566838921 Bootloader_Id_Byte_19 "ESMD_03139";
BA_ "CI_SLOT_Name" SG_ 2566838921 Bootloader_Id_Byte_19 "SAEatad0200";
BA_ "SPN" SG_ 2566838921 Bootloader_Id_Byte_19 234;
BA_ "CI_FullName" SG_ 2566838921 Bootloader_Id_Byte_20 "Software Identification";
BA_ "CI_ParId" SG_ 2566838921 Bootloader_Id_Byte_20 "ESMD_03139";
BA_ "CI_SLOT_Name" SG_ 2566838921 Bootloader_Id_Byte_20 "SAEatad0200";
BA_ "SPN" SG_ 2566838921 Bootloader_Id_Byte_20 234;
BA_ "CI_FullName" SG_ 2566838921 Bootloader_Id_Byte_21 "Software Identification";
BA_ "CI_ParId" SG_ 2566838921 Bootloader_Id_Byte_21 "ESMD_03139";
BA_ "CI_SLOT_Name" SG_ 2566838921 Bootloader_Id_Byte_21 "SAEatad0200";
BA_ "SPN" SG_ 2566838921 Bootloader_Id_Byte_21 234;
BA_ "CI_FullName" SG_ 2566838921 Bootloader_Id_Byte_22 "Software Identification";
BA_ "CI_ParId" SG_ 2566838921 Bootloader_Id_Byte_22 "ESMD_03139";
BA_ "CI_SLOT_Name" SG_ 2566838921 Bootloader_Id_Byte_22 "SAEatad0200";
BA_ "SPN" SG_ 2566838921 Bootloader_Id_Byte_22 234;
BA_ "CI_FullName" SG_ 2566838921 Bootloader_Id_Byte_23 "Software Identification";
BA_ "CI_ParId" SG_ 2566838921 Bootloader_Id_Byte_23 "ESMD_03139";
BA_ "CI_SLOT_Name" SG_ 2566838921 Bootloader_Id_Byte_23 "SAEatad0200";
BA_ "SPN" SG_ 2566838921 Bootloader_Id_Byte_23 234;
BA_ "CI_FullName" SG_ 2566838921 Bootloader_Id_Byte_24 "Software Identification";
BA_ "CI_ParId" SG_ 2566838921 Bootloader_Id_Byte_24 "ESMD_03139";
BA_ "CI_SLOT_Name" SG_ 2566838921 Bootloader_Id_Byte_24 "SAEatad0200";
BA_ "SPN" SG_ 2566838921 Bootloader_Id_Byte_24 234;
BA_ "CI_FullName" SG_ 2566838921 Bootloader_Id_Byte_25 "Software Identification";
BA_ "CI_ParId" SG_ 2566838921 Bootloader_Id_Byte_25 "ESMD_03139";
BA_ "CI_SLOT_Name" SG_ 2566838921 Bootloader_Id_Byte_25 "SAEatad0200";
BA_ "SPN" SG_ 2566838921 Bootloader_Id_Byte_25 234;
BA_ "CI_FullName" SG_ 2566838921 Bootloader_Id_Byte_26 "Software Identification";
BA_ "CI_ParId" SG_ 2566838921 Bootloader_Id_Byte_26 "ESMD_03139";
BA_ "CI_SLOT_Name" SG_ 2566838921 Bootloader_Id_Byte_26 "SAEatad0200";
BA_ "SPN" SG_ 2566838921 Bootloader_Id_Byte_26 234;
BA_ "CI_FullName" SG_ 2566838921 Bootloader_Id_Byte_27 "Software Identification";
BA_ "CI_ParId" SG_ 2566838921 Bootloader_Id_Byte_27 "ESMD_03139";
BA_ "CI_SLOT_Name" SG_ 2566838921 Bootloader_Id_Byte_27 "SAEatad0200";
BA_ "SPN" SG_ 2566838921 Bootloader_Id_Byte_27 234;
BA_ "CI_FullName" SG_ 2566838921 Bootloader_Id_Byte_28 "Software Identification";
BA_ "CI_ParId" SG_ 2566838921 Bootloader_Id_Byte_28 "ESMD_03139";
BA_ "CI_SLOT_Name" SG_ 2566838921 Bootloader_Id_Byte_28 "SAEatad0200";
BA_ "SPN" SG_ 2566838921 Bootloader_Id_Byte_28 234;
BA_ "CI_FullName" SG_ 2566838921 Bootloader_Id_Byte_29 "Software Identification";
BA_ "CI_ParId" SG_ 2566838921 Bootloader_Id_Byte_29 "ESMD_03139";
BA_ "CI_SLOT_Name" SG_ 2566838921 Bootloader_Id_Byte_29 "SAEatad0200";
BA_ "SPN" SG_ 2566838921 Bootloader_Id_Byte_29 234;
BA_ "CI_FullName" SG_ 2566838921 Bootloader_Id_Byte_30 "Software Identification";
BA_ "CI_ParId" SG_ 2566838921 Bootloader_Id_Byte_30 "ESMD_03139";
BA_ "CI_SLOT_Name" SG_ 2566838921 Bootloader_Id_Byte_30 "SAEatad0200";
BA_ "SPN" SG_ 2566838921 Bootloader_Id_Byte_30 234;
BA_ "CI_FullName" SG_ 2566838921 Bootloader_Id_Byte_31 "Software Identification";
BA_ "CI_ParId" SG_ 2566838921 Bootloader_Id_Byte_31 "ESMD_03139";
BA_ "CI_SLOT_Name" SG_ 2566838921 Bootloader_Id_Byte_31 "SAEatad0200";
BA_ "SPN" SG_ 2566838921 Bootloader_Id_Byte_31 234;
BA_ "CI_FullName" SG_ 2566838921 Bootloader_Id_Byte_32 "Software Identification";
BA_ "CI_ParId" SG_ 2566838921 Bootloader_Id_Byte_32 "ESMD_03139";
BA_ "CI_SLOT_Name" SG_ 2566838921 Bootloader_Id_Byte_32 "SAEatad0200";
BA_ "SPN" SG_ 2566838921 Bootloader_Id_Byte_32 234;
BA_ "CI_FullName" SG_ 2566838921 Bootloader_Id_Byte_33 "Software Identification";
BA_ "CI_ParId" SG_ 2566838921 Bootloader_Id_Byte_33 "ESMD_03139";
BA_ "CI_SLOT_Name" SG_ 2566838921 Bootloader_Id_Byte_33 "SAEatad0200";
BA_ "SPN" SG_ 2566838921 Bootloader_Id_Byte_33 234;
BA_ "CI_FullName" SG_ 2566838921 Bootloader_Id_Byte_34 "Software Identification";
BA_ "CI_ParId" SG_ 2566838921 Bootloader_Id_Byte_34 "ESMD_03139";
BA_ "CI_SLOT_Name" SG_ 2566838921 Bootloader_Id_Byte_34 "SAEatad0200";
BA_ "SPN" SG_ 2566838921 Bootloader_Id_Byte_34 234;
BA_ "CI_FullName" SG_ 2566838921 Bootloader_Id_Byte_35 "Software Identification";
BA_ "CI_ParId" SG_ 2566838921 Bootloader_Id_Byte_35 "ESMD_03139";
BA_ "CI_SLOT_Name" SG_ 2566838921 Bootloader_Id_Byte_35 "SAEatad0200";
BA_ "SPN" SG_ 2566838921 Bootloader_Id_Byte_35 234;
BA_ "CI_FullName" SG_ 2566838921 Bootloader_Id_Byte_36 "Software Identification";
BA_ "CI_ParId" SG_ 2566838921 Bootloader_Id_Byte_36 "ESMD_03139";
BA_ "CI_SLOT_Name" SG_ 2566838921 Bootloader_Id_Byte_36 "SAEatad0200";
BA_ "SPN" SG_ 2566838921 Bootloader_Id_Byte_36 234;
BA_ "CI_FullName" SG_ 2566838921 Bootloader_Id_Byte_37 "Software Identification";
BA_ "CI_ParId" SG_ 2566838921 Bootloader_Id_Byte_37 "ESMD_03139";
BA_ "CI_SLOT_Name" SG_ 2566838921 Bootloader_Id_Byte_37 "SAEatad0200";
BA_ "SPN" SG_ 2566838921 Bootloader_Id_Byte_37 234;
BA_ "CI_FullName" SG_ 2566838921 Bootloader_Id_Byte_38 "Software Identification";
BA_ "CI_ParId" SG_ 2566838921 Bootloader_Id_Byte_38 "ESMD_03139";
BA_ "CI_SLOT_Name" SG_ 2566838921 Bootloader_Id_Byte_38 "SAEatad0200";
BA_ "SPN" SG_ 2566838921 Bootloader_Id_Byte_38 234;
BA_ "CI_FullName" SG_ 2566838921 Bootloader_Id_Byte_39 "Software Identification";
BA_ "CI_ParId" SG_ 2566838921 Bootloader_Id_Byte_39 "ESMD_03139";
BA_ "CI_SLOT_Name" SG_ 2566838921 Bootloader_Id_Byte_39 "SAEatad0200";
BA_ "SPN" SG_ 2566838921 Bootloader_Id_Byte_39 234;
BA_ "CI_FullName" SG_ 2566838921 Bootloader_Id_Enum "Software Identification";
BA_ "CI_ParId" SG_ 2566838921 Bootloader_Id_Enum "ESMD_03139";
BA_ "CI_SLOT_Name" SG_ 2566838921 Bootloader_Id_Enum "SAEbs24";
BA_ "SPN" SG_ 2566838921 Bootloader_Id_Enum 234;
BA_ "CI_FullName" SG_ 2566838921 EndStrng_00 "Software Identification";
BA_ "CI_ParId" SG_ 2566838921 EndStrng_00 "ESMD_21930";
BA_ "CI_SLOT_Name" SG_ 2566838921 EndStrng_00 "SAEatad0200";
BA_ "GenSigStartValue" SG_ 2566838921 EndStrng_00 42;
BA_ "SigType" SG_ 2566838921 EndStrng_00 8;
BA_ "CI_FullName" SG_ 2566838921 EndStrng_01 "Software Identification";
BA_ "CI_ParId" SG_ 2566838921 EndStrng_01 "ESMD_21931";
BA_ "CI_SLOT_Name" SG_ 2566838921 EndStrng_01 "SAEatad0200";
BA_ "GenSigStartValue" SG_ 2566838921 EndStrng_01 42;
BA_ "SigType" SG_ 2566838921 EndStrng_01 8;
BA_ "GenSigAutoGenSnd" SG_ 2566838921 NumSW_IdField 0;
BA_ "GenSigAutoGenDsp" SG_ 2566838921 NumSW_IdField 0;
BA_ "CI_RepetitionComplemented" SG_ 2566838921 NumSW_IdField 2;
BA_ "CI_FullName" SG_ 2566838921 NumSW_IdField "Number of Software Identification Fields";
BA_ "CI_ParId" SG_ 2566838921 NumSW_IdField "ESMD_02746";
BA_ "CI_SLOT_Name" SG_ 2566838921 NumSW_IdField "SAEst01";
BA_ "SPN" SG_ 2566838921 NumSW_IdField 965;
BA_ "SigType" SG_ 2566838921 NumSW_IdField 1;
BA_ "CI_FullName" SG_ 2566838921 Appl_Id "Software Identification";
BA_ "CI_ParId" SG_ 2566838921 Appl_Id "ESMD_03139";
BA_ "CI_SLOT_Name" SG_ 2566838921 Appl_Id "SAEatad0200";
BA_ "SPN" SG_ 2566838921 Appl_Id 234;
BA_ "CI_FullName" SG_ 2566838921 Appl_Id_Byte_01 "Software Identification";
BA_ "CI_ParId" SG_ 2566838921 Appl_Id_Byte_01 "ESMD_03139";
BA_ "CI_SLOT_Name" SG_ 2566838921 Appl_Id_Byte_01 "SAEatad0200";
BA_ "SPN" SG_ 2566838921 Appl_Id_Byte_01 234;
BA_ "CI_FullName" SG_ 2566838921 Appl_Id_Byte_02 "Software Identification";
BA_ "CI_ParId" SG_ 2566838921 Appl_Id_Byte_02 "ESMD_03139";
BA_ "CI_SLOT_Name" SG_ 2566838921 Appl_Id_Byte_02 "SAEatad0200";
BA_ "SPN" SG_ 2566838921 Appl_Id_Byte_02 234;
BA_ "CI_FullName" SG_ 2566838921 Appl_Id_Byte_03 "Software Identification";
BA_ "CI_ParId" SG_ 2566838921 Appl_Id_Byte_03 "ESMD_03139";
BA_ "CI_SLOT_Name" SG_ 2566838921 Appl_Id_Byte_03 "SAEatad0200";
BA_ "SPN" SG_ 2566838921 Appl_Id_Byte_03 234;
BA_ "CI_FullName" SG_ 2566838921 Appl_Id_Byte_04 "Software Identification";
BA_ "CI_ParId" SG_ 2566838921 Appl_Id_Byte_04 "ESMD_03139";
BA_ "CI_SLOT_Name" SG_ 2566838921 Appl_Id_Byte_04 "SAEatad0200";
BA_ "SPN" SG_ 2566838921 Appl_Id_Byte_04 234;
BA_ "CI_FullName" SG_ 2566838921 Appl_Id_Byte_05 "Software Identification";
BA_ "CI_ParId" SG_ 2566838921 Appl_Id_Byte_05 "ESMD_03139";
BA_ "CI_SLOT_Name" SG_ 2566838921 Appl_Id_Byte_05 "SAEatad0200";
BA_ "SPN" SG_ 2566838921 Appl_Id_Byte_05 234;
BA_ "CI_FullName" SG_ 2566838921 Appl_Id_Byte_06 "Software Identification";
BA_ "CI_ParId" SG_ 2566838921 Appl_Id_Byte_06 "ESMD_03139";
BA_ "CI_SLOT_Name" SG_ 2566838921 Appl_Id_Byte_06 "SAEatad0200";
BA_ "SPN" SG_ 2566838921 Appl_Id_Byte_06 234;
BA_ "CI_FullName" SG_ 2566838921 Appl_Id_Byte_07 "Software Identification";
BA_ "CI_ParId" SG_ 2566838921 Appl_Id_Byte_07 "ESMD_03139";
BA_ "CI_SLOT_Name" SG_ 2566838921 Appl_Id_Byte_07 "SAEatad0200";
BA_ "SPN" SG_ 2566838921 Appl_Id_Byte_07 234;
BA_ "CI_FullName" SG_ 2566838921 Appl_Id_Byte_08 "Software Identification";
BA_ "CI_ParId" SG_ 2566838921 Appl_Id_Byte_08 "ESMD_03139";
BA_ "CI_SLOT_Name" SG_ 2566838921 Appl_Id_Byte_08 "SAEatad0200";
BA_ "SPN" SG_ 2566838921 Appl_Id_Byte_08 234;
BA_ "CI_FullName" SG_ 2566838921 Appl_Id_Byte_09 "Software Identification";
BA_ "CI_ParId" SG_ 2566838921 Appl_Id_Byte_09 "ESMD_03139";
BA_ "CI_SLOT_Name" SG_ 2566838921 Appl_Id_Byte_09 "SAEatad0200";
BA_ "SPN" SG_ 2566838921 Appl_Id_Byte_09 234;
BA_ "CI_FullName" SG_ 2566838921 Appl_Id_Byte_10 "Software Identification";
BA_ "CI_ParId" SG_ 2566838921 Appl_Id_Byte_10 "ESMD_03139";
BA_ "CI_SLOT_Name" SG_ 2566838921 Appl_Id_Byte_10 "SAEatad0200";
BA_ "SPN" SG_ 2566838921 Appl_Id_Byte_10 234;
BA_ "CI_FullName" SG_ 2566838921 Appl_Id_Byte_11 "Software Identification";
BA_ "CI_ParId" SG_ 2566838921 Appl_Id_Byte_11 "ESMD_03139";
BA_ "CI_SLOT_Name" SG_ 2566838921 Appl_Id_Byte_11 "SAEatad0200";
BA_ "SPN" SG_ 2566838921 Appl_Id_Byte_11 234;
BA_ "CI_FullName" SG_ 2566838921 Appl_Id_Byte_12 "Software Identification";
BA_ "CI_ParId" SG_ 2566838921 Appl_Id_Byte_12 "ESMD_03139";
BA_ "CI_SLOT_Name" SG_ 2566838921 Appl_Id_Byte_12 "SAEatad0200";
BA_ "SPN" SG_ 2566838921 Appl_Id_Byte_12 234;
BA_ "CI_FullName" SG_ 2566838921 Appl_Id_Byte_13 "Software Identification";
BA_ "CI_ParId" SG_ 2566838921 Appl_Id_Byte_13 "ESMD_03139";
BA_ "CI_SLOT_Name" SG_ 2566838921 Appl_Id_Byte_13 "SAEatad0200";
BA_ "SPN" SG_ 2566838921 Appl_Id_Byte_13 234;
BA_ "CI_FullName" SG_ 2566838921 Appl_Id_Byte_14 "Software Identification";
BA_ "CI_ParId" SG_ 2566838921 Appl_Id_Byte_14 "ESMD_03139";
BA_ "CI_SLOT_Name" SG_ 2566838921 Appl_Id_Byte_14 "SAEatad0200";
BA_ "SPN" SG_ 2566838921 Appl_Id_Byte_14 234;
BA_ "CI_FullName" SG_ 2566838921 Appl_Id_Byte_15 "Software Identification";
BA_ "CI_ParId" SG_ 2566838921 Appl_Id_Byte_15 "ESMD_03139";
BA_ "CI_SLOT_Name" SG_ 2566838921 Appl_Id_Byte_15 "SAEatad0200";
BA_ "SPN" SG_ 2566838921 Appl_Id_Byte_15 234;
BA_ "CI_FullName" SG_ 2566838921 Appl_Id_Byte_16 "Software Identification";
BA_ "CI_ParId" SG_ 2566838921 Appl_Id_Byte_16 "ESMD_03139";
BA_ "CI_SLOT_Name" SG_ 2566838921 Appl_Id_Byte_16 "SAEatad0200";
BA_ "SPN" SG_ 2566838921 Appl_Id_Byte_16 234;
BA_ "CI_FullName" SG_ 2566838921 Appl_Id_Byte_17 "Software Identification";
BA_ "CI_ParId" SG_ 2566838921 Appl_Id_Byte_17 "ESMD_03139";
BA_ "CI_SLOT_Name" SG_ 2566838921 Appl_Id_Byte_17 "SAEatad0200";
BA_ "SPN" SG_ 2566838921 Appl_Id_Byte_17 234;
BA_ "CI_FullName" SG_ 2566838921 Appl_Id_Byte_18 "Software Identification";
BA_ "CI_ParId" SG_ 2566838921 Appl_Id_Byte_18 "ESMD_03139";
BA_ "CI_SLOT_Name" SG_ 2566838921 Appl_Id_Byte_18 "SAEatad0200";
BA_ "SPN" SG_ 2566838921 Appl_Id_Byte_18 234;
BA_ "CI_FullName" SG_ 2566838921 Appl_Id_Byte_19 "Software Identification";
BA_ "CI_ParId" SG_ 2566838921 Appl_Id_Byte_19 "ESMD_03139";
BA_ "CI_SLOT_Name" SG_ 2566838921 Appl_Id_Byte_19 "SAEatad0200";
BA_ "SPN" SG_ 2566838921 Appl_Id_Byte_19 234;
BA_ "CI_FullName" SG_ 2566838921 Appl_Id_Byte_20 "Software Identification";
BA_ "CI_ParId" SG_ 2566838921 Appl_Id_Byte_20 "ESMD_03139";
BA_ "CI_SLOT_Name" SG_ 2566838921 Appl_Id_Byte_20 "SAEatad0200";
BA_ "SPN" SG_ 2566838921 Appl_Id_Byte_20 234;
BA_ "CI_FullName" SG_ 2566838921 Appl_Id_Byte_21 "Software Identification";
BA_ "CI_ParId" SG_ 2566838921 Appl_Id_Byte_21 "ESMD_03139";
BA_ "CI_SLOT_Name" SG_ 2566838921 Appl_Id_Byte_21 "SAEatad0200";
BA_ "SPN" SG_ 2566838921 Appl_Id_Byte_21 234;
BA_ "CI_FullName" SG_ 2566838921 Appl_Id_Byte_22 "Software Identification";
BA_ "CI_ParId" SG_ 2566838921 Appl_Id_Byte_22 "ESMD_03139";
BA_ "CI_SLOT_Name" SG_ 2566838921 Appl_Id_Byte_22 "SAEatad0200";
BA_ "SPN" SG_ 2566838921 Appl_Id_Byte_22 234;
BA_ "CI_FullName" SG_ 2566838921 Appl_Id_Byte_23 "Software Identification";
BA_ "CI_ParId" SG_ 2566838921 Appl_Id_Byte_23 "ESMD_03139";
BA_ "CI_SLOT_Name" SG_ 2566838921 Appl_Id_Byte_23 "SAEatad0200";
BA_ "SPN" SG_ 2566838921 Appl_Id_Byte_23 234;
BA_ "CI_FullName" SG_ 2566838921 Appl_Id_Byte_24 "Software Identification";
BA_ "CI_ParId" SG_ 2566838921 Appl_Id_Byte_24 "ESMD_03139";
BA_ "CI_SLOT_Name" SG_ 2566838921 Appl_Id_Byte_24 "SAEatad0200";
BA_ "SPN" SG_ 2566838921 Appl_Id_Byte_24 234;
BA_ "CI_FullName" SG_ 2566838921 Appl_Id_Byte_25 "Software Identification";
BA_ "CI_ParId" SG_ 2566838921 Appl_Id_Byte_25 "ESMD_03139";
BA_ "CI_SLOT_Name" SG_ 2566838921 Appl_Id_Byte_25 "SAEatad0200";
BA_ "SPN" SG_ 2566838921 Appl_Id_Byte_25 234;
BA_ "CI_FullName" SG_ 2566838921 Appl_Id_Byte_26 "Software Identification";
BA_ "CI_ParId" SG_ 2566838921 Appl_Id_Byte_26 "ESMD_03139";
BA_ "CI_SLOT_Name" SG_ 2566838921 Appl_Id_Byte_26 "SAEatad0200";
BA_ "SPN" SG_ 2566838921 Appl_Id_Byte_26 234;
BA_ "CI_FullName" SG_ 2566838921 Appl_Id_Byte_27 "Software Identification";
BA_ "CI_ParId" SG_ 2566838921 Appl_Id_Byte_27 "ESMD_03139";
BA_ "CI_SLOT_Name" SG_ 2566838921 Appl_Id_Byte_27 "SAEatad0200";
BA_ "SPN" SG_ 2566838921 Appl_Id_Byte_27 234;
BA_ "CI_FullName" SG_ 2566838921 Appl_Id_Byte_28 "Software Identification";
BA_ "CI_ParId" SG_ 2566838921 Appl_Id_Byte_28 "ESMD_03139";
BA_ "CI_SLOT_Name" SG_ 2566838921 Appl_Id_Byte_28 "SAEatad0200";
BA_ "SPN" SG_ 2566838921 Appl_Id_Byte_28 234;
BA_ "CI_FullName" SG_ 2566838921 Appl_Id_Byte_29 "Software Identification";
BA_ "CI_ParId" SG_ 2566838921 Appl_Id_Byte_29 "ESMD_03139";
BA_ "CI_SLOT_Name" SG_ 2566838921 Appl_Id_Byte_29 "SAEatad0200";
BA_ "SPN" SG_ 2566838921 Appl_Id_Byte_29 234;
BA_ "CI_FullName" SG_ 2566838921 Appl_Id_Byte_30 "Software Identification";
BA_ "CI_ParId" SG_ 2566838921 Appl_Id_Byte_30 "ESMD_03139";
BA_ "CI_SLOT_Name" SG_ 2566838921 Appl_Id_Byte_30 "SAEatad0200";
BA_ "SPN" SG_ 2566838921 Appl_Id_Byte_30 234;
BA_ "CI_FullName" SG_ 2566838921 Appl_Id_Byte_31 "Software Identification";
BA_ "CI_ParId" SG_ 2566838921 Appl_Id_Byte_31 "ESMD_03139";
BA_ "CI_SLOT_Name" SG_ 2566838921 Appl_Id_Byte_31 "SAEatad0200";
BA_ "SPN" SG_ 2566838921 Appl_Id_Byte_31 234;
BA_ "CI_FullName" SG_ 2566838921 Appl_Id_Byte_32 "Software Identification";
BA_ "CI_ParId" SG_ 2566838921 Appl_Id_Byte_32 "ESMD_03139";
BA_ "CI_SLOT_Name" SG_ 2566838921 Appl_Id_Byte_32 "SAEatad0200";
BA_ "SPN" SG_ 2566838921 Appl_Id_Byte_32 234;
BA_ "CI_FullName" SG_ 2566838921 Appl_Id_Byte_33 "Software Identification";
BA_ "CI_ParId" SG_ 2566838921 Appl_Id_Byte_33 "ESMD_03139";
BA_ "CI_SLOT_Name" SG_ 2566838921 Appl_Id_Byte_33 "SAEatad0200";
BA_ "SPN" SG_ 2566838921 Appl_Id_Byte_33 234;
BA_ "CI_FullName" SG_ 2566838921 Appl_Id_Byte_34 "Software Identification";
BA_ "CI_ParId" SG_ 2566838921 Appl_Id_Byte_34 "ESMD_03139";
BA_ "CI_SLOT_Name" SG_ 2566838921 Appl_Id_Byte_34 "SAEatad0200";
BA_ "SPN" SG_ 2566838921 Appl_Id_Byte_34 234;
BA_ "CI_FullName" SG_ 2566838921 Appl_Id_Byte_35 "Software Identification";
BA_ "CI_ParId" SG_ 2566838921 Appl_Id_Byte_35 "ESMD_03139";
BA_ "CI_SLOT_Name" SG_ 2566838921 Appl_Id_Byte_35 "SAEatad0200";
BA_ "SPN" SG_ 2566838921 Appl_Id_Byte_35 234;
BA_ "CI_FullName" SG_ 2566838921 Appl_Id_Byte_36 "Software Identification";
BA_ "CI_ParId" SG_ 2566838921 Appl_Id_Byte_36 "ESMD_03139";
BA_ "CI_SLOT_Name" SG_ 2566838921 Appl_Id_Byte_36 "SAEatad0200";
BA_ "SPN" SG_ 2566838921 Appl_Id_Byte_36 234;
BA_ "CI_FullName" SG_ 2566838921 Appl_Id_Byte_37 "Software Identification";
BA_ "CI_ParId" SG_ 2566838921 Appl_Id_Byte_37 "ESMD_03139";
BA_ "CI_SLOT_Name" SG_ 2566838921 Appl_Id_Byte_37 "SAEatad0200";
BA_ "SPN" SG_ 2566838921 Appl_Id_Byte_37 234;
BA_ "CI_FullName" SG_ 2566838921 Appl_Id_Byte_38 "Software Identification";
BA_ "CI_ParId" SG_ 2566838921 Appl_Id_Byte_38 "ESMD_03139";
BA_ "CI_SLOT_Name" SG_ 2566838921 Appl_Id_Byte_38 "SAEatad0200";
BA_ "SPN" SG_ 2566838921 Appl_Id_Byte_38 234;
BA_ "CI_FullName" SG_ 2566838921 Appl_Id_Byte_39 "Software Identification";
BA_ "CI_ParId" SG_ 2566838921 Appl_Id_Byte_39 "ESMD_03139";
BA_ "CI_SLOT_Name" SG_ 2566838921 Appl_Id_Byte_39 "SAEatad0200";
BA_ "SPN" SG_ 2566838921 Appl_Id_Byte_39 234;
BA_ "CI_FullName" SG_ 2566838921 Appl_Id_Enum "Software Identification";
BA_ "CI_ParId" SG_ 2566838921 Appl_Id_Enum "ESMD_03139";
BA_ "CI_SLOT_Name" SG_ 2566838921 Appl_Id_Enum "SAEbs24";
BA_ "SPN" SG_ 2566838921 Appl_Id_Enum 234;
BA_ "CI_FullName" SG_ 2566838921 Bootloader_Id "Software Identification";
BA_ "CI_ParId" SG_ 2566838921 Bootloader_Id "ESMD_03139";
BA_ "CI_SLOT_Name" SG_ 2566838921 Bootloader_Id "SAEatad0200";
BA_ "SPN" SG_ 2566838921 Bootloader_Id 234;
BA_ "CI_FullName" SG_ 2566838921 Bootloader_Id_Byte_01 "Software Identification";
BA_ "CI_ParId" SG_ 2566838921 Bootloader_Id_Byte_01 "ESMD_03139";
BA_ "CI_SLOT_Name" SG_ 2566838921 Bootloader_Id_Byte_01 "SAEatad0200";
BA_ "SPN" SG_ 2566838921 Bootloader_Id_Byte_01 234;
BA_ "CI_FullName" SG_ 2566838921 Bootloader_Id_Byte_02 "Software Identification";
BA_ "CI_ParId" SG_ 2566838921 Bootloader_Id_Byte_02 "ESMD_03139";
BA_ "CI_SLOT_Name" SG_ 2566838921 Bootloader_Id_Byte_02 "SAEatad0200";
BA_ "SPN" SG_ 2566838921 Bootloader_Id_Byte_02 234;
BA_ "CI_FullName" SG_ 2566838921 Bootloader_Id_Byte_03 "Software Identification";
BA_ "CI_ParId" SG_ 2566838921 Bootloader_Id_Byte_03 "ESMD_03139";
BA_ "CI_SLOT_Name" SG_ 2566838921 Bootloader_Id_Byte_03 "SAEatad0200";
BA_ "SPN" SG_ 2566838921 Bootloader_Id_Byte_03 234;
BA_ "CI_FullName" SG_ 2566838921 Bootloader_Id_Byte_04 "Software Identification";
BA_ "CI_ParId" SG_ 2566838921 Bootloader_Id_Byte_04 "ESMD_03139";
BA_ "CI_SLOT_Name" SG_ 2566838921 Bootloader_Id_Byte_04 "SAEatad0200";
BA_ "SPN" SG_ 2566838921 Bootloader_Id_Byte_04 234;
BA_ "CI_FullName" SG_ 2566838921 Bootloader_Id_Byte_05 "Software Identification";
BA_ "CI_ParId" SG_ 2566838921 Bootloader_Id_Byte_05 "ESMD_03139";
BA_ "CI_SLOT_Name" SG_ 2566838921 Bootloader_Id_Byte_05 "SAEatad0200";
BA_ "SPN" SG_ 2566838921 Bootloader_Id_Byte_05 234;
BA_ "CI_FullName" SG_ 2566866048 EHR_ChksumStor "EHR Checksum Storage";
BA_ "CI_ParId" SG_ 2566866048 EHR_ChksumStor "ESMD_20887";
BA_ "CI_FullName" SG_ 2566866048 EHR_ChksumSW "EHR Checksum Software";
BA_ "CI_ParId" SG_ 2566866048 EHR_ChksumSW "ESMD_20886";
BA_ "CI_FullName" SG_ 2566866048 EHR_EvNumParamMux_12 "EHR Valve Number Parameter Multiplex 12";
BA_ "CI_ParId" SG_ 2566866048 EHR_EvNumParamMux_12 "ESMD_20916";
BA_ "CI_FullName" SG_ 2566866048 EHR_ParamByte_1 "EHR Parameter Byte 1";
BA_ "CI_ParId" SG_ 2566866048 EHR_ParamByte_1 "ESMD_20901";
BA_ "CI_FullName" SG_ 2566866048 EHR_ParamStsByte_2 "EHR Parameter Status Byte 2";
BA_ "CI_ParId" SG_ 2566866048 EHR_ParamStsByte_2 "ESMD_20903";
BA_ "CI_FullName" SG_ 2566866048 EHR_ParamStsByte_3 "EHR Parameter Status Byte 3";
BA_ "CI_ParId" SG_ 2566866048 EHR_ParamStsByte_3 "ESMD_20904";
BA_ "CI_FullName" SG_ 2566866048 EHR_RmpRndng "EHR Ramp Rounding";
BA_ "CI_ParId" SG_ 2566866048 EHR_RmpRndng "ESMD_20908";
BA_ "CI_FullName" SG_ 2566866049 EHR_ChksumStor "EHR Checksum Storage";
BA_ "CI_ParId" SG_ 2566866049 EHR_ChksumStor "ESMD_20887";
BA_ "CI_FullName" SG_ 2566866049 EHR_ChksumSW "EHR Checksum Software";
BA_ "CI_ParId" SG_ 2566866049 EHR_ChksumSW "ESMD_20886";
BA_ "CI_FullName" SG_ 2566866049 EHR_EvNumParamMux_12 "EHR Valve Number Parameter Multiplex 12";
BA_ "CI_ParId" SG_ 2566866049 EHR_EvNumParamMux_12 "ESMD_20916";
BA_ "CI_FullName" SG_ 2566866049 EHR_ParamByte_1 "EHR Parameter Byte 1";
BA_ "CI_ParId" SG_ 2566866049 EHR_ParamByte_1 "ESMD_20901";
BA_ "CI_FullName" SG_ 2566866049 EHR_ParamStsByte_2 "EHR Parameter Status Byte 2";
BA_ "CI_ParId" SG_ 2566866049 EHR_ParamStsByte_2 "ESMD_20903";
BA_ "CI_FullName" SG_ 2566866049 EHR_ParamStsByte_3 "EHR Parameter Status Byte 3";
BA_ "CI_ParId" SG_ 2566866049 EHR_ParamStsByte_3 "ESMD_20904";
BA_ "CI_FullName" SG_ 2566866049 EHR_RmpRndng "EHR Ramp Rounding";
BA_ "CI_ParId" SG_ 2566866049 EHR_RmpRndng "ESMD_20908";
BA_ "CI_FullName" SG_ 2566866050 EHR_ChksumStor "EHR Checksum Storage";
BA_ "CI_ParId" SG_ 2566866050 EHR_ChksumStor "ESMD_20887";
BA_ "CI_FullName" SG_ 2566866050 EHR_ChksumSW "EHR Checksum Software";
BA_ "CI_ParId" SG_ 2566866050 EHR_ChksumSW "ESMD_20886";
BA_ "CI_FullName" SG_ 2566866050 EHR_EvNumParamMux_12 "EHR Valve Number Parameter Multiplex 12";
BA_ "CI_ParId" SG_ 2566866050 EHR_EvNumParamMux_12 "ESMD_20916";
BA_ "CI_FullName" SG_ 2566866050 EHR_ParamByte_1 "EHR Parameter Byte 1";
BA_ "CI_ParId" SG_ 2566866050 EHR_ParamByte_1 "ESMD_20901";
BA_ "CI_FullName" SG_ 2566866050 EHR_ParamStsByte_2 "EHR Parameter Status Byte 2";
BA_ "CI_ParId" SG_ 2566866050 EHR_ParamStsByte_2 "ESMD_20903";
BA_ "CI_FullName" SG_ 2566866050 EHR_ParamStsByte_3 "EHR Parameter Status Byte 3";
BA_ "CI_ParId" SG_ 2566866050 EHR_ParamStsByte_3 "ESMD_20904";
BA_ "CI_FullName" SG_ 2566866050 EHR_RmpRndng "EHR Ramp Rounding";
BA_ "CI_ParId" SG_ 2566866050 EHR_RmpRndng "ESMD_20908";
BA_ "CI_FullName" SG_ 2566866051 EHR_ChksumStor "EHR Checksum Storage";
BA_ "CI_ParId" SG_ 2566866051 EHR_ChksumStor "ESMD_20887";
BA_ "CI_FullName" SG_ 2566866051 EHR_ChksumSW "EHR Checksum Software";
BA_ "CI_ParId" SG_ 2566866051 EHR_ChksumSW "ESMD_20886";
BA_ "CI_FullName" SG_ 2566866051 EHR_EvNumParamMux_12 "EHR Valve Number Parameter Multiplex 12";
BA_ "CI_ParId" SG_ 2566866051 EHR_EvNumParamMux_12 "ESMD_20916";
BA_ "CI_FullName" SG_ 2566866051 EHR_ParamByte_1 "EHR Parameter Byte 1";
BA_ "CI_ParId" SG_ 2566866051 EHR_ParamByte_1 "ESMD_20901";
BA_ "CI_FullName" SG_ 2566866051 EHR_ParamStsByte_2 "EHR Parameter Status Byte 2";
BA_ "CI_ParId" SG_ 2566866051 EHR_ParamStsByte_2 "ESMD_20903";
BA_ "CI_FullName" SG_ 2566866051 EHR_ParamStsByte_3 "EHR Parameter Status Byte 3";
BA_ "CI_ParId" SG_ 2566866051 EHR_ParamStsByte_3 "ESMD_20904";
BA_ "CI_FullName" SG_ 2566866051 EHR_RmpRndng "EHR Ramp Rounding";
BA_ "CI_ParId" SG_ 2566866051 EHR_RmpRndng "ESMD_20908";
VAL_ 2566866048 EHR_ParamByte_1 127 "EHR Parameter Status" 59 "EHR Parameter Control" ;
VAL_ 2566866048 EHR_ParamStsByte_3 244 "Check status (PTO uses)" 103 "RoundingOfTheTimeRamp" 80 "ReadChecksumOfApplicationSw" ;
VAL_ 2566866049 EHR_ParamByte_1 127 "EHR Parameter Status" 59 "EHR Parameter Control" ;
VAL_ 2566866049 EHR_ParamStsByte_3 244 "Check status (PTO uses)" 103 "RoundingOfTheTimeRamp" 80 "ReadChecksumOfApplicationSw" ;
VAL_ 2566866050 EHR_ParamByte_1 127 "EHR Parameter Status" 59 "EHR Parameter Control" ;
VAL_ 2566866050 EHR_ParamStsByte_3 244 "Check status (PTO uses)" 103 "RoundingOfTheTimeRamp" 80 "ReadChecksumOfApplicationSw" ;
VAL_ 2566866051 EHR_ParamByte_1 127 "EHR Parameter Status" 59 "EHR Parameter Control" ;
VAL_ 2566866051 EHR_ParamStsByte_3 244 "Check status (PTO uses)" 103 "RoundingOfTheTimeRamp" 80 "ReadChecksumOfApplicationSw" ;
